## CMakeLists.txt
```
# SPDX-License-Identifier: Apache-2.0

cmake_minimum_required(VERSION 3.20.0)

find_package(Zephyr REQUIRED HINTS $ENV{ZEPHYR_BASE})
project(periodic_adv_rsp)

target_sources(app PRIVATE
  src/main.c
  src/pawr_broadcaster.c
  src/onboarding_manager.c
  )

target_include_directories(app PRIVATE include)
```

## Kconfig
```
# Copyright (c) 2025 Nordic Semiconductor ASA
# SPDX-License-Identifier: Apache-2.0

mainmenu "Maximum Throughput Sample"

config MAX_THROUGHPUT
	bool "Maximum Throughput Sample Settings"
	default y
	help
		Enable configuration options for maximum throughput sample

config BT_MAX_THROUGHPUT_DEVICES
	int "Number of PAwR scanner devices"
	default 16
	range 1 255
	depends on MAX_THROUGHPUT
	help
		Number of scanner devices that will participate in the PAwR communication.
		This affects timing calculations.
		IMPORTANT: This value must match the NUM_SYNCHRONIZERS in run_devices.sh
		

source "Kconfig.zephyr" 
```

## prj.conf
```kconfig
# Basic Bluetooth configuration
CONFIG_BT=y
CONFIG_BT_BROADCASTER=y
CONFIG_BT_EXT_ADV=y
CONFIG_BT_PER_ADV=y
CONFIG_BT_DEVICE_NAME="PAwR adv sample"

CONFIG_BT_MAX_CONN=1
CONFIG_BT_CONN_TX_MAX=10
CONFIG_BT_CENTRAL=y
CONFIG_BT_PER_ADV_SYNC_TRANSFER_SENDER=y

# Enable Periodic Advertising with Responses (PAwR)
CONFIG_BT_PER_ADV_RSP=y

CONFIG_BT_REMOTE_INFO=y
CONFIG_BT_GATT_CLIENT=y

# Controller configuration for simulator
CONFIG_BT_CTLR_PHY_2M=y
CONFIG_BT_CTLR_SDC_MAX_CONN_EVENT_LEN_DEFAULT=4000000
CONFIG_BT_CTLR_TX_PWR_DYNAMIC_CONTROL=y

# Buffer and data length configuration
CONFIG_BT_BUF_ACL_RX_SIZE=502
CONFIG_BT_BUF_ACL_TX_SIZE=502
CONFIG_BT_L2CAP_TX_MTU=498
CONFIG_BT_DATA_LEN_UPDATE=y
CONFIG_BT_USER_PHY_UPDATE=y
CONFIG_BT_GAP_AUTO_UPDATE_CONN_PARAMS=n

# Controller buffer configuration
CONFIG_BT_CTLR_DATA_LENGTH_MAX=251
CONFIG_BT_CTLR_SDC_TX_PACKET_COUNT=10
CONFIG_BT_CTLR_SDC_RX_PACKET_COUNT=10

# Maximum Throughput Sample Configuration
CONFIG_THROUGHPUT_PAWR=y
CONFIG_BT_NUM_RSP_DEVICES=1

# Enable PHY update
CONFIG_BT_USER_PHY_UPDATE=y

CONFIG_BT_CTLR_SDC_PERIODIC_ADV_RSP_TX_MAX_DATA_SIZE=247
CONFIG_BT_CTLR_SDC_PERIODIC_ADV_RSP_TX_BUFFER_COUNT=8
CONFIG_BT_CTLR_SDC_PERIODIC_ADV_RSP_RX_BUFFER_COUNT=64


# Logging for physical dks 
CONFIG_PRINTK=y
CONFIG_SERIAL=y
CONFIG_CONSOLE=y
CONFIG_UART_CONSOLE=y
CONFIG_BOOT_BANNER=y
```

## src/main.c
```c
/*
 * Copyright (c) 2025 Nordic Semiconductor ASA
 *
 * SPDX-License-Identifier: Apache-2.0
 */

#include <zephyr/bluetooth/bluetooth.h>
#include <zephyr/bluetooth/hci.h>
#include <zephyr/kernel.h>
#include <zephyr/sys/byteorder.h>
#include <string.h>
#include <stdint.h>
#include <stdio.h>
#include <stdbool.h>

/*
* PAwR Throughput Demo
* Advertiser sends subevent data with control information.
* Devices claim response slots using PAwR responses.
* Retransmissions are bitmap-controlled.
*/


#define NUM_RSP_SLOTS                   CONFIG_BT_NUM_RSP_DEVICES
#define NUM_SUBEVENTS                   1
#define PAYLOAD_SIZE                    251
#define ADV_NAME                        "PAwR adv sample"
#define NORDIC_COMPANY_ID               0x0059 

#define MAX_INDIVIDUAL_RESPONSE_SIZE    247     /* BLE spec limit for individual responses */
#define THROUGHPUT_PRINT_INTERVAL       1000 
#define PAWR_CLAIM_MSG_ID               0xC1
#define CLAIM_MSG_LEN                   5       /* Claim token length (4B) + Claim token offset (1B) */
#define PAWR_INTERVAL_UNIT_MS_X100      125U
#define PAWR_PHY_MBIT_PER_S             2U      /* LE 2M */
 

void set_pawr_params(struct bt_le_per_adv_param *params, uint8_t num_response_slots)
{
    const uint16_t min_pawr_interval_ms         = 1;       
    const uint16_t payload_size                 = MAX_INDIVIDUAL_RESPONSE_SIZE; 
    const uint32_t advertiser_guard_ms_x100     = 100U; /* 1.00 ms -> 100 */
    const uint32_t quarter_ms_x100              = 25U;  /* 0.25 ms -> 25 */
    const uint8_t response_slot_delay_units     = 3U;   /* 3 * 1.25 ms = 3.75 ms */
    const uint32_t response_slot_delay_ms_x100  = (uint32_t)response_slot_delay_units * PAWR_INTERVAL_UNIT_MS_X100;

    /* Approximate on-air time + radio turnarounds at 2M PHY */
    const uint32_t payload_bits     = (uint32_t)payload_size * 8U;          /* payload_size * 8 bits = total bits to transmit */
    const uint32_t tx_denom_ms      = (uint32_t)PAWR_PHY_MBIT_PER_S * 10U;  /* PAWR_PHY_MBIT_PER_S * 10 = bits per ms */
    const uint32_t tx_time_ms_x100  = (payload_bits + tx_denom_ms - 1U) / tx_denom_ms; 
    const uint32_t slot_ms_x100     = tx_time_ms_x100 + quarter_ms_x100;
    const uint32_t slot_units       = DIV_ROUND_UP(slot_ms_x100 * 10U, PAWR_INTERVAL_UNIT_MS_X100);
    /* if (slot_units > UINT16_MAX) { 
        printk("slot_units overflow\n");
    }*/
    const uint16_t slot_spacing_units       = (uint16_t)slot_units;
    const uint32_t subevent_ms_x100         = response_slot_delay_ms_x100 + (uint32_t)num_response_slots * slot_ms_x100;

    uint32_t subevent_interval_units_tmp    = DIV_ROUND_UP(subevent_ms_x100, PAWR_INTERVAL_UNIT_MS_X100);
    uint16_t subevent_interval_units        = (uint16_t)(subevent_interval_units_tmp);
    if (subevent_interval_units < 6U) {
        subevent_interval_units = 6U;
    } else if (subevent_interval_units > 255U) {
        subevent_interval_units = 255U;
        printk("Warning: subevent too long for one window; consider fewer devices or smaller payload.\n");
    }

    const uint32_t total_event_ms_x100  = subevent_ms_x100 + advertiser_guard_ms_x100;
    const uint32_t min_interval_units   = (uint32_t)(((uint32_t)min_pawr_interval_ms * 100U + PAWR_INTERVAL_UNIT_MS_X100 - 1U) / PAWR_INTERVAL_UNIT_MS_X100);

    const uint32_t required_interval_units = (total_event_ms_x100 + PAWR_INTERVAL_UNIT_MS_X100 - 1U) / PAWR_INTERVAL_UNIT_MS_X100;

    uint16_t advertising_event_interval_units = (required_interval_units > min_interval_units) ? (uint16_t)required_interval_units : (uint16_t)min_interval_units;

    if (advertising_event_interval_units < subevent_interval_units) {
        advertising_event_interval_units = subevent_interval_units;
    }

    /* fill params */
    params->interval_min            = advertising_event_interval_units;
    params->interval_max            = advertising_event_interval_units;
    params->options                 = 0;
    params->num_subevents           = 1;
    params->subevent_interval       = (uint8_t)subevent_interval_units;
    params->response_slot_delay     = (uint8_t)response_slot_delay_units;
    params->response_slot_spacing   = (uint8_t)slot_spacing_units;
    params->num_response_slots      = num_response_slots;

    /* Diagnostics: */
    const uint32_t adv_event_ms_x100    = (uint32_t)advertising_event_interval_units * 125U;
    const uint32_t est_throughput_kbps  = (adv_event_ms_x100 > 0U) ? 
                                            (uint32_t)(((uint64_t)num_response_slots * payload_size * 8ULL * 100000ULL) /
                                            (uint64_t)adv_event_ms_x100) / 1000U : 0U;

    printk("PAwR config (1 subevent):\n");
    printk("  Devices: %u, Resp size: %u B, Slot: %u.%02u ms\n",
           num_response_slots, payload_size, slot_ms_x100 / 100U, slot_ms_x100 % 100U);
    printk("  Delay: %u (%u.%02u ms), SubEvt: %u (%u.%02u ms), AdvInt: %u (%u.%02u ms)\n",
           response_slot_delay_units, response_slot_delay_ms_x100 / 100U, response_slot_delay_ms_x100 % 100U,
           subevent_interval_units, subevent_ms_x100 / 100U, subevent_ms_x100 % 100U,
           advertising_event_interval_units, adv_event_ms_x100 / 100U, adv_event_ms_x100 % 100U);
    printk("  Est. uplink throughput (theoretical) ~%u kbps\n", (unsigned int)est_throughput_kbps);
}

static struct bt_le_per_adv_param   per_adv_params;

void init_adv_params(void) 
{
	set_pawr_params(&per_adv_params,NUM_RSP_SLOTS);
}

static struct bt_le_per_adv_subevent_data_params subevent_data_params[NUM_SUBEVENTS];
static struct net_buf_simple bufs[NUM_SUBEVENTS];
static uint8_t backing_store[NUM_SUBEVENTS][PAYLOAD_SIZE];

BUILD_ASSERT(ARRAY_SIZE(bufs)           == ARRAY_SIZE(subevent_data_params));
BUILD_ASSERT(ARRAY_SIZE(backing_store)  == ARRAY_SIZE(subevent_data_params));

#define BITMAP_BYTES_NEEDED(num_devices) (((num_devices) + 7) / 8)
static uint8_t response_bitmap[BITMAP_BYTES_NEEDED(NUM_RSP_SLOTS)];
static uint8_t expected_responses[BITMAP_BYTES_NEEDED(NUM_RSP_SLOTS)];

/*
 * Slot assignment state and ACK queue for claim/ack protocol
 */
struct slot_assignment_state 
{
    bool        assigned;
    uint32_t    token; /* Token that owns this slot, 0 if unassigned */
};

static struct slot_assignment_state     slot_state[NUM_RSP_SLOTS];

struct ack_entry 
{
    uint32_t    token;
    uint8_t     slot;
};

#define MAX_ACKS_PER_EVENT  32
static struct               ack_entry ack_queue[MAX_ACKS_PER_EVENT];
static uint8_t              ack_queue_count;

/* Build a bitmap of unassigned (open) slots; Bit i set => slot i is open*/
static void build_open_slots_bitmap(uint8_t *out, uint8_t bytes)
{
    memset(out, 0, bytes);
    for (int i = 0; i < NUM_RSP_SLOTS; i++) {
        if (!slot_state[i].assigned) {
            uint8_t idx = (uint8_t)(i / 8);
            uint8_t bit = (uint8_t)(i % 8);
            if (idx < bytes) {
                out[idx] |= (uint8_t)(1U << bit);
            }
        }
    }
}

/* Linear search for slot by token owner*/
static int find_slot_by_token(uint32_t token)
{
    if (token == 0) {
        return -1;
    }
    for (int i = 0; i < NUM_RSP_SLOTS; i++) {
        if (slot_state[i].assigned && slot_state[i].token == token) {
            return i;
        }
    }
    return -1;
}

/* Append an ACK (tocken,slot) if queue has room */
static void queue_ack(uint32_t token, uint8_t slot)
{
    if (ack_queue_count < MAX_ACKS_PER_EVENT) {
        ack_queue[ack_queue_count].token    = token;
        ack_queue[ack_queue_count].slot     = slot;
        ack_queue_count++;
    }
}

/* Set bit in a byte-addressed bitmap*/
static void bitmap_set_bit(uint8_t *bitmap, int bit) 
{
    /* Test bit in a byte-addressed bitmap*/
    bitmap[bit / 8] |= (1 << (bit % 8));
}

/* Clear bitmap to zero for the first num_bits bits */
static bool bitmap_test_bit(const uint8_t *bitmap, int bit) 
{
    return (bitmap[bit / 8] & (1 << (bit % 8))) != 0;
}

/* Build PAwR control payload and program controller*/
static void bitmap_clear(uint8_t *bitmap, int num_bits) 
{
    memset(bitmap, 0, BITMAP_BYTES_NEEDED(num_bits));
}

static void reclaim_idle_slots()
{
    static uint8_t noresp_counters[NUM_RSP_SLOTS];
    for (int slot = 0; slot < NUM_RSP_SLOTS; slot++) {
        bool was_expected = bitmap_test_bit(expected_responses, slot);
        bool got_response = bitmap_test_bit(response_bitmap, slot);
        if (was_expected && !got_response) {
            if (noresp_counters[slot] < 255) {
                noresp_counters[slot]++;
            }
            if (noresp_counters[slot] >= 3) {
                /* Consider this slot idle; free it for new claimers */
                slot_state[slot].assigned = false;
                slot_state[slot].token = 0;
                noresp_counters[slot] = 0;
                printk("[CLAIM] Reclaimed idle slot %d\n", slot);
            }
        } else if (got_response) {
            noresp_counters[slot] = 0;
        }
    }
}

static void open_slots_bitmap(struct net_buf_simple *buf)
{
    uint8_t open_len_full   = BITMAP_BYTES_NEEDED(NUM_RSP_SLOTS);
    uint8_t open_len        = open_len_full > 32 ? 32 : open_len_full;
    uint8_t tmp_open[32];
    build_open_slots_bitmap(tmp_open, open_len);
    net_buf_simple_add_u8(buf, open_len);
    for (uint8_t j = 0; j < open_len; j++) {
        net_buf_simple_add_u8(buf, tmp_open[j]);
    }
}

static void append_acks(struct net_buf_simple *buf, uint8_t bitmap_bytes, uint8_t *ack_count_ptr)
{
    *ack_count_ptr          = 0;
    size_t reserved_for_rt  = 1 + bitmap_bytes /* rt len + rt bytes */;
    size_t tail             = net_buf_simple_tailroom(buf);
    size_t ack_space        = (tail > reserved_for_rt) ? (tail - reserved_for_rt) : 0;
    uint8_t ack_capacity    = (uint8_t)(ack_space / CLAIM_MSG_LEN); 
    if (ack_capacity > MAX_ACKS_PER_EVENT) {
        ack_capacity = MAX_ACKS_PER_EVENT;
    }
    uint8_t acks_to_send = MIN(ack_queue_count, ack_capacity);
    for (uint8_t a = 0; a < acks_to_send; a++) {
        net_buf_simple_add_le32(buf, ack_queue[a].token);
        net_buf_simple_add_u8(buf, ack_queue[a].slot);
    }
    *ack_count_ptr = acks_to_send;
}

static void append_retransmit_bitmap(struct net_buf_simple *buf, uint8_t bitmap_bytes, uint8_t *retransmit_bitmap)
{
    uint8_t rt_bytes_to_send = bitmap_bytes > 4 ? 4 : bitmap_bytes;
        net_buf_simple_add_u8(buf, rt_bytes_to_send);
        for (int j = 0; j < rt_bytes_to_send; j++) {
            net_buf_simple_add_u8(buf, retransmit_bitmap[j]);
        }
}

static void request_cb(struct bt_le_ext_adv *adv, const struct bt_le_per_adv_data_request *request)
{
    int         err;
    uint8_t     to_send;
    struct      net_buf_simple *buf;

    if (!request) {
        printk("Error: NULL request received\n");
        return;
    }

    to_send = MIN(request->count, ARRAY_SIZE(subevent_data_params));

    /* Calculate retransmission bitmap (bits set for slots that didn't respond) */
    uint8_t bitmap_bytes = BITMAP_BYTES_NEEDED(NUM_RSP_SLOTS);
    uint8_t retransmit_bitmap[bitmap_bytes];
    
    for (int i = 0; i < bitmap_bytes; i++) {
        retransmit_bitmap[i] = expected_responses[i] & (~response_bitmap[i]);
    }
    /* Reporting which slots missed a response */
    for (int s = 0; s < NUM_RSP_SLOTS; s++) {
        uint8_t idx = (uint8_t)(s / 8);
        uint8_t bit = (uint8_t)(s % 8);
        if (idx < bitmap_bytes && (retransmit_bitmap[idx] & (uint8_t)(1U << bit))) {
            printk("[LOSS] slot %d missed response; should retransmit\n", s);
        }
    }
    reclaim_idle_slots();

    /* Reset response bitmap */
    bitmap_clear(response_bitmap, NUM_RSP_SLOTS);

    /* Process each subevent */
    for (size_t i = 0; i < to_send; i++) {
        buf = &bufs[i];
        net_buf_simple_reset(buf);
        uint8_t *length_field = net_buf_simple_add(buf, 1);
        net_buf_simple_add_u8(buf, BT_DATA_MANUFACTURER_DATA);
        net_buf_simple_add_le16(buf, NORDIC_COMPANY_ID); 
        net_buf_simple_add_u8(buf, 0x01); /* protocol version */
        net_buf_simple_add_u8(buf, 0x00); /* protocol flags (none) */

        /* Open slots bitmap */
        open_slots_bitmap(buf);

        /* ACK list: pack as many as tailroom allows, but cap to MAX_ACKS_PER_EVENT */
        uint8_t *ack_count_ptr = net_buf_simple_add(buf, 1);
        append_acks(buf, bitmap_bytes, ack_count_ptr);

        /* Retransmit bitmap: clamp to 4 bytes to keep control small during join */
        append_retransmit_bitmap(buf, bitmap_bytes, retransmit_bitmap);

        *length_field = buf->len - 1;

        subevent_data_params[i].subevent            = request->start + i;
        subevent_data_params[i].response_slot_start = 0;
        subevent_data_params[i].response_slot_count = NUM_RSP_SLOTS;
        subevent_data_params[i].data                = buf;
    }

    /* We just consumed pending ACKs; clear the queue for next event */
    ack_queue_count  = 0;

    err = bt_le_per_adv_set_subevent_data(adv, to_send, subevent_data_params);
    if (err) {
        printk(" [ADV]Failed to set subevent data (err %d)\n", err);
    } 
}

void handle_claim_message(struct net_buf_simple *buf, struct bt_le_per_adv_response_info *info)
{
    /* CLAIM message: [0xC1][token(4B LE)] */
    uint32_t token = sys_get_le32(&buf->data[1]);

    if (info->response_slot < NUM_RSP_SLOTS) {
        int already = find_slot_by_token(token);
        if (already >= 0) {
            /* This token already owns a slot: only ACK its true slot */
            if (already == info->response_slot) {
                queue_ack(token, (uint8_t)already);
            }
        } else if (!slot_state[info->response_slot].assigned) {
            /* Assign the slot to this token and queue ACK */
            slot_state[info->response_slot].assigned = true;
            slot_state[info->response_slot].token = token;
            bitmap_set_bit(expected_responses, info->response_slot);
            queue_ack(token, info->response_slot);
            printk("[CLAIM] accepted: slot %d token 0x%08x\n", info->response_slot, token);
        } else {
            /* Slot already assigned to a different token: ignore */
        }
    }
}

static void print_throughput(uint64_t stamp, uint32_t total_bytes)
{
    int64_t delta = k_uptime_delta(&stamp);
    uint64_t measured_kbps = (delta > 0) ? (((uint64_t)total_bytes * 8ULL) / (uint64_t)delta) : 0ULL;
    printk("\n[ADV] received %u bytes (%u KB) in %lld ms at %llu kbps\n",
            total_bytes, total_bytes / 1024, delta, measured_kbps);
    
    uint16_t interval_units = per_adv_params.interval_min; 
    uint32_t adv_ms_x100    = (uint32_t)interval_units * 125U;
    uint16_t num_rsp_slots  = per_adv_params.num_response_slots;
    uint16_t payload_bytes  = MAX_INDIVIDUAL_RESPONSE_SIZE;
    
    if (adv_ms_x100 > 0U && num_rsp_slots > 0U) {
        uint32_t theo_kbps =
            (uint32_t)(((uint64_t)num_rsp_slots * payload_bytes * 8ULL * 100000ULL) /
                        (uint64_t)adv_ms_x100) / 1000U;
    
        printk("[PAwR] theoretical ~%u kbps; efficiency ~%u%% (N=%u, payload=%u, AdvInt=%u.%02u ms)\n",
                (unsigned int)theo_kbps,
                (unsigned int)((theo_kbps > 0U) ? (uint32_t)((measured_kbps * 100ULL) / theo_kbps) : 0U),
                (unsigned int)num_rsp_slots,
                (unsigned int)payload_bytes,
                (unsigned int)(adv_ms_x100 / 100U),
                (unsigned int)(adv_ms_x100 % 100U));
    }
}

static void response_cb(struct bt_le_ext_adv *adv, struct bt_le_per_adv_response_info *info, struct net_buf_simple *buf)
{
    static uint32_t     total_bytes;
    static uint64_t      stamp;

    if (buf) {
        /* Initialize timestamp on first response */
        if (total_bytes == 0) {
            stamp = k_uptime_get_32();
        }

        /* Handle claim messages or data responses */
        if (buf->len >= CLAIM_MSG_LEN && buf->data[0] == PAWR_CLAIM_MSG_ID) {
            handle_claim_message(buf, info);
        } else {
            /* Count payload bytes as throughput */
            total_bytes += buf->len;
        }

        if (info->response_slot < NUM_RSP_SLOTS) {
            bitmap_set_bit(response_bitmap, info->response_slot);
        }

        if (k_uptime_get_32() - stamp > THROUGHPUT_PRINT_INTERVAL) {
            print_throughput(stamp, total_bytes);
            total_bytes = 0;
        }
    }
}


void init_bufs(void)
{
	for (size_t i = 0; i < ARRAY_SIZE(backing_store); i++) {
		/* Initialize buffer with backing storage */
		net_buf_simple_init_with_data(&bufs[i], &backing_store[i], ARRAY_SIZE(backing_store[i]));
		net_buf_simple_reset(&bufs[i]);
		
		/* Add manufacturer specific data */
		net_buf_simple_add_u8(&bufs[i], 3); /* Length of manufacturer data */
		net_buf_simple_add_u8(&bufs[i], BT_DATA_MANUFACTURER_DATA);
		net_buf_simple_add_le16(&bufs[i], NORDIC_COMPANY_ID); 
		
		printk("[ADV] Buffer %zu initialized with len %u\n", i, bufs[i].len);
	}
}

static const struct bt_data ad[] = {
    BT_DATA_BYTES(BT_DATA_FLAGS, (BT_LE_AD_GENERAL | BT_LE_AD_NO_BREDR)),
    BT_DATA(BT_DATA_NAME_COMPLETE, ADV_NAME, sizeof(ADV_NAME) - 1),
};

static const struct bt_le_ext_adv_cb adv_cb = {
    .pawr_data_request =    request_cb,
    .pawr_response     =    response_cb,
};


int main(void)
{
	int     err;
	struct  bt_le_ext_adv *pawr_adv;

    /* Initialize buffers */
	init_bufs();

    /* Initialize Bluetooth */
	err = bt_enable(NULL);
	if (err) {
		printk("Bluetooth init failed (err %d)\n", err);
		return 0;
	}
	printk("Bluetooth initialized\n");

	/* Initialize parameters */
	init_adv_params();

    printk("Starting PAwR Advertiser\n");
	printk("===========================================\n");

	/* Create a non-connectable advertising set */
	err = bt_le_ext_adv_create(BT_LE_EXT_ADV_NCONN, &adv_cb, &pawr_adv);
	if (err) {
		printk("Failed to create advertising set (err %d)\n", err);
		return 0;
	}

    /* Set extended advertising data */
	err = bt_le_ext_adv_set_data(pawr_adv, ad, ARRAY_SIZE(ad), NULL, 0);
    if (err) {
        printk("Failed to set ext adv data (err %d)\n", err);
        return 0;
    }

	/* Set periodic advertising parameters */
	err = bt_le_per_adv_set_param(pawr_adv, &per_adv_params);
	if (err) {
		printk("Failed to set periodic advertising parameters (err %d)\n", err);
		return 0;
	}

    /* Enable Extended Advertising */
    printk("Start Extended Advertising\n");
	err = bt_le_ext_adv_start(pawr_adv, BT_LE_EXT_ADV_START_DEFAULT);
	if (err) {
		printk("Failed to start extended advertising (err %d)\n", err);
		return 0;
	}

	/* Enable Periodic Advertising */
	printk("Start Periodic Advertising\n");
	err = bt_le_per_adv_start(pawr_adv);
	if (err) {
		printk("Failed to enable periodic advertising (err %d)\n", err);
		return 0;
	}

	return 0;
}
```

## include/onboarding_manager.h
```c
#ifndef ONBOARDING_MANAGER_H_
#define ONBOARDING_MANAGER_H_

#include <stdint.h>
#include <zephyr/bluetooth/bluetooth.h>

int onboarding_manager_init(struct bt_le_ext_adv *pawr_adv);

void onboarding_manager_start(void);

void onboarding_manager_handle_slot_idle(uint8_t slot);

#endif /* ONBOARDING_MANAGER_H_ */
```

## include/pawr_broadcaster.h
```c
#ifndef PAWR_BROADCASTER_H_
#define PAWR_BROADCASTER_H_

#include <zephyr/bluetooth/bluetooth.h>
#include <stdint.h>
#include <stdbool.h>

int pawr_broadcaster_init(struct bt_le_ext_adv **out_adv);

void pawr_broadcaster_set_slot_expected(uint8_t slot, bool expected);

uint8_t pawr_broadcaster_total_slots(void);

#endif /* PAWR_BROADCASTER_H_ */
```

## include/pawr_onboarding.h
```c
#ifndef PAWR_ONBOARDING_H_
#define PAWR_ONBOARDING_H_

#include <stdbool.h>
#include <zephyr/bluetooth/addr.h>
#include <zephyr/sys/util.h>

#ifdef CONFIG_BT_MAX_THROUGHPUT_DEVICES
#define PAWR_MAX_RESPONSE_SLOTS CONFIG_BT_MAX_THROUGHPUT_DEVICES
#else
#define PAWR_MAX_RESPONSE_SLOTS 1
#endif
#define PAWR_DEFAULT_SUBEVENT   0

/* UUIDs for the onboarding GATT service on the synchronizer side */
#define BT_UUID_PAWR_ONBOARDING_SERVICE_VAL \
	BT_UUID_128_ENCODE(0x12345678, 0x1234, 0x5678, 0x1234, 0x56789abcdef0)
#define BT_UUID_PAWR_SLOT_CHAR_VAL \
	BT_UUID_128_ENCODE(0x12345678, 0x1234, 0x5678, 0x1234, 0x56789abcdef1)

#define BT_UUID_PAWR_ONBOARDING_SERVICE BT_UUID_DECLARE_128(BT_UUID_PAWR_ONBOARDING_SERVICE_VAL)
#define BT_UUID_PAWR_SLOT_CHAR        BT_UUID_DECLARE_128(BT_UUID_PAWR_SLOT_CHAR_VAL)

struct pawr_slot_config {
	uint8_t subevent;
	uint8_t response_slot;
	uint16_t payload_id;
	uint8_t total_slots;
} __packed;

#endif /* PAWR_ONBOARDING_H_ */
```

## src/onboarding_manager.c
```c
#include <zephyr/bluetooth/bluetooth.h>
#include <zephyr/bluetooth/gap.h>
#include <zephyr/bluetooth/gatt.h>
#include <zephyr/bluetooth/hci.h>
#include <zephyr/kernel.h>
#include <zephyr/sys/byteorder.h>
#include <zephyr/sys/printk.h>
#include <zephyr/sys/util.h>
#include <string.h>

#include "onboarding_manager.h"
#include "pawr_onboarding.h"
#include "pawr_broadcaster.h"

#define TARGET_NAME "PAwR sync sample"
#define SCAN_RETRY_DELAY_MS 250
#ifdef CONFIG_BT_DEVICE_NAME_MAX
#define NAME_BUF_LEN CONFIG_BT_DEVICE_NAME_MAX
#else
#define NAME_BUF_LEN 30
#endif

struct slot_entry {
	bool valid;
	bool in_use;
	bt_addr_le_t addr;
};

static struct slot_entry slot_table[PAWR_MAX_RESPONSE_SLOTS];

static struct bt_conn *current_conn;
static bt_addr_le_t current_peer_addr;
static struct bt_le_ext_adv *adv_ref;

static uint8_t pending_slot = PAWR_MAX_RESPONSE_SLOTS;
static bool pending_slot_prev_valid;
static bool slot_committed;

static struct pawr_slot_config slot_config_buf;
static struct bt_gatt_discover_params discover_params;
static struct bt_gatt_write_params write_params;

static struct k_work_delayable disconnect_work;
static struct k_work_delayable scan_work;

static bool scanning_enabled;

static void start_scan_if_possible(void);
static void cleanup_pending_slot(bool keep_assigned_record);
static void scan_recv_cb(const struct bt_le_scan_recv_info *info,
		struct net_buf_simple *ad);

static struct bt_le_scan_cb scan_cb = {
	.recv = scan_recv_cb,
};

static int find_slot_for_addr(const bt_addr_le_t *addr)
{
	for (int i = 0; i < PAWR_MAX_RESPONSE_SLOTS; i++) {
		if (slot_table[i].valid && (bt_addr_le_cmp(addr, &slot_table[i].addr) == 0)) {
			return i;
		}
	}
	return -1;
}

static int find_available_slot(void)
{
	for (int i = 0; i < PAWR_MAX_RESPONSE_SLOTS; i++) {
		if (!slot_table[i].valid) {
			return i;
		}
	}
	for (int i = 0; i < PAWR_MAX_RESPONSE_SLOTS; i++) {
		if (!slot_table[i].in_use) {
			return i;
		}
	}
	return -1;
}

static void stop_scan(void)
{
	if (!scanning_enabled) {
		return;
	}

	int err = bt_le_scan_stop();
	if (err && err != -EALREADY) {
		printk("[SCAN] stop failed (err %d)\n", err);
	}
	scanning_enabled = false;
}

static void scan_work_handler(struct k_work *work)
{
	ARG_UNUSED(work);
	start_scan_if_possible();
}

static bool name_match_cb(struct bt_data *data, void *user_data)
{
	char *name = user_data;
	uint8_t len;

	switch (data->type) {
	case BT_DATA_NAME_SHORTENED:
	case BT_DATA_NAME_COMPLETE:
		len = MIN(data->data_len, NAME_BUF_LEN - 1U);
		memcpy(name, data->data, len);
		name[len] = '\0';
		return false;
	default:
		return true;
	}
}

static bool ad_matches_target(struct net_buf_simple *ad)
{
	char name[NAME_BUF_LEN];

	memset(name, 0, sizeof(name));
	bt_data_parse(ad, name_match_cb, name);

	return (strlen(name) > 0U) && (strcmp(name, TARGET_NAME) == 0);
}

static void scan_recv_cb(const struct bt_le_scan_recv_info *info,
		   struct net_buf_simple *ad)
{
	if (current_conn) {
		return;
	}

	if (!(info->adv_props & BT_GAP_ADV_PROP_CONNECTABLE)) {
		return;
	}

	if (!ad_matches_target(ad)) {
		return;
	}

	char addr_str[BT_ADDR_LE_STR_LEN];
	bt_addr_le_to_str(info->addr, addr_str, sizeof(addr_str));
	printk("[SCAN] found %s (SID %u)\n", addr_str, info->sid);

	stop_scan();

	int err = bt_conn_le_create(info->addr, BT_CONN_LE_CREATE_CONN,
					BT_LE_CONN_PARAM_DEFAULT, &current_conn);
	if (err) {
		printk("[SCAN] create conn failed (%d)\n", err);
		bt_addr_le_copy(&current_peer_addr, BT_ADDR_LE_ANY);
		k_work_reschedule(&scan_work, K_MSEC(SCAN_RETRY_DELAY_MS));
		return;
	}

	bt_addr_le_copy(&current_peer_addr, info->addr);
}

static void start_scan_if_possible(void)
{
	if (scanning_enabled || current_conn) {
		return;
	}

	int err = bt_le_scan_start(BT_LE_SCAN_PASSIVE_CONTINUOUS, NULL);
	if (err) {
		if (err != -EALREADY) {
			printk("[SCAN] start failed (%d)\n", err);
			k_work_reschedule(&scan_work, K_MSEC(SCAN_RETRY_DELAY_MS));
		}
		return;
	}

	scanning_enabled = true;
	printk("[SCAN] scanning for synchronizers\n");
}

static void disconnect_work_handler(struct k_work *work)
{
	ARG_UNUSED(work);
	if (current_conn) {
		int err = bt_conn_disconnect(current_conn, BT_HCI_ERR_REMOTE_USER_TERM_CONN);
		if (err && err != -ENOTCONN) {
			printk("[CONN] disconnect failed (err %d)\n", err);
		}
	}
}

static int begin_slot_assignment(struct bt_conn *conn)
{
	const bt_addr_le_t *addr = bt_conn_get_dst(conn);
	int slot = find_slot_for_addr(addr);
	bool new_mapping = false;

	if (slot < 0) {
		slot = find_available_slot();
		new_mapping = true;
	}

	if (slot < 0) {
		printk("[ONBOARD] No slots available for new device\n");
		return -ENOBUFS;
	}

	pending_slot = slot;
	pending_slot_prev_valid = slot_table[slot].valid;
	slot_committed = false;

	if (new_mapping || !slot_table[slot].valid) {
		bt_addr_le_copy(&slot_table[slot].addr, addr);
		slot_table[slot].valid = true;
	}
	slot_table[slot].in_use = false;

	slot_config_buf.subevent = PAWR_DEFAULT_SUBEVENT;
	slot_config_buf.response_slot = slot;
	slot_config_buf.payload_id = sys_cpu_to_le16(slot);
	slot_config_buf.total_slots = pawr_broadcaster_total_slots();

	int err = bt_le_per_adv_set_info_transfer(adv_ref, conn, slot);
	if (err) {
		printk("[ONBOARD] PAST send failed (%d)\n", err);
		return err;
	}

	discover_params.uuid = BT_UUID_PAWR_SLOT_CHAR;
	discover_params.func = NULL; /* will set below */
	discover_params.start_handle = BT_ATT_FIRST_ATTRIBUTE_HANDLE;
	discover_params.end_handle = BT_ATT_LAST_ATTRIBUTE_HANDLE;
	discover_params.type = BT_GATT_DISCOVER_CHARACTERISTIC;

	return 0;
}

static uint8_t discover_func(struct bt_conn *conn, const struct bt_gatt_attr *attr,
				struct bt_gatt_discover_params *params);
static void write_cb(struct bt_conn *conn, uint8_t err,
			   struct bt_gatt_write_params *params);

static int start_discovery(struct bt_conn *conn)
{
	discover_params.uuid = BT_UUID_PAWR_SLOT_CHAR;
	discover_params.func = discover_func;
	discover_params.start_handle = BT_ATT_FIRST_ATTRIBUTE_HANDLE;
	discover_params.end_handle = BT_ATT_LAST_ATTRIBUTE_HANDLE;
	discover_params.type = BT_GATT_DISCOVER_CHARACTERISTIC;

	int err = bt_gatt_discover(conn, &discover_params);
	if (err) {
		printk("[ONBOARD] discovery failed (%d)\n", err);
	}
	return err;
}

static uint8_t discover_func(struct bt_conn *conn, const struct bt_gatt_attr *attr,
				struct bt_gatt_discover_params *params)
{
	ARG_UNUSED(params);

	if (!attr) {
		printk("[ONBOARD] Slot characteristic not found\n");
		cleanup_pending_slot(false);
		k_work_reschedule(&disconnect_work, K_NO_WAIT);
		return BT_GATT_ITER_STOP;
	}

	printk("[GATT] Discover attr handle=0x%04x uuid=%s type=0x%04x len=%u\n",
		attr->handle,
		bt_uuid_str(attr->uuid),
		attr->uuid ? attr->uuid->type : 0,
		attr->read ? attr->read(conn, attr, NULL, 0, 0) : 0);

	struct bt_gatt_chrc *chrc = (struct bt_gatt_chrc *)attr->user_data;
	if (bt_uuid_cmp(chrc->uuid, BT_UUID_PAWR_SLOT_CHAR) != 0) {
		return BT_GATT_ITER_CONTINUE;
	}

	write_params.func = write_cb;
	write_params.handle = chrc->value_handle;
	write_params.offset = 0U;
	write_params.data = &slot_config_buf;
	write_params.length = sizeof(slot_config_buf);

	int err = bt_gatt_write(conn, &write_params);
	if (err) {
		printk("[ONBOARD] write start failed (%d)\n", err);
		cleanup_pending_slot(false);
		k_work_reschedule(&disconnect_work, K_NO_WAIT);
	}

	return BT_GATT_ITER_STOP;
}

static void write_cb(struct bt_conn *conn, uint8_t err,
			   struct bt_gatt_write_params *params)
{
	ARG_UNUSED(params);

	if (err) {
		printk("[ONBOARD] slot write failed (err %u)\n", err);
		cleanup_pending_slot(false);
		k_work_reschedule(&disconnect_work, K_NO_WAIT);
		return;
	}

	if (pending_slot >= PAWR_MAX_RESPONSE_SLOTS) {
		k_work_reschedule(&disconnect_work, K_NO_WAIT);
		return;
	}

	slot_table[pending_slot].in_use = true;
	slot_committed = true;
	pawr_broadcaster_set_slot_expected(pending_slot, true);

	char addr_str[BT_ADDR_LE_STR_LEN];
	bt_addr_le_to_str(&current_peer_addr, addr_str, sizeof(addr_str));
	printk("[ONBOARD] Assigned slot %u to %s\n", pending_slot, addr_str);

	k_work_reschedule(&disconnect_work, K_MSEC(30));
}

static void cleanup_pending_slot(bool keep_assigned_record)
{
	if (pending_slot >= PAWR_MAX_RESPONSE_SLOTS) {
		return;
	}

	if (!keep_assigned_record) {
		pawr_broadcaster_set_slot_expected(pending_slot, false);
		slot_table[pending_slot].in_use = false;
		if (!pending_slot_prev_valid) {
			slot_table[pending_slot].valid = false;
			bt_addr_le_copy(&slot_table[pending_slot].addr, BT_ADDR_LE_ANY);
		}
	}

	pending_slot = PAWR_MAX_RESPONSE_SLOTS;
	pending_slot_prev_valid = false;
	slot_committed = false;
}

static void connected_cb(struct bt_conn *conn, uint8_t err)
{
	char addr_str[BT_ADDR_LE_STR_LEN];
	bt_addr_le_to_str(bt_conn_get_dst(conn), addr_str, sizeof(addr_str));

	if (err) {
		printk("[CONN] Failed to connect to %s (0x%02X)\n", addr_str, err);
		if (conn == current_conn) {
			bt_conn_unref(current_conn);
			current_conn = NULL;
			k_work_reschedule(&scan_work, K_MSEC(SCAN_RETRY_DELAY_MS));
		}
		return;
	}

	printk("[CONN] Connected to %s\n", addr_str);

	struct bt_conn_le_phy_param phy_param = {
		.options = BT_CONN_LE_PHY_OPT_NONE,
		.pref_tx_phy = BT_GAP_LE_PHY_2M,
		.pref_rx_phy = BT_GAP_LE_PHY_2M,
	};

	int err_phy = bt_conn_le_phy_update(conn, &phy_param);
	if (err_phy) {
		printk("[CONN] PHY update request failed (%d)\n", err_phy);
	}
}

static void disconnected_cb(struct bt_conn *conn, uint8_t reason)
{
	char addr_str[BT_ADDR_LE_STR_LEN];
	bt_addr_le_to_str(bt_conn_get_dst(conn), addr_str, sizeof(addr_str));
	printk("[CONN] Disconnected from %s (0x%02X)\n", addr_str, reason);

	if (conn == current_conn) {
		bt_conn_unref(current_conn);
		current_conn = NULL;
	}

	k_work_cancel_delayable(&disconnect_work);

	cleanup_pending_slot(slot_committed);

	k_work_reschedule(&scan_work, K_MSEC(50));
}

static void remote_info_available_cb(struct bt_conn *conn,
				   struct bt_conn_remote_info *info)
{
	ARG_UNUSED(info);

	if (conn != current_conn) {
		return;
	}

	int err = begin_slot_assignment(conn);
	if (err) {
		cleanup_pending_slot(false);
		k_work_reschedule(&disconnect_work, K_NO_WAIT);
		return;
	}

	err = start_discovery(conn);
	if (err) {
		cleanup_pending_slot(false);
		k_work_reschedule(&disconnect_work, K_NO_WAIT);
	}
}

static struct bt_conn_cb conn_callbacks = {
	.connected = connected_cb,
	.disconnected = disconnected_cb,
	.remote_info_available = remote_info_available_cb,
};

int onboarding_manager_init(struct bt_le_ext_adv *pawr_adv)
{
	adv_ref = pawr_adv;
	k_work_init_delayable(&disconnect_work, disconnect_work_handler);
	k_work_init_delayable(&scan_work, scan_work_handler);
	bt_le_scan_cb_register(&scan_cb);
	bt_conn_cb_register(&conn_callbacks);
	memset(slot_table, 0, sizeof(slot_table));
	return 0;
}

void onboarding_manager_start(void)
{
	start_scan_if_possible();
}

void onboarding_manager_handle_slot_idle(uint8_t slot)
{
	if (slot >= PAWR_MAX_RESPONSE_SLOTS) {
		return;
	}

	if (!slot_table[slot].valid) {
		return;
	}

	printk("[ONBOARD] Slot %u idle, clearing assignment\n", slot);
	pawr_broadcaster_set_slot_expected(slot, false);
	slot_table[slot].in_use = false;
	slot_table[slot].valid = false;
	bt_addr_le_copy(&slot_table[slot].addr, BT_ADDR_LE_ANY);
	k_work_reschedule(&scan_work, K_MSEC(10));
}
```

## src/pawr_broadcaster.c
```c
#include <zephyr/bluetooth/bluetooth.h>
#include <zephyr/bluetooth/hci.h>
#include <zephyr/kernel.h>
#include <zephyr/sys/byteorder.h>
#include <zephyr/sys/printk.h>
#include <zephyr/sys/util.h>
#include <math.h>
#include <string.h>

#include "pawr_broadcaster.h"
#include "pawr_onboarding.h"
#include "onboarding_manager.h"

#define NUM_SUBEVENTS 1
#define PACKET_SIZE   251

#define MAX_INDIVIDUAL_RESPONSE_SIZE 247
#define THROUGHPUT_PRINT_INTERVAL 1000
#define SLOT_IDLE_THRESHOLD 4

#define ADV_NAME "PAwR adv sample"

static struct bt_le_ext_adv *adv_handle;

static struct bt_le_per_adv_param per_adv_params;
static struct bt_le_per_adv_subevent_data_params subevent_data_params[NUM_SUBEVENTS];
static struct net_buf_simple bufs[NUM_SUBEVENTS];
static uint8_t backing_store[NUM_SUBEVENTS][PACKET_SIZE];

BUILD_ASSERT(ARRAY_SIZE(bufs) == ARRAY_SIZE(subevent_data_params));
BUILD_ASSERT(ARRAY_SIZE(backing_store) == ARRAY_SIZE(subevent_data_params));

#define BITMAP_BYTES_NEEDED(num_devices) (((num_devices) + 7) / 8)

static uint8_t expected_responses[BITMAP_BYTES_NEEDED(PAWR_MAX_RESPONSE_SLOTS)];
static uint8_t response_bitmap[BITMAP_BYTES_NEEDED(PAWR_MAX_RESPONSE_SLOTS)];

static uint16_t g_num_rsp_slots_print;
static uint16_t g_payload_size_print;
static uint32_t g_adv_event_ms_x100_print;

static uint32_t total_interval_bytes;
static uint64_t throughput_timestamp;

static uint8_t noresp_counters[PAWR_MAX_RESPONSE_SLOTS];

static inline void bitmap_set_bit(uint8_t *bitmap, int bit)
{
	bitmap[bit / 8] |= (1U << (bit % 8));
}

static inline void bitmap_clear_bit(uint8_t *bitmap, int bit)
{
	bitmap[bit / 8] &= ~(1U << (bit % 8));
}

static inline bool bitmap_test_bit(const uint8_t *bitmap, int bit)
{
	return (bitmap[bit / 8] & (1U << (bit % 8))) != 0U;
}

static inline void bitmap_clear_all(uint8_t *bitmap, size_t num_bits)
{
	memset(bitmap, 0, BITMAP_BYTES_NEEDED(num_bits));
}

static void set_pawr_params(struct bt_le_per_adv_param *params, uint8_t num_response_slots)
{
	const uint16_t MIN_PAWR_INTERVAL_MS = 1;
	const float ADVERTISER_GUARD_MS = 1.0f;
	const uint8_t PHY_RATE_MBPS = 2;
	const uint16_t packet_size = MAX_INDIVIDUAL_RESPONSE_SIZE;

	const float tx_time_ms = (float)(packet_size * 8) / (PHY_RATE_MBPS * 1000.0f);
	const float slot_time_ms = tx_time_ms + 0.25f;
	uint16_t slot_spacing_units = (uint16_t)ceilf(slot_time_ms / 0.125f);
	const uint8_t delay_units = 3;

	const uint32_t subevent_duration_ms_x100 = (uint32_t)delay_units * 125U +
		(uint32_t)num_response_slots * ((uint32_t)slot_spacing_units * 125U / 10U);

	uint16_t subevent_interval_units = (uint16_t)((subevent_duration_ms_x100 + 125U - 1U) / 125U);
	if (subevent_interval_units < 6) {
		subevent_interval_units = 6;
	} else if (subevent_interval_units > 255) {
		subevent_interval_units = 255;
		printk("Warning: subevent too long for one window; consider fewer devices or smaller payload.\n");
	}

	const uint32_t total_event_time_ms_x100 = (uint32_t)delay_units * 125U +
		(uint32_t)num_response_slots * ((uint32_t)slot_spacing_units * 125U / 10U) +
		(uint32_t)(ADVERTISER_GUARD_MS * 100.0f);

	const uint16_t min_interval_units = (uint16_t)((MIN_PAWR_INTERVAL_MS + 1) / 1.25f);
	const uint16_t required_interval_units = (uint16_t)((total_event_time_ms_x100 + 125U - 1U) / 125U);
	uint16_t advertising_event_interval_units = (required_interval_units > min_interval_units)
		? required_interval_units
		: min_interval_units;

	if (advertising_event_interval_units < subevent_interval_units) {
		advertising_event_interval_units = subevent_interval_units;
	}

	params->interval_min = advertising_event_interval_units;
	params->interval_max = advertising_event_interval_units;
	params->options = 0;
	params->num_subevents = 1;
	params->subevent_interval = (uint8_t)subevent_interval_units;
	params->response_slot_delay = delay_units;
	params->response_slot_spacing = (uint8_t)slot_spacing_units;
	params->num_response_slots = num_response_slots;

	const uint32_t adv_event_ms_x100 = (uint32_t)advertising_event_interval_units * 125U;
	const uint32_t subevent_ms_x100 = (uint32_t)subevent_interval_units * 125U;
	const uint32_t slot_ms_x100 = (uint32_t)slot_spacing_units * 125U / 10U;
	const uint32_t est_throughput_kbps = (adv_event_ms_x100 > 0U) ?
		(uint32_t)(((uint64_t)num_response_slots * packet_size * 8ULL * 100000ULL) /
			 (uint64_t)adv_event_ms_x100) /
		1000U : 0U;

	g_num_rsp_slots_print = num_response_slots;
	g_payload_size_print = packet_size;
	g_adv_event_ms_x100_print = adv_event_ms_x100;

	printk("PAwR config (1 subevent):\n");
	printk("  Devices: %u, Resp size: %u B, Slot: %u.%02u ms\n",
		num_response_slots, packet_size, slot_ms_x100 / 100U, slot_ms_x100 % 100U);
	printk("  Delay: %u (%u.%02u ms), SubEvt: %u (%u.%02u ms), AdvInt: %u (%u.%02u ms)\n",
		delay_units, (uint32_t)delay_units * 125U / 100U, (uint32_t)delay_units * 125U % 100U,
		subevent_interval_units, subevent_ms_x100 / 100U, subevent_ms_x100 % 100U,
		advertising_event_interval_units, adv_event_ms_x100 / 100U, adv_event_ms_x100 % 100U);
	printk("  Est. uplink throughput (theoretical) ~%u kbps\n", (unsigned int)est_throughput_kbps);
}

static void init_bufs(void)
{
	for (size_t i = 0; i < ARRAY_SIZE(backing_store); i++) {
		net_buf_simple_init_with_data(&bufs[i], &backing_store[i],
				ARRAY_SIZE(backing_store[i]));
		net_buf_simple_reset(&bufs[i]);
		/* Add manufacturer specific data header */
		net_buf_simple_add_u8(&bufs[i], 3);
		net_buf_simple_add_u8(&bufs[i], BT_DATA_MANUFACTURER_DATA);
		net_buf_simple_add_le16(&bufs[i], 0x0059);
	}
}

static void request_cb(struct bt_le_ext_adv *adv,
	const struct bt_le_per_adv_data_request *request)
{
	uint8_t bitmap_bytes = BITMAP_BYTES_NEEDED(PAWR_MAX_RESPONSE_SLOTS);
	uint8_t retransmit_bitmap[BITMAP_BYTES_NEEDED(PAWR_MAX_RESPONSE_SLOTS)];

	if (!request) {
		printk("Error: NULL request received\n");
		return;
	}

	uint8_t to_send = MIN(request->count, ARRAY_SIZE(subevent_data_params));

	for (int i = 0; i < bitmap_bytes; i++) {
		retransmit_bitmap[i] = expected_responses[i] & (~response_bitmap[i]);
	}

	for (uint8_t slot = 0; slot < PAWR_MAX_RESPONSE_SLOTS; slot++) {
		bool expected = bitmap_test_bit(expected_responses, slot);
		bool got_response = bitmap_test_bit(response_bitmap, slot);
		if (expected && !got_response) {
			if (noresp_counters[slot] < 0xFF) {
				noresp_counters[slot]++;
			}
			if (noresp_counters[slot] >= SLOT_IDLE_THRESHOLD) {
				printk("Slot %u inactive, releasing\n", slot);
				bitmap_clear_bit(expected_responses, slot);
				onboarding_manager_handle_slot_idle(slot);
				noresp_counters[slot] = 0U;
			}
		} else if (got_response) {
			noresp_counters[slot] = 0U;
		}
	}

	bitmap_clear_all(response_bitmap, PAWR_MAX_RESPONSE_SLOTS);

	for (size_t i = 0; i < to_send; i++) {
		struct net_buf_simple *buf = &bufs[i];
		net_buf_simple_reset(buf);

		uint8_t *length_field = net_buf_simple_add(buf, 1);
		net_buf_simple_add_u8(buf, BT_DATA_MANUFACTURER_DATA);
		net_buf_simple_add_le16(buf, 0x0059);
		net_buf_simple_add_u8(buf, 0x01); /* version */
		net_buf_simple_add_u8(buf, PAWR_MAX_RESPONSE_SLOTS);

		net_buf_simple_add_u8(buf, bitmap_bytes);
		for (int j = 0; j < bitmap_bytes; j++) {
			net_buf_simple_add_u8(buf, expected_responses[j]);
		}

		net_buf_simple_add_u8(buf, bitmap_bytes);
		for (int j = 0; j < bitmap_bytes; j++) {
			net_buf_simple_add_u8(buf, retransmit_bitmap[j]);
		}

		*length_field = buf->len - 1U;

		subevent_data_params[i].subevent = request->start + i;
		subevent_data_params[i].response_slot_start = 0;
		subevent_data_params[i].response_slot_count = PAWR_MAX_RESPONSE_SLOTS;
		subevent_data_params[i].data = buf;
	}

	int err = bt_le_per_adv_set_subevent_data(adv, to_send, subevent_data_params);
	if (err) {
		printk("Failed to set subevent data (err %d)\n", err);
	}
}

static void response_cb(struct bt_le_ext_adv *adv,
	struct bt_le_per_adv_response_info *info,
	struct net_buf_simple *buf)
{
	ARG_UNUSED(adv);

	if (!buf) {
		printk("Empty response at slot %u\n", info->response_slot);
		return;
	}

	if (total_interval_bytes == 0U) {
		throughput_timestamp = k_uptime_get_32();
	}

	total_interval_bytes += buf->len;

	if (info->response_slot < PAWR_MAX_RESPONSE_SLOTS) {
		bitmap_set_bit(response_bitmap, info->response_slot);
	}

	if (k_uptime_get_32() - throughput_timestamp > THROUGHPUT_PRINT_INTERVAL) {
		int64_t delta = k_uptime_delta(&throughput_timestamp);
		uint64_t measured_kbps = (delta > 0) ?
			(((uint64_t)total_interval_bytes * 8ULL) / (uint64_t)delta) : 0ULL;
		printk("\n[PAwR] received %u bytes (%u KB) in %lld ms at %llu kbps\n",
			total_interval_bytes, total_interval_bytes / 1024U, delta, measured_kbps);

		if (g_adv_event_ms_x100_print > 0U && g_num_rsp_slots_print > 0U) {
			uint32_t theo_kbps = (uint32_t)(((uint64_t)g_num_rsp_slots_print *
				g_payload_size_print * 8ULL * 100000ULL) /
				(uint64_t)g_adv_event_ms_x100_print) / 1000U;
			uint32_t efficiency = (theo_kbps > 0U) ?
				(uint32_t)((measured_kbps * 100ULL) / theo_kbps) : 0U;
			printk("[PAwR] theoretical ~%u kbps; efficiency ~%u%% (N=%u, payload=%u, AdvInt=%u.%02u ms)\n",
				(unsigned int)theo_kbps, (unsigned int)efficiency,
				(unsigned int)g_num_rsp_slots_print,
				(unsigned int)g_payload_size_print,
				(unsigned int)(g_adv_event_ms_x100_print / 100U),
				(unsigned int)(g_adv_event_ms_x100_print % 100U));
		}
		total_interval_bytes = 0U;
	}
}

static const struct bt_le_ext_adv_cb adv_cb = {
	.pawr_data_request = request_cb,
	.pawr_response = response_cb,
};

static const struct bt_data ad[] = {
	BT_DATA_BYTES(BT_DATA_FLAGS, (BT_LE_AD_GENERAL | BT_LE_AD_NO_BREDR)),
	BT_DATA(BT_DATA_NAME_COMPLETE, ADV_NAME, sizeof(ADV_NAME) - 1),
};

int pawr_broadcaster_init(struct bt_le_ext_adv **out_adv)
{
	int err;

	init_bufs();
	set_pawr_params(&per_adv_params, PAWR_MAX_RESPONSE_SLOTS);

	err = bt_le_ext_adv_create(BT_LE_EXT_ADV_NCONN, &adv_cb, &adv_handle);
	if (err) {
		printk("Failed to create advertising set (err %d)\n", err);
		return err;
	}

	err = bt_le_ext_adv_set_data(adv_handle, ad, ARRAY_SIZE(ad), NULL, 0);
	if (err) {
		printk("Failed to set ext adv data (err %d)\n", err);
		return err;
	}

	err = bt_le_per_adv_set_param(adv_handle, &per_adv_params);
	if (err) {
		printk("Failed to set periodic advertising parameters (err %d)\n", err);
		return err;
	}

	err = bt_le_ext_adv_start(adv_handle, BT_LE_EXT_ADV_START_DEFAULT);
	if (err) {
		printk("Failed to start extended advertising (err %d)\n", err);
		return err;
	}

	err = bt_le_per_adv_start(adv_handle);
	if (err) {
		printk("Failed to enable periodic advertising (err %d)\n", err);
		return err;
	}

	bitmap_clear_all(expected_responses, PAWR_MAX_RESPONSE_SLOTS);
	bitmap_clear_all(response_bitmap, PAWR_MAX_RESPONSE_SLOTS);
	memset(noresp_counters, 0, sizeof(noresp_counters));
	total_interval_bytes = 0U;
	throughput_timestamp = k_uptime_get_32();

	if (out_adv) {
		*out_adv = adv_handle;
	}

	printk("PAwR advertiser started\n");
	return 0;
}

void pawr_broadcaster_set_slot_expected(uint8_t slot, bool expected)
{
	if (slot >= PAWR_MAX_RESPONSE_SLOTS) {
		return;
	}

	if (expected) {
		bitmap_set_bit(expected_responses, slot);
	} else {
		bitmap_clear_bit(expected_responses, slot);
		noresp_counters[slot] = 0U;
	}
}

uint8_t pawr_broadcaster_total_slots(void)
{
	return PAWR_MAX_RESPONSE_SLOTS;
}
```
