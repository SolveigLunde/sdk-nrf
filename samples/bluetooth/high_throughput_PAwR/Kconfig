## samples/bluetooth/high_throughput_PAwR/Kconfig
```kconfig
# Copyright (c) 2024 Nordic Semiconductor ASA
# SPDX-License-Identifier: Apache-2.0

source "Kconfig.zephyr"

rsource "periodic_adv_rsp/Kconfig" 
```

## samples/bluetooth/high_throughput_pawr_scan/periodic_adv_rsp/Kconfig
```kconfig
# Copyright (c) 2024 Nordic Semiconductor ASA
# SPDX-License-Identifier: Apache-2.0

mainmenu "Maximum Throughput Sample"

config MAX_THROUGHPUT
	bool "Maximum Throughput Sample Settings"
	default y
	help
		Enable configuration options for maximum throughput sample

config BT_MAX_THROUGHPUT_DEVICES
	int "Number of PAwR scanner devices"
	default 16
	range 1 255
	depends on MAX_THROUGHPUT
	help
		Number of scanner devices that will participate in the PAwR communication.
		This affects timing calculations.
		IMPORTANT: This value must match the NUM_SYNCHRONIZERS in run_devices.sh
		

source "Kconfig.zephyr" 
```

## samples/bluetooth/max_throughput/Kconfig.defconfig
```kconfig
# Copyright (c) 2024 Nordic Semiconductor ASA
# SPDX-License-Identifier: Apache-2.0

config MAX_THROUGHPUT
	bool "Maximum Throughput Sample Settings"
	default y
	help
		Enable configuration options for maximum throughput sample

config BT_MAX_THROUGHPUT_DEVICES
	int "Number of PAwR scanner devices"
	default 16
	range 1 255
	depends on MAX_THROUGHPUT
	help
		Number of scanner devices that will participate in the PAwR communication.
		This affects memory usage and timing calculations.

config BT_MAX_THROUGHPUT_PAWR_INTERVAL_MS
	int "PAwR advertising interval (ms)"
	default 150
	range 20 1000
	depends on MAX_THROUGHPUT
	help
		Interval between periodic advertising events in milliseconds.
		Lower values increase throughput but consume more power. 
```

## samples/bluetooth/max_throughput/periodic_adv_rsp/Kconfig
```kconfig
# Copyright (c) 2024 Nordic Semiconductor ASA
# SPDX-License-Identifier: Apache-2.0

mainmenu "Maximum Throughput Sample"

config MAX_THROUGHPUT
	bool "Maximum Throughput Sample Settings"
	default y
	help
		Enable configuration options for maximum throughput sample

config BT_MAX_THROUGHPUT_DEVICES
	int "Number of PAwR scanner devices"
	default 16
	range 1 255
	depends on MAX_THROUGHPUT
	help
		Number of scanner devices that will participate in the PAwR communication.
		This affects memory usage and timing calculations.
		IMPORTANT: This value must match the NUM_SYNCHRONIZERS in run_devices.sh
		
		Optimal configurations within 1650-byte buffer limit:
		- 16 devices × 102 bytes = 1632 bytes (98.9% efficiency)
		- 12 devices × 137 bytes = 1644 bytes (99.6% efficiency)
		- 8 devices × 206 bytes = 1648 bytes (99.9% efficiency)
		
		Higher device counts require smaller packet sizes to fit buffer constraints.

config BT_MAX_THROUGHPUT_PAWR_INTERVAL_MS
	int "PAwR advertising interval (ms)"
	default 150
	range 20 2000
	depends on MAX_THROUGHPUT
	help
		Interval between periodic advertising events in milliseconds.
		Lower values increase throughput but consume more power.
		
		Recommended intervals for optimal throughput:
		- 100ms: Higher throughput, more power consumption
		- 150ms: Good balance of throughput and power (RECOMMENDED)
		- 200ms: Lower power, reduced throughput

source "Kconfig.zephyr" 
```

## samples/bluetooth/max_throughput_working/periodic_adv_rsp/boards/nrf54l15bsim_nrf54l15_cpuapp.conf
```kconfig
# Basic Bluetooth configuration
CONFIG_BT=y
CONFIG_BT_PERIPHERAL=y
CONFIG_BT_OBSERVER=y
CONFIG_BT_BROADCASTER=y

# Extended Advertising features
CONFIG_BT_EXT_ADV=y
CONFIG_BT_PER_ADV=y
CONFIG_BT_PER_ADV_SYNC=y
CONFIG_BT_PER_ADV_RSP=y

# Connection settings
CONFIG_BT_MAX_CONN=1
CONFIG_BT_GATT_CLIENT=y
CONFIG_BT_REMOTE_INFO=y

# Host features
CONFIG_BT_DIS=y
CONFIG_BT_SMP=y
CONFIG_BT_DATA_LEN_UPDATE=y
CONFIG_BT_PHY_UPDATE=y

# Buffer configuration
CONFIG_BT_BUF_ACL_RX_SIZE=255
CONFIG_BT_BUF_ACL_TX_SIZE=251
CONFIG_BT_L2CAP_TX_MTU=247 
```

## samples/bluetooth/throughput_pawr/periodic_adv_rsp/Kconfig
```kconfig
# Copyright (c) 2025 Nordic Semiconductor ASA
# SPDX-License-Identifier: Apache-2.0

mainmenu "Throughput PAwR Sample"

config THROUGHPUT_PAWR
	bool "Throughput PAwR Sample Settings"
	default y
	help
		Enable configuration options for throughput PAwR sample

config BT_NUM_RSP_DEVICES
	int "Number of PAwR scanner devices"
	default 2
	range 1 255
	depends on THROUGHPUT_PAWR
	help
		Number of scanner devices that will participate in the PAwR communication.
		This affects timing calculations.
		
source "Kconfig.zephyr" 
```
