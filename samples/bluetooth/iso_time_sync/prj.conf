## CMakeLists.txt
```
#
# Copyright (c) 2024 Nordic Semiconductor
#
# SPDX-License-Identifier: LicenseRef-Nordic-5-Clause
#

cmake_minimum_required(VERSION 3.20.0)
find_package(Zephyr REQUIRED HINTS $ENV{ZEPHYR_BASE})
project(iso_time_sync)

target_include_directories(app PRIVATE include)
target_sources(app PRIVATE src/main.c src/timed_led_toggle.c)

if (CONFIG_BT_ISO_BROADCASTER)
    target_sources(app PRIVATE src/bis_transmitter.c)
endif()

if (CONFIG_BT_ISO_SYNC_RECEIVER)
    target_sources(app PRIVATE src/bis_receiver.c)
endif()

if (CONFIG_BT_ISO_CENTRAL)
    target_sources(app PRIVATE src/cis_central.c)
endif()

if (CONFIG_BT_ISO_PERIPHERAL)
    target_sources(app PRIVATE src/cis_peripheral.c)
endif()

if (CONFIG_BT_ISO_TX_BUF_COUNT)
    target_sources(app PRIVATE src/iso_tx.c)
endif()

if (CONFIG_BT_ISO_RX_BUF_COUNT)
    target_sources(app PRIVATE src/iso_rx.c)
endif()

if (CONFIG_SOC_COMPATIBLE_NRF52X)
    target_sources(app PRIVATE src/controller_time_nrf52.c)
elseif (CONFIG_SOC_COMPATIBLE_NRF5340_CPUAPP)
    target_sources(app PRIVATE src/controller_time_nrf53_app.c)
elseif (CONFIG_SOC_SERIES_NRF54LX OR CONFIG_SOC_SERIES_NRF54HX)
    target_sources(app PRIVATE src/controller_time_nrf54.c)
else()
    MESSAGE(FATAL_ERROR "Unsupported series")
endif()
```

## Kconfig
```
#
# Copyright (c) 2024 Nordic Semiconductor
#
# SPDX-License-Identifier: LicenseRef-Nordic-5-Clause
#

menu "Bluetooth ISO time sync sample"

config SDU_INTERVAL_US
	int "SDU interval to be used in microseconds"
	default 10000
	help
	  The SDU interval determines how often the button
	  value will be transmitted to the receiving devices.

config TIMED_LED_PRESENTATION_DELAY_US
	int "The delay of presenting the new value of the LED"
	default 5000
	help
	  The presentation delay of the LED represents the time
	  from the SDU synchronization reference until the value
	  is applied.
	  The application needs to ensure it can process the
	  received SDU within this amount of time.
	  The end-to-end latency will be at least the sum
	  of the configured transport latency and presentation delay

config LED_TOGGLE_IMMEDIATELY_ON_SEND_OR_RECEIVE
	bool "Enable immediate LED toggling upon sending or receiving data"
	help
	  Enable immediate toggling of LED2 when isochronous
	  data is sent or received. This allows for measurment
	  of the mimimum end-to-end latency.

endmenu

source "Kconfig.zephyr"
```

## Kconfig.sysbuild
```
#
# Copyright (c) 2023 Nordic Semiconductor
#
# SPDX-License-Identifier: LicenseRef-Nordic-5-Clause
#

source "share/sysbuild/Kconfig"

config NRF_DEFAULT_BLUETOOTH
	default y

config NETCORE_IPC_RADIO_BT_HCI_IPC
	default y
```

## sample.yaml
```
sample:
  description: Bluetooth ISO time sync sample
  name: Bluetooth ISO time sync
tests:
  sample.bluetooth.iso_time_sync:
    sysbuild: true
    build_only: true
    integration_platforms:
      - nrf52840dk/nrf52840
      - nrf52833dk/nrf52833
      - nrf5340dk/nrf5340/cpuapp
      - nrf54l15dk/nrf54l05/cpuapp
      - nrf54l15dk/nrf54l10/cpuapp
      - nrf54l15dk/nrf54l15/cpuapp
      - nrf54h20dk/nrf54h20/cpuapp
      - nrf54lm20pdk/nrf54lm20a/cpuapp
    platform_allow:
      - nrf52840dk/nrf52840
      - nrf52833dk/nrf52833
      - nrf5340dk/nrf5340/cpuapp
      - nrf54l15dk/nrf54l05/cpuapp
      - nrf54l15dk/nrf54l10/cpuapp
      - nrf54l15dk/nrf54l15/cpuapp
      - nrf54h20dk/nrf54h20/cpuapp
      - nrf54lm20pdk/nrf54lm20a/cpuapp
    tags:
      - bluetooth
      - ci_build
      - sysbuild
```

## prj.conf
```kconfig
CONFIG_NCS_SAMPLES_DEFAULTS=y

CONFIG_BT=y
CONFIG_BT_ISO_BROADCASTER=y
CONFIG_BT_ISO_SYNC_RECEIVER=y
CONFIG_BT_ISO_CENTRAL=y
CONFIG_BT_ISO_PERIPHERAL=y
CONFIG_BT_OBSERVER=y
CONFIG_BT_CENTRAL=y
CONFIG_BT_PERIPHERAL=y
CONFIG_BT_DEVICE_NAME="Nordic_ISO"

CONFIG_BT_MAX_CONN=5
CONFIG_BT_CTLR_SDC_PERIPHERAL_COUNT=1

CONFIG_BT_ISO_MAX_CHAN=4
CONFIG_BT_ISO_TX_BUF_COUNT=4
CONFIG_BT_CTLR_SDC_ISO_TX_HCI_BUFFER_COUNT=4
CONFIG_BT_CTLR_ADV_ISO_STREAM_COUNT=4
CONFIG_BT_CTLR_SYNC_ISO_STREAM_COUNT=4
CONFIG_BT_CTLR_CONN_ISO_STREAMS=4

CONFIG_BT_ISO_TX_MTU=6
CONFIG_BT_ISO_RX_MTU=23

CONFIG_NRFX_GPPI=y

CONFIG_CONSOLE=y
CONFIG_CONSOLE_SUBSYS=y
CONFIG_CONSOLE_HANDLER=y
CONFIG_CONSOLE_GETCHAR=y
```

## boards/nrf52840dk_nrf52840.conf
```kconfig
#
# Copyright (c) 2024 Nordic Semiconductor
#
# SPDX-License-Identifier: LicenseRef-Nordic-5-Clause
#

CONFIG_NRFX_TIMER1=y
CONFIG_NRFX_RTC2=y
CONFIG_NRFX_PPI=y
```

## boards/nrf5340dk_nrf5340_cpuapp.conf
```kconfig
#
# Copyright (c) 2024 Nordic Semiconductor
#
# SPDX-License-Identifier: LicenseRef-Nordic-5-Clause
#

CONFIG_NRFX_TIMER0=y
CONFIG_NRFX_RTC0=y
CONFIG_NRFX_GPPI=y
```

## boards/nrf54l15dk_nrf54l05_cpuapp.conf
```kconfig
#
# Copyright (c) 2024 Nordic Semiconductor
#
# SPDX-License-Identifier: LicenseRef-Nordic-5-Clause
#

CONFIG_NRFX_GPPI=y
CONFIG_BT_RX_STACK_SIZE=2048
```

## src/main.c
```c
/*
 * Copyright (c) 2024 Nordic Semiconductor ASA
 *
 * SPDX-License-Identifier: LicenseRef-Nordic-5-Clause
 */

#include <stdlib.h>
#include <ctype.h>
#include <zephyr/kernel.h>
#include <zephyr/bluetooth/bluetooth.h>
#include <zephyr/console/console.h>
#include "iso_time_sync.h"

enum role {
	CIS_CENTRAL = 'c',
	CIS_PERIPHERAL = 'p',
	BIS_TRANSMIT = 'b',
	BIS_RECEIVER = 'r',
};

enum direction {
	DIR_TX = 't',
	DIR_RX = 'r'
};

#define CONSOLE_INTEGER_INVALID 0xFFFFFFFFU

static enum role role_select(void)
{
	enum role role;

	while (true) {
		printk("Choose role - cis_central (c) / cis_peripheral (p) / bis_transmitter (b) / "
		       "bis_receiver (r) : ");
		role = console_getchar();
		printk("%c\n", role);

		switch (role) {
		case CIS_CENTRAL:
		case CIS_PERIPHERAL:
		case BIS_TRANSMIT:
		case BIS_RECEIVER:
			return role;
		default:
			printk("Invalid role selected\n");
		}
	}
}

static enum direction direction_select(void)
{
	enum direction direction;

	while (true) {
		printk("Choose direction - TX (t) / RX (r) : ");
		direction = console_getchar();
		printk("%c\n", direction);

		switch (direction) {
		case DIR_TX:
		case DIR_RX:
			return direction;
		default:
			printk("Invalid direction selected\n");
			break;
		}
	}
}

static size_t get_chars(char *buffer, size_t max_size)
{
	size_t pos = 0;

	while (pos < max_size) {
		char c = tolower(console_getchar());

		if (c == '\n' || c == '\r') {
			break;
		}
		printk("%c", c);
		buffer[pos++] = c;
	}
	printk("\n");
	buffer[pos] = '\0';

	return pos;
}

static uint32_t console_integer_get(void)
{
	char buffer[9];
	size_t char_count;

	char_count = get_chars(buffer, sizeof(buffer) - 1);
	if (char_count == 0) {
		return CONSOLE_INTEGER_INVALID;
	}

	return strtoul(buffer, NULL, 0);
}

static uint8_t bis_index_select(void)
{
	uint32_t index;

	while (true) {
		printk("Choose bis index [1..31] : ");

		index = console_integer_get();

		if (index == CONSOLE_INTEGER_INVALID) {
			/* Use default of 1. */
			return 1;
		} else if (index >= 1 && index <= 31) {
			return index;
		}

		printk("Invalid index\n");
	}
}

static uint8_t sdu_retransmission_number_get(void)
{
	uint32_t retransmission_number;

	while (true) {
		printk("Choose retransmission number [0..30] : ");

		retransmission_number = console_integer_get();

		if (retransmission_number == CONSOLE_INTEGER_INVALID) {
			/* Use default of 1. */
			return 1;
		} else if (retransmission_number <= 30) {
			return retransmission_number;
		}

		printk("Invalid retransmission number\n");
	}
}

static uint8_t sdu_max_transport_latency_get(void)
{
	uint32_t max_transport_latency_ms;

	while (true) {
		printk("Choose max transport latency in ms [5..4000] : ");

		max_transport_latency_ms = console_integer_get();

		if (max_transport_latency_ms == CONSOLE_INTEGER_INVALID) {
			/* Use default of 10. */
			return 10;
		} else if (max_transport_latency_ms >= 5 && max_transport_latency_ms <= 4000) {
			return max_transport_latency_ms;
		}

		printk("Invalid latency\n");
	}
}

int main(void)
{
	int err;
	enum role role;
	enum direction direction;
	uint8_t retransmission_number;
	uint16_t max_transport_latency_ms;

	console_init();

	printk("Bluetooth ISO Time Sync Demo\n");

	err = timed_led_toggle_init();
	if (err != 0) {
		printk("Error failed to init LED device for toggling\n");
		return err;
	}

	/* Initialize the Bluetooth Subsystem */
	err = bt_enable(NULL);
	if (err) {
		printk("Bluetooth init failed (err %d)\n", err);
		return 0;
	}

	role = role_select();
	if (role == BIS_TRANSMIT) {
		retransmission_number = sdu_retransmission_number_get();
		max_transport_latency_ms = sdu_max_transport_latency_get();

		printk("Starting BIS transmitter with BIS indices [1..%d], RTN: %d, max transport latency %d ms\n",
			CONFIG_BT_ISO_MAX_CHAN, retransmission_number, max_transport_latency_ms);
		bis_transmitter_start(retransmission_number, max_transport_latency_ms);
	} else if (role == BIS_RECEIVER) {
		uint8_t index = bis_index_select();

		printk("Starting BIS receiver, BIS index %d\n", index);
		bis_receiver_start(index);
	} else {
		direction = direction_select();

		if (role == CIS_CENTRAL) {
			retransmission_number = sdu_retransmission_number_get();
			max_transport_latency_ms = sdu_max_transport_latency_get();

			printk("Starting CIS central, dir: %s, RTN: %d, max transport latency %d ms\n",
			       direction == DIR_TX ? "tx" : "rx",
			       retransmission_number, max_transport_latency_ms);
			cis_central_start(direction == DIR_TX,
					  retransmission_number, max_transport_latency_ms);
		} else {
			printk("Starting CIS peripheral, dir: %s\n",
			       direction == DIR_TX ? "tx" : "rx");
			cis_peripheral_start(direction == DIR_TX);
		}
	}

	return 0;
}
```

## include/iso_time_sync.h
```c
/*
 * Copyright (c) 2024 Nordic Semiconductor ASA
 *
 * SPDX-License-Identifier: LicenseRef-Nordic-5-Clause
 */

#ifndef ISO_TIME_SYNC_H__
#define ISO_TIME_SYNC_H__

/** Definitions for the ISO time sync sample.
 *
 * This file contains common definitions and API declarations
 * used by the sample.
 */

#include <stdint.h>
#include <stdbool.h>
#include <zephyr/bluetooth/iso.h>

#define SDU_SIZE_BYTES 5 /* SDU = [btn_val, 4 byte sdu_counter]*/

/** Start BIS transmitter demo.
 *
 * @param retransmission_number    Requested retransmission number.
 * @param max_transport_latency_ms Requested maximum transport latency.
 */
void bis_transmitter_start(uint8_t retransmission_number, uint16_t max_transport_latency_ms);

/** Start BIS receiver demo.
 *
 * @param bis_index_to_sync_to BIS index that it will sync to.
 */
void bis_receiver_start(uint8_t bis_index_to_sync_to);

/** Start CIS central demo.
 *
 * @param do_tx Set to true to send SDUs, otherwise it will receive.
 * @param retransmission_number    Requested retransmission number.
 * @param max_transport_latency_ms Requested maximum transport latency.
 */
void cis_central_start(bool do_tx,
		       uint8_t retransmission_number,
		       uint16_t max_transport_latency_ms);

/** Start CIS peripheral demo.
 *
 * @param do_tx Set to true to send SDUs, otherwise it will receive.
 */
void cis_peripheral_start(bool do_tx);

/** Initialize TX path channels.
 *
 * @param retransmission_number Requested retransmission number (if central or broadcaster).
 * @param iso_connected_cb Callback that is triggered when the ISO channel connects.
 *						   This can be set to NULL.
 */
void iso_tx_init(uint8_t retransmission_number, void (*iso_connected_cb)(void));

/** Initialize RX path channel.
 *
 * @param retransmission_number Requested retransmission number (if central).
 * @param Callback that is triggered when an ISO RX channel disconnects.
 *                 This can be set to NULL.
 */
void iso_rx_init(uint8_t retransmission_number, void (*iso_disconnected_cb)(void));

/** Obtain pointer to TX channels.
 *
 * @retval Pointer to the TX channels.
 */
struct bt_iso_chan **iso_tx_channels_get(void);

/** Obtain pointer to RX channels.
 *
 * @retval Pointer to the RX channels.
 */
struct bt_iso_chan **iso_rx_channels_get(void);

/** Print info ISO channel information.
 *
 * @param info ISO channel info.
 * @param role The role of the ISO channel.
 */
void iso_chan_info_print(struct bt_iso_info *info, uint8_t role);

/** Obtain the current Bluetooth controller time.
 *
 * The ISO timestamps are based upon this clock.
 *
 * @retval The current controller time.
 */
uint64_t controller_time_us_get(void);

/** Sets the controller to trigger a PPI event at the given timestamp.
 *
 * @param timestamp_us The timestamp where it will trigger.
 */
void controller_time_trigger_set(uint64_t timestamp_us);

/** Get the address of the event that will trigger.
 *
 * @retval The address of the event that will trigger.
 */
uint32_t controller_time_trigger_event_addr_get(void);

/** Initialize the module handling timed toggling of an LED.
 *
 * @retval 0 on success, failure otherwise.
 */
int timed_led_toggle_init(void);

/** Toggle the led to the give value at the given timestamp.
 *
 * @param value The LED value.
 * @param timestamp_us The time when the led will be set.
 *                     The time is specified in controller clock units.
 */
void timed_led_toggle_trigger_at(uint8_t value, uint32_t timestamp_us);

#endif
```

## src/bis_receiver.c
```c
/*
 * Copyright (c) 2024 Nordic Semiconductor ASA
 *
 * SPDX-License-Identifier: LicenseRef-Nordic-5-Clause
 */

/** BIS receiver implementation for the time sync sample
 *
 * This file implements a device that syncs to a given BIS index.
 * When disconnected, it tries to sync to it again.
 */

#include <zephyr/kernel.h>
#include <zephyr/bluetooth/bluetooth.h>
#include <zephyr/bluetooth/iso.h>
#include <zephyr/device.h>
#include <zephyr/drivers/gpio.h>
#include <sdc_hci_vs.h>
#include <sdc_hci.h>
#include "iso_time_sync.h"

#define ADV_NAME_STR_MAX_LEN (sizeof(CONFIG_BT_DEVICE_NAME))

static K_SEM_DEFINE(sem_per_adv_info_valid, 0, 1);
static K_SEM_DEFINE(sem_big_info_valid, 0, 1);
static K_SEM_DEFINE(sem_per_adv_sync_lost, 0, 1);

static bool syncing_or_synced_to_periodic_adv;
static bool syncing_or_synced_to_big;

static bt_addr_le_t adv_addr;
static uint8_t adv_set_id;

static bool adv_data_parse_cb(struct bt_data *data, void *user_data)
{
	char *name = user_data;
	uint8_t len;

	switch (data->type) {
	case BT_DATA_NAME_SHORTENED:
	case BT_DATA_NAME_COMPLETE:
		len = MIN(data->data_len, ADV_NAME_STR_MAX_LEN - 1);
		memcpy(name, data->data, len);
		name[len] = '\0';
		return false;
	default:
		return true;
	}
}

static void scan_recv(const struct bt_le_scan_recv_info *info, struct net_buf_simple *buf)
{
	char name_str[ADV_NAME_STR_MAX_LEN] = {0};

	bt_data_parse(buf, adv_data_parse_cb, name_str);

	if (strncmp(name_str, CONFIG_BT_DEVICE_NAME, ADV_NAME_STR_MAX_LEN) != 0) {
		return;
	}

	if (!syncing_or_synced_to_periodic_adv) {
		bt_addr_le_copy(&adv_addr, info->addr);
		adv_set_id = info->sid;

		syncing_or_synced_to_periodic_adv = true;
		k_sem_give(&sem_per_adv_info_valid);
	}
}

static void synced_to_per_adv_cb(struct bt_le_per_adv_sync *sync,
				 struct bt_le_per_adv_sync_synced_info *info)
{
	printk("Synced to periodic advertiser\n");
}

static void sync_to_per_adv_lost_cb(struct bt_le_per_adv_sync *sync,
				    const struct bt_le_per_adv_sync_term_info *info)
{
	printk("Sync to periodic advertiser lost\n");
	k_sem_give(&sem_per_adv_sync_lost);
}

static void biginfo_rcvd_cb(struct bt_le_per_adv_sync *sync, const struct bt_iso_biginfo *biginfo)
{
	if (!syncing_or_synced_to_big) {
		printk("BigInfo received\n");
		syncing_or_synced_to_big = true;
		k_sem_give(&sem_big_info_valid);
	}
}

static struct bt_le_scan_cb scan_callbacks = {
	.recv = scan_recv,
};

static struct bt_le_per_adv_sync_cb sync_callbacks = {
	.synced = synced_to_per_adv_cb,
	.term = sync_to_per_adv_lost_cb,
	.biginfo = biginfo_rcvd_cb,
};

static void reset_state(void)
{
	k_sem_reset(&sem_per_adv_info_valid);
	k_sem_reset(&sem_big_info_valid);
	k_sem_reset(&sem_per_adv_sync_lost);
	syncing_or_synced_to_periodic_adv = false;
	syncing_or_synced_to_big = false;
}

void bis_receiver_start(uint8_t bis_index_to_sync_to)
{
	struct bt_le_per_adv_sync_param sync_create_param;
	struct bt_iso_big_sync_param big_sync_param;
	struct bt_le_per_adv_sync *sync;
	struct bt_iso_big *big;
	int err;

	uint8_t unused_rtn = 0;

	iso_rx_init(unused_rtn, NULL);

	bt_le_scan_cb_register(&scan_callbacks);
	bt_le_per_adv_sync_cb_register(&sync_callbacks);

	err = bt_le_scan_start(BT_LE_SCAN_PASSIVE_CONTINUOUS, NULL);
	if (err) {
		printk("Scan start failed (err %d)\n", err);
		return;
	}

	while (true) {
		reset_state();

		printk("Scanning for periodic advertiser\n");
		k_sem_take(&sem_per_adv_info_valid, K_FOREVER);

		syncing_or_synced_to_periodic_adv = true;

		memset(&sync_create_param, 0, sizeof(sync_create_param));
		bt_addr_le_copy(&sync_create_param.addr, &adv_addr);
		sync_create_param.options = 0;
		sync_create_param.sid = adv_set_id;
		sync_create_param.skip = 0;
		sync_create_param.timeout = 1000;

		err = bt_le_per_adv_sync_create(&sync_create_param, &sync);
		if (err) {
			printk("Sync create failed (err %d)\n", err);
			return;
		}

		printk("Waiting for BigInfo\n");
		err = k_sem_take(&sem_big_info_valid, K_MSEC(5000));
		if (err) {
			printk("Failed obtaining BigInfo in time, starting over\n");

			err = bt_le_per_adv_sync_delete(sync);
			if (err) {
				printk("Deleting periodic sync failed (err %d)\n", err);
				return;
			}

			continue;
		}

		memset(&big_sync_param, 0, sizeof(big_sync_param));
		big_sync_param.bis_channels = iso_rx_channels_get();
		big_sync_param.num_bis = 1;
		big_sync_param.bis_bitfield = BIT(bis_index_to_sync_to - 1);
		big_sync_param.mse = BT_ISO_SYNC_MSE_ANY;
		big_sync_param.sync_timeout = 100; /* in 10 ms units */

		printk("Syncing to BIG index %d\n", bis_index_to_sync_to);
		err = bt_iso_big_sync(sync, &big_sync_param, &big);
		if (err) {
			printk("Creating BIG sync failed (err %d)\n", err);
			return;
		}

		k_sem_take(&sem_per_adv_sync_lost, K_FOREVER);

		err = bt_le_per_adv_sync_delete(sync);
		if (err) {
			printk("Deleting periodic sync failed (err %d)\n", err);
			return;
		}
	}
}
```

## src/bis_transmitter.c
```c
/*
 * Copyright (c) 2024 Nordic Semiconductor ASA
 *
 * SPDX-License-Identifier: LicenseRef-Nordic-5-Clause
 */

/** BIS transmitter implementation for the time sync sample
 *
 * This file implements a device that sets up a BIS transmitter
 * with a configured number of streams.
 */

#include <zephyr/kernel.h>
#include <zephyr/bluetooth/bluetooth.h>
#include <zephyr/bluetooth/iso.h>

#include "iso_time_sync.h"

static const struct bt_data ad[] = {
	BT_DATA(BT_DATA_NAME_COMPLETE, CONFIG_BT_DEVICE_NAME, sizeof(CONFIG_BT_DEVICE_NAME) - 1),
};

void bis_transmitter_start(uint8_t retransmission_number, uint16_t max_transport_latency_ms)
{
	int err;
	struct bt_le_ext_adv *adv;
	struct bt_iso_big *big;

	iso_tx_init(retransmission_number, NULL);

	/* Create a non-connectable non-scannable advertising set */
	err = bt_le_ext_adv_create(BT_LE_EXT_ADV_NCONN, NULL, &adv);
	if (err) {
		printk("Failed to create advertising set (err %d)\n", err);
		return;
	}

	/* Set the advertising data */
	err = bt_le_ext_adv_set_data(adv, ad, ARRAY_SIZE(ad), NULL, 0);
	if (err) {
		printk("failed to set advertising data (err %d)\n", err);
		return;
	}

	/* Set periodic advertising parameters */
	err = bt_le_per_adv_set_param(adv, BT_LE_PER_ADV_PARAM(BT_GAP_PER_ADV_FAST_INT_MIN_2,
							       BT_GAP_PER_ADV_FAST_INT_MAX_2,
							       BT_LE_PER_ADV_OPT_NONE));
	if (err) {
		printk("Failed to set periodic advertising parameters"
		       " (err %d)\n",
		       err);
		return;
	}

	/* Start extended advertising */
	err = bt_le_ext_adv_start(adv, BT_LE_EXT_ADV_START_DEFAULT);
	if (err) {
		printk("Failed to start extended advertising (err %d)\n", err);
		return;
	}

	/* Enable Periodic Advertising */
	err = bt_le_per_adv_start(adv);
	if (err) {
		printk("Failed to enable periodic advertising (err %d)\n", err);
		return;
	}

	struct bt_iso_big_create_param big_create_param = {
		.num_bis = CONFIG_BT_ISO_MAX_CHAN,
		.bis_channels = iso_tx_channels_get(),
		.interval = CONFIG_SDU_INTERVAL_US,
		.latency = max_transport_latency_ms,
		.packing = 0, /* 0 - sequential, 1 - interleaved */
		.framing = 0, /* 0 - unframed, 1 - framed */
	};

	/* Create BIG */
	err = bt_iso_big_create(adv, &big_create_param, &big);
	if (err) {
		printk("Failed to create BIG (err %d)\n", err);
		return;
	}

	printk("BIS transmitter started\n");
}
```

## src/cis_central.c
```c
/*
 * Copyright (c) 2024 Nordic Semiconductor ASA
 *
 * SPDX-License-Identifier: LicenseRef-Nordic-5-Clause
 */

/** CIS central implementation for the time sync sample
 *
 * This file implements a device that acts as a CIS central.
 * The central can either be configured as a transmitter or a receiver.
 *
 * It connects to as many peripherals as it has available ISO channels.
 */

#include <zephyr/kernel.h>
#include <zephyr/bluetooth/bluetooth.h>
#include <zephyr/bluetooth/conn.h>
#include <zephyr/bluetooth/iso.h>
#include <zephyr/bluetooth/hci.h>

#include "iso_time_sync.h"

#define ADV_NAME_STR_MAX_LEN (sizeof(CONFIG_BT_DEVICE_NAME))

static bool configured_for_tx;

static K_SEM_DEFINE(sem_connected, 0, 1);

static void scan_start(void);

static struct bt_iso_chan *free_iso_chan_find(void)
{
	const size_t max_channels = configured_for_tx ? CONFIG_BT_ISO_MAX_CHAN : 1;

	struct bt_iso_chan **iso_channels;

	if (configured_for_tx) {
		iso_channels = iso_tx_channels_get();
	} else {
		iso_channels = iso_rx_channels_get();
	}

	struct bt_iso_chan *iso_chan = NULL;

	for (size_t i = 0; i < max_channels; i++) {
		if (iso_channels[i]->state == BT_ISO_STATE_DISCONNECTED) {
			iso_chan = iso_channels[i];
			break;
		}
	}

	return iso_chan;
}

static bool adv_data_parse_cb(struct bt_data *data, void *user_data)
{
	char *name = user_data;
	uint8_t len;

	switch (data->type) {
	case BT_DATA_NAME_SHORTENED:
	case BT_DATA_NAME_COMPLETE:
		len = MIN(data->data_len, ADV_NAME_STR_MAX_LEN - 1);
		memcpy(name, data->data, len);
		name[len] = '\0';
		return false;
	default:
		return true;
	}
}

static void scan_recv(const struct bt_le_scan_recv_info *info, struct net_buf_simple *buf)
{
	char name_str[ADV_NAME_STR_MAX_LEN] = {0};

	bt_data_parse(buf, adv_data_parse_cb, name_str);

	if (strncmp(name_str, CONFIG_BT_DEVICE_NAME, ADV_NAME_STR_MAX_LEN) != 0) {
		return;
	}

	if (bt_le_scan_stop()) {
		return;
	}

	struct bt_conn *conn = NULL;
	int err = bt_conn_le_create(info->addr, BT_CONN_LE_CREATE_CONN, BT_LE_CONN_PARAM_DEFAULT,
				    &conn);
	if (err) {
		printk("Create conn to %s failed (%d)\n", name_str, err);
	} else {
		bt_conn_unref(conn);
	}
}

static struct bt_le_scan_cb scan_callbacks = {
	.recv = scan_recv,
};

static void scan_start(void)
{
	int err;

	if (free_iso_chan_find()) {
		err = bt_le_scan_start(BT_LE_SCAN_ACTIVE_CONTINUOUS, NULL);
		if (err == -EALREADY) {
			/** If the central is RXing, both the ISO and the ACL
			 * disconnection callbacks try to enable the scanner.
			 * If the ISO channel disconnects before the ACL
			 * connection, the application will attempt to enable
			 * the scanner again.
			 */
			printk("Scanning did not start because it has already started (err %d)\n",
				   err);
		} else if (err) {
			printk("Scanning failed to start (err %d)\n", err);
			return;
		}

		printk("CIS Central started scanning\n");
	}
}

static void connected(struct bt_conn *conn, uint8_t err)
{
	char addr[BT_ADDR_LE_STR_LEN];

	bt_addr_le_to_str(bt_conn_get_dst(conn), addr, sizeof(addr));

	if (err) {
		printk("Failed to connect to %s 0x%02x %s\n", addr, err, bt_hci_err_to_str(err));

		scan_start();
		return;
	}

	printk("Connected: %s\n", addr);

	/* Find a free ISO channel */
	struct bt_iso_chan *iso_chan = free_iso_chan_find();

	if (iso_chan == NULL) {
		printk("No ISO channel available\n");
		return;
	}

	struct bt_iso_connect_param connect_param;

	connect_param.acl = conn;
	connect_param.iso_chan = iso_chan;

	err = bt_iso_chan_connect(&connect_param, 1);
	if (err) {
		printk("Failed to connect iso (%d)\n", err);
		return;
	}
	printk("Connecting ISO channel\n");
}

static void disconnected(struct bt_conn *conn, uint8_t reason)
{
	char addr[BT_ADDR_LE_STR_LEN];

	bt_addr_le_to_str(bt_conn_get_dst(conn), addr, sizeof(addr));

	printk("Disconnected: %s, reason 0x%02x %s\n", addr, reason, bt_hci_err_to_str(reason));

	scan_start();
}

static struct bt_conn_cb conn_callbacks = {
	.connected = connected,
	.disconnected = disconnected,
};

void cis_central_start(bool do_tx, uint8_t retransmission_number, uint16_t max_transport_latency_ms)
{
	struct bt_iso_cig_param param;
	struct bt_iso_cig *cig;
	int err;

	configured_for_tx = do_tx;
	if (do_tx) {
		/** scan_start is registered as a callback that is triggered when an
		 * ISO channel connects to avoid a situation where the
		 * LE HCI Create CIS command is called while there is a pending CIS
		 * connection. The CIS central starts scanning for a new connection only after a
		 * pending CIS connection has completed. This must be done because the
		 * LE HCI Create CIS command is disallowed while a CIS connection is
		 * pending. See Bluetooth Core Specification, Vol 6, Part B, Section 7.8.99.
		 */
		iso_tx_init(retransmission_number, &scan_start);
	} else {
		/** scan_start is registered as a callback that is triggered when an
		 * ISO channel disconnects. This is needed because the ISO channel might
		 * disconnect after the ACL has completed its disconnection callback. If
		 * this is the case, there are no RX ISO channels available during the
		 * ACL disconnection callback, which will prevent scanning from starting.
		 */
		iso_rx_init(retransmission_number, &scan_start);
	}

	bt_le_scan_cb_register(&scan_callbacks);
	bt_conn_cb_register(&conn_callbacks);

	memset(&param, 0, sizeof(param));
	param.cis_channels = do_tx ? iso_tx_channels_get() : iso_rx_channels_get();
	param.num_cis = do_tx ? CONFIG_BT_ISO_MAX_CHAN : 1;
	param.sca = BT_GAP_SCA_UNKNOWN;
	param.packing = 0;
	param.framing = 0;
	param.c_to_p_latency = max_transport_latency_ms;
	param.p_to_c_latency = max_transport_latency_ms;
	param.c_to_p_interval = CONFIG_SDU_INTERVAL_US;
	param.p_to_c_interval = CONFIG_SDU_INTERVAL_US;

	err = bt_iso_cig_create(&param, &cig);
	if (err != 0) {
		printk("Failed to create CIG (%d)\n", err);
		return;
	}

	scan_start();

	printk("CIS central started scanning for peripheral(s)\n");
}
```

## src/cis_peripheral.c
```c
/*
 * Copyright (c) 2024 Nordic Semiconductor ASA
 *
 * SPDX-License-Identifier: LicenseRef-Nordic-5-Clause
 */

/** CIS peripheral implementation for the time sync sample
 *
 * This file implements a device that acts as a CIS peripheral.
 * The peripheral can either be configured as a transmitter or a receiver.
 */

#include <zephyr/kernel.h>
#include <zephyr/bluetooth/bluetooth.h>
#include <zephyr/bluetooth/conn.h>
#include <zephyr/bluetooth/iso.h>
#include <zephyr/bluetooth/hci.h>

#include "iso_time_sync.h"

static bool configured_for_tx;

static const struct bt_data ad[] = {
	BT_DATA(BT_DATA_NAME_COMPLETE, CONFIG_BT_DEVICE_NAME, sizeof(CONFIG_BT_DEVICE_NAME) - 1),
};

static void connected(struct bt_conn *conn, uint8_t err)
{
	char addr[BT_ADDR_LE_STR_LEN];

	bt_addr_le_to_str(bt_conn_get_dst(conn), addr, sizeof(addr));

	if (err) {
		printk("Failed to connect to %s 0x%02x %s\n", addr, err, bt_hci_err_to_str(err));
		return;
	}

	printk("Connected: %s\n", addr);
}

static void disconnected(struct bt_conn *conn, uint8_t reason)
{
	char addr[BT_ADDR_LE_STR_LEN];

	bt_addr_le_to_str(bt_conn_get_dst(conn), addr, sizeof(addr));

	printk("Disconnected from %s, reason 0x%02x %s\n", addr, reason, bt_hci_err_to_str(reason));
}

static struct bt_conn_cb conn_callbacks = {
	.connected = connected,
	.disconnected = disconnected,
};

static int iso_accept(const struct bt_iso_accept_info *info, struct bt_iso_chan **chan)
{
	printk("Incoming request from %p\n", (void *)info->acl);

	struct bt_iso_chan **iso_channels =
		configured_for_tx ? iso_tx_channels_get() : iso_rx_channels_get();

	if (iso_channels[0]->iso) {
		printk("No channels available\n");
		return -ENOMEM;
	}

	*chan = iso_channels[0];

	return 0;
}

static struct bt_iso_server iso_server = {
#if defined(CONFIG_BT_SMP)
	.sec_level = BT_SECURITY_L1,
#endif /* CONFIG_BT_SMP */
	.accept = iso_accept,
};

void cis_peripheral_start(bool do_tx)
{
	int err;
	uint8_t unused_rtn = 0;

	configured_for_tx = do_tx;

	/* It is the central that sets the RTN */
	if (do_tx) {
		iso_tx_init(unused_rtn, NULL);
	} else {
		iso_rx_init(unused_rtn, NULL);
	}

	bt_conn_cb_register(&conn_callbacks);

	err = bt_iso_server_register(&iso_server);
	if (err) {
		printk("Unable to register ISO server (err %d)\n", err);
		return;
	}

	err = bt_le_adv_start(BT_LE_ADV_CONN_FAST_2, ad, ARRAY_SIZE(ad), NULL, 0);
	if (err) {
		printk("Advertising failed to start (err %d)\n", err);
		return;
	}

	printk("CIS peripheral started advertising\n");
}
```

## src/controller_time_nrf52.c
```c
/*
 * Copyright (c) 2024 Nordic Semiconductor ASA
 *
 * SPDX-License-Identifier: LicenseRef-Nordic-5-Clause
 */

/** This file implements controller time management for 52 Series devices
 *
 * As the controller clock is not directly accessible, the controller
 * time is obtained using a mirrored RTC peripheral.
 * To achieve microsecond accurate toggling, a timer peripheral is also used.
 */

#include <zephyr/kernel.h>
#include <zephyr/sys/barrier.h>
#include <mpsl_clock.h>
#include <nrfx_rtc.h>
#include <nrfx_timer.h>
#include <helpers/nrfx_gppi.h>
#include <hal/nrf_egu.h>
#include <soc.h>
#include "iso_time_sync.h"

static const nrfx_rtc_t app_rtc_instance = NRFX_RTC_INSTANCE(2);
static const nrfx_timer_t app_timer_instance = NRFX_TIMER_INSTANCE(1);

static uint8_t ppi_chan_on_rtc_match;
static volatile uint32_t num_rtc_overflows;

static uint32_t offset_ticks_and_controller_to_app_rtc;

static void rtc_isr_handler(nrfx_rtc_int_type_t int_type)
{
	if (int_type == NRFX_RTC_INT_OVERFLOW) {
		num_rtc_overflows++;
	}
}

static void unused_timer_isr_handler(nrf_timer_event_t event_type, void *ctx)
{
	ARG_UNUSED(event_type);
	ARG_UNUSED(ctx);
}

static int32_t rtc_diff_get(void)
{
	uint32_t controller_ticks = nrf_rtc_counter_get(NRF_RTC0);
	uint32_t app_ticks = nrf_rtc_counter_get(app_rtc_instance.p_reg);

	return controller_ticks - app_ticks;
}

static int rtc_config(void)
{
	int ret;

	const nrfx_rtc_config_t rtc_cfg = NRFX_RTC_DEFAULT_CONFIG;

	ret = nrfx_rtc_init(&app_rtc_instance, &rtc_cfg, rtc_isr_handler);
	if (ret != NRFX_SUCCESS) {
		printk("Failed initializing RTC (ret: %d)\n", ret - NRFX_ERROR_BASE_NUM);
		return -ENODEV;
	}

#ifndef CONFIG_SOC_SERIES_BSIM_NRFXX
	IRQ_CONNECT(NRFX_IRQ_NUMBER_GET(NRF_RTC_INST_GET(2)), IRQ_PRIO_LOWEST,
		    NRFX_RTC_INST_HANDLER_GET(2), NULL, 0);
#else
	IRQ_CONNECT(NRFX_IRQ_NUMBER_GET(NRF_RTC_INST_GET(2)), 0,
		    (void *)NRFX_RTC_INST_HANDLER_GET(2), NULL, 0);
#endif

	nrfx_rtc_overflow_enable(&app_rtc_instance, true);
	nrfx_rtc_tick_enable(&app_rtc_instance, false);
	nrfx_rtc_enable(&app_rtc_instance);

	/* To obtain the controller timestamp without modifying the state of RTC0,
	 * we find the offset between RTC0 and our mirrored RTC.
	 * We achieve this by reading out the counter value of both of them.
	 * When the diff between those two have been equal twice, we know the
	 * time difference in ticks.
	 */

	uint32_t sync_attempts = 10;

	while (sync_attempts > 0) {
		sync_attempts--;

		int32_t diff_measurement_1 = rtc_diff_get();

		/* We need to wait half an RTC tick to ensure we are not measuring
		 * the diff between the two RTCs at the point in time where their
		 * values are transitioning.
		 */
		k_busy_wait(15);

		int32_t diff_measurement_2 = rtc_diff_get();

		if (diff_measurement_1 == diff_measurement_2) {
			offset_ticks_and_controller_to_app_rtc = diff_measurement_1;
			return 0;
		}
	}

	printk("Controller time sync failure\n");
	offset_ticks_and_controller_to_app_rtc = 0;
	return -EINVAL;
}

static int timer_config(void)
{
	int ret;
	uint8_t ppi_chan_timer_clear_on_rtc_tick;
	const nrfx_timer_config_t timer_cfg = {
		.frequency = NRFX_MHZ_TO_HZ(1UL),
		.mode = NRF_TIMER_MODE_TIMER,
		.bit_width = NRF_TIMER_BIT_WIDTH_8,
		.interrupt_priority = NRFX_TIMER_DEFAULT_CONFIG_IRQ_PRIORITY,
		.p_context = NULL};

	ret = nrfx_timer_init(&app_timer_instance, &timer_cfg, unused_timer_isr_handler);
	if (ret != NRFX_SUCCESS) {
		printk("Failed initializing timer (ret: %d)\n", ret - NRFX_ERROR_BASE_NUM);
		return -ENODEV;
	}

	/* Clear the TIMER every RTC tick. */
	if (nrfx_gppi_channel_alloc(&ppi_chan_timer_clear_on_rtc_tick) != NRFX_SUCCESS) {
		printk("Failed allocating for clearing TIMER on RTC TICK\n");
		return -ENOMEM;
	}

	nrfx_gppi_channel_endpoints_setup(ppi_chan_timer_clear_on_rtc_tick,
					  nrfx_rtc_event_address_get(&app_rtc_instance,
								     NRF_RTC_EVENT_TICK),
					  nrfx_timer_task_address_get(&app_timer_instance,
								      NRF_TIMER_TASK_CLEAR));

	nrfx_gppi_channels_enable(BIT(ppi_chan_timer_clear_on_rtc_tick));

	nrfx_timer_enable(&app_timer_instance);

	return 0;
}

/** Configure the TIMER and RTC in such a way that microsecond accurate timing can be achieved.
 *
 * To get microsecond accurate toggling, we need to combine both the RTC and TIMER peripheral.
 * That is, both a RTC CC value and TIMER CC value needs to be set.
 * We should only trigger an EGU task when the TIMER CC value matches after the
 * RTC CC value matched.
 * This is achieved using a PPI group. The group is enabled when the RTC CC matches and disabled
 * again then the TIMER CC matches.
 */
int config_egu_trigger_on_rtc_and_timer_match(void)
{
	uint8_t ppi_chan_on_timer_match;

	if (nrfx_gppi_channel_alloc(&ppi_chan_on_rtc_match) != NRFX_SUCCESS) {
		printk("Failed allocating for RTC match\n");
		return -ENOMEM;
	}

	if (nrfx_gppi_channel_alloc(&ppi_chan_on_timer_match) != NRFX_SUCCESS) {
		printk("Failed allocating for TIMER match\n");
		return -ENOMEM;
	}

	nrfx_gppi_group_clear(NRFX_GPPI_CHANNEL_GROUP0);
	nrfx_gppi_group_disable(NRFX_GPPI_CHANNEL_GROUP0);
	nrfx_gppi_channels_include_in_group(
		BIT(ppi_chan_on_timer_match) | BIT(ppi_chan_on_rtc_match),
		NRFX_GPPI_CHANNEL_GROUP0);

	nrfx_gppi_channel_endpoints_setup(ppi_chan_on_rtc_match,
					  nrfx_rtc_event_address_get(&app_rtc_instance,
								     NRF_RTC_EVENT_COMPARE_0),
					  nrfx_gppi_task_address_get(NRFX_GPPI_TASK_CHG0_EN));

	nrfx_gppi_channel_endpoints_setup(ppi_chan_on_timer_match,
					  nrfx_timer_event_address_get(&app_timer_instance,
								       NRF_TIMER_EVENT_COMPARE0),
					  nrf_egu_task_address_get(NRF_EGU0,
								   NRF_EGU_TASK_TRIGGER0));
	nrfx_gppi_fork_endpoint_setup(ppi_chan_on_timer_match,
				      nrfx_gppi_task_address_get(NRFX_GPPI_TASK_CHG0_DIS));

	return 0;
}

int controller_time_init(void)
{
	int ret;

	ret = rtc_config();
	if (ret) {
		return ret;
	}

	ret = timer_config();
	if (ret) {
		return ret;
	}

	return config_egu_trigger_on_rtc_and_timer_match();
}

static uint64_t rtc_ticks_to_us(uint32_t rtc_ticks)
{
	const uint64_t rtc_ticks_in_femto_units = 30517578125UL;

	return (rtc_ticks * rtc_ticks_in_femto_units) / 1000000000UL;
}

static uint32_t us_to_rtc_ticks(uint32_t timestamp_us)
{
	const uint64_t rtc_ticks_in_femto_units = 30517578125UL;

	return ((uint64_t)(timestamp_us) * 1000000000UL) / rtc_ticks_in_femto_units;
}

uint64_t controller_time_us_get(void)
{
	const uint64_t rtc_overflow_time_us = 512000000UL;

	/* On the 52 series the RTC has to task to capture the current RTC value.
	 * Therefore we cannot capture the TIMER and RTC value simultaneously.
	 * Therefore we only use the RTC to read out the current time here.
	 * This will result in an error of maximum one RTC tick.
	 */

	uint32_t captured_rtc_overflows;
	uint32_t captured_rtc_ticks;

	while (true) {
		captured_rtc_overflows = num_rtc_overflows;

		/* Read out RTC ticks after reading number of overflows. */
		barrier_isync_fence_full();

		captured_rtc_ticks = nrf_rtc_counter_get(app_rtc_instance.p_reg);

		/* Read out number of overflows after reading number of RTC ticks  */
		barrier_isync_fence_full();

		if (captured_rtc_overflows == num_rtc_overflows) {
			/* There were no new overflows after reading ticks.
			 * That is, we can use the captured value.
			 */
			break;
		}
	}

	return rtc_ticks_to_us(captured_rtc_ticks) +
	       (captured_rtc_overflows * rtc_overflow_time_us) +
	       rtc_ticks_to_us(offset_ticks_and_controller_to_app_rtc);
}

void controller_time_trigger_set(uint64_t timestamp_us)
{
	uint64_t timestamp_without_rtc_offset =
		timestamp_us - rtc_ticks_to_us(offset_ticks_and_controller_to_app_rtc);

	uint32_t num_overflows = timestamp_without_rtc_offset / 512000000UL;
	uint64_t overflow_time_us = num_overflows * 512000000UL;

	uint32_t rtc_remainder_time_us = timestamp_without_rtc_offset - overflow_time_us;
	uint32_t rtc_val = us_to_rtc_ticks(rtc_remainder_time_us);
	uint8_t timer_val =	timestamp_without_rtc_offset - rtc_ticks_to_us(rtc_val);

	/* Ensure the timer value lies between 1 and 30 so that it will
	 * always be between two RTC ticks.
	 */
	timer_val = MAX(timer_val, 1);
	timer_val = MIN(timer_val, 30);

	if (nrfx_rtc_cc_set(&app_rtc_instance, 0, rtc_val, false) != NRFX_SUCCESS) {
		printk("Failed setting trigger\n");
	}

	nrfx_timer_compare(&app_timer_instance, 0, timer_val, false);
	nrfx_gppi_channels_enable(BIT(ppi_chan_on_rtc_match));
}

uint32_t controller_time_trigger_event_addr_get(void)
{
	return nrf_egu_event_address_get(NRF_EGU0, NRF_EGU_EVENT_TRIGGERED0);
}

SYS_INIT(controller_time_init, POST_KERNEL, CONFIG_KERNEL_INIT_PRIORITY_DEFAULT);
```

## src/controller_time_nrf53_app.c
```c
/*
 * Copyright (c) 2024 Nordic Semiconductor ASA
 *
 * SPDX-License-Identifier: LicenseRef-Nordic-5-Clause
 */

/** This file implements controller time management for 53 Series devices
 *
 * As the controller clock is not directly accessible, the controller
 * time is obtained using a mirrored RTC peripheral.
 * The RTC is started upon starting the controller clock on the network core.
 * To achieve microsecond accurate toggling, a timer peripheral is also used.
 */

#include <zephyr/kernel.h>
#include <zephyr/init.h>
#include <zephyr/sys/barrier.h>
#include <helpers/nrfx_gppi.h>
#include <nrfx_rtc.h>
#include <nrfx_timer.h>
#include <hal/nrf_ipc.h>
#include <hal/nrf_egu.h>
#include "iso_time_sync.h"

static const nrfx_rtc_t app_rtc_instance = NRFX_RTC_INSTANCE(0);
static const nrfx_timer_t app_timer_instance = NRFX_TIMER_INSTANCE(0);

static uint8_t ppi_chan_on_rtc_match;
static volatile uint32_t num_rtc_overflows;

static void rtc_isr_handler(nrfx_rtc_int_type_t int_type)
{
	if (int_type == NRFX_RTC_INT_OVERFLOW) {
		num_rtc_overflows++;
	}
}

static void unused_timer_isr_handler(nrf_timer_event_t event_type, void *ctx)
{
	ARG_UNUSED(event_type);
	ARG_UNUSED(ctx);
}

static int rtc_config(void)
{
	int ret;
	uint8_t dppi_channel_rtc_start;
	const nrfx_rtc_config_t rtc_cfg = NRFX_RTC_DEFAULT_CONFIG;

	ret = nrfx_rtc_init(&app_rtc_instance, &rtc_cfg, rtc_isr_handler);
	if (ret != NRFX_SUCCESS) {
		printk("Failed initializing RTC (ret: %d)\n", ret - NRFX_ERROR_BASE_NUM);
		return -ENODEV;
	}

#ifndef CONFIG_SOC_SERIES_BSIM_NRFXX
	IRQ_CONNECT(NRFX_IRQ_NUMBER_GET(NRF_RTC_INST_GET(0)), IRQ_PRIO_LOWEST,
		    NRFX_RTC_INST_HANDLER_GET(0), NULL, 0);
#else
	IRQ_CONNECT(NRFX_IRQ_NUMBER_GET(NRF_RTC_INST_GET(0)), 0,
		    (void *)NRFX_RTC_INST_HANDLER_GET(0), NULL, 0);
#endif

	nrfx_rtc_overflow_enable(&app_rtc_instance, true);
	nrfx_rtc_tick_enable(&app_rtc_instance, false);
	nrfx_rtc_enable(&app_rtc_instance);


	/* The application core RTC is started synchronously with the controller
	 * RTC using PPI over IPC.
	 */
	ret = nrfx_gppi_channel_alloc(&dppi_channel_rtc_start);
	if (ret != NRFX_SUCCESS) {
		printk("nrfx DPPI channel alloc error for starting RTC: %d", ret);
		return -ENODEV;
	}

	nrf_ipc_receive_config_set(NRF_IPC, 4, NRF_IPC_CHANNEL_4);

	nrfx_gppi_channel_endpoints_setup(dppi_channel_rtc_start,
					  nrfx_rtc_task_address_get(&app_rtc_instance,
								     NRF_RTC_TASK_CLEAR),
					  nrf_ipc_event_address_get(NRF_IPC,
								    NRF_IPC_EVENT_RECEIVE_4));

	nrfx_gppi_channels_enable(BIT(dppi_channel_rtc_start));

	return 0;
}

static int timer_config(void)
{
	int ret;
	uint8_t ppi_chan_timer_clear_on_rtc_tick;
	const nrfx_timer_config_t timer_cfg = {
		.frequency = NRFX_MHZ_TO_HZ(1UL),
		.mode = NRF_TIMER_MODE_TIMER,
		.bit_width = NRF_TIMER_BIT_WIDTH_8,
		.interrupt_priority = NRFX_TIMER_DEFAULT_CONFIG_IRQ_PRIORITY,
		.p_context = NULL};

	ret = nrfx_timer_init(&app_timer_instance, &timer_cfg, unused_timer_isr_handler);
	if (ret != NRFX_SUCCESS) {
		printk("Failed initializing timer (ret: %d)\n", ret - NRFX_ERROR_BASE_NUM);
		return -ENODEV;
	}

	/* Clear the TIMER every RTC tick. */
	if (nrfx_gppi_channel_alloc(&ppi_chan_timer_clear_on_rtc_tick) != NRFX_SUCCESS) {
		printk("Failed allocating for clearing TIMER on RTC TICK\n");
		return -ENOMEM;
	}

	nrfx_gppi_channel_endpoints_setup(ppi_chan_timer_clear_on_rtc_tick,
					  nrfx_rtc_event_address_get(&app_rtc_instance,
								     NRF_RTC_EVENT_TICK),
					  nrfx_timer_task_address_get(&app_timer_instance,
								      NRF_TIMER_TASK_CLEAR));

	nrfx_gppi_channels_enable(BIT(ppi_chan_timer_clear_on_rtc_tick));

	nrfx_timer_enable(&app_timer_instance);

	return 0;
}

/** Configure the TIMER and RTC in such a way that microsecond accurate timing can be achieved.
 *
 * To get microsecond accurate toggling, we need to combine both the RTC and TIMER peripheral.
 * That is, both a RTC CC value and TIMER CC value needs to be set.
 * We should only trigger an EGU task when the TIMER CC value
 * matches after the RTC CC value matched.
 * This is achieved using a PPI group. The group is enabled when the RTC CC matches and disabled
 * again then the TIMER CC matches.
 */
int config_egu_trigger_on_rtc_and_timer_match(void)
{
	uint8_t ppi_chan_on_timer_match;

	if (nrfx_gppi_channel_alloc(&ppi_chan_on_rtc_match) != NRFX_SUCCESS) {
		printk("Failed allocating for RTC match\n");
		return -ENOMEM;
	}

	if (nrfx_gppi_channel_alloc(&ppi_chan_on_timer_match) != NRFX_SUCCESS) {
		printk("Failed allocating for TIMER match\n");
		return -ENOMEM;
	}

	nrfx_gppi_group_clear(NRFX_GPPI_CHANNEL_GROUP0);
	nrfx_gppi_group_disable(NRFX_GPPI_CHANNEL_GROUP0);
	nrfx_gppi_channels_include_in_group(
		BIT(ppi_chan_on_timer_match) | BIT(ppi_chan_on_rtc_match),
		NRFX_GPPI_CHANNEL_GROUP0);

	nrfx_gppi_channel_endpoints_setup(ppi_chan_on_rtc_match,
					  nrfx_rtc_event_address_get(&app_rtc_instance,
								     NRF_RTC_EVENT_COMPARE_0),
					  nrfx_gppi_task_address_get(NRFX_GPPI_TASK_CHG0_EN));
	nrfx_gppi_channel_endpoints_setup(ppi_chan_on_timer_match,
					  nrfx_timer_event_address_get(&app_timer_instance,
								       NRF_TIMER_EVENT_COMPARE0),
					  nrfx_gppi_task_address_get(NRFX_GPPI_TASK_CHG0_DIS));
	nrfx_gppi_fork_endpoint_setup(ppi_chan_on_timer_match,
				      nrf_egu_task_address_get(NRF_EGU0, NRF_EGU_TASK_TRIGGER0));

	return 0;
}

int controller_time_init(void)
{
	int ret;

	ret = rtc_config();
	if (ret) {
		return ret;
	}

	ret = timer_config();
	if (ret) {
		return ret;
	}

	return config_egu_trigger_on_rtc_and_timer_match();
}

static uint64_t rtc_ticks_to_us(uint32_t rtc_ticks)
{
	const uint64_t rtc_ticks_in_femto_units = 30517578125UL;

	return (rtc_ticks * rtc_ticks_in_femto_units) / 1000000000UL;
}

static uint32_t us_to_rtc_ticks(uint32_t timestamp_us)
{
	const uint64_t rtc_ticks_in_femto_units = 30517578125UL;

	return ((uint64_t)(timestamp_us) * 1000000000UL) / rtc_ticks_in_femto_units;
}

uint64_t controller_time_us_get(void)
{
	/* Simply use the RTC time here.
	 * It is possible to combine RTC and TIMER information here to get a more accurate
	 * timestamp. That requires setting up a PPI channel to capture both values simultaneously.
	 */

	const uint64_t rtc_overflow_time_us = 512000000UL;

	uint32_t captured_rtc_overflows;
	uint32_t captured_rtc_ticks;

	while (true) {
		captured_rtc_overflows = num_rtc_overflows;

		/* Read out RTC ticks after reading number of overflows. */
		barrier_isync_fence_full();

		captured_rtc_ticks = nrf_rtc_counter_get(app_rtc_instance.p_reg);

		/* Read out number of overflows after reading number of RTC ticks  */
		barrier_isync_fence_full();

		if (captured_rtc_overflows == num_rtc_overflows) {
			/* There were no new overflows after reading ticks.
			 * That is, we can use the captured value.
			 */
			break;
		}
	}

	return rtc_ticks_to_us(captured_rtc_ticks) +
	       (captured_rtc_overflows * rtc_overflow_time_us);
}

void controller_time_trigger_set(uint64_t timestamp_us)
{
	uint32_t num_overflows = timestamp_us / 512000000UL;
	uint64_t overflow_time_us = num_overflows * 512000000UL;

	uint32_t remainder_time_us = timestamp_us - overflow_time_us;
	uint32_t rtc_val = us_to_rtc_ticks(remainder_time_us);
	uint8_t timer_val = timestamp_us - rtc_ticks_to_us(rtc_val);

	/* Ensure the timer value lies between 1 and 30 so that it will
	 * always be between two RTC ticks.
	 */
	timer_val = MAX(timer_val, 1);
	timer_val = MIN(timer_val, 30);

	if (nrfx_rtc_cc_set(&app_rtc_instance, 0, rtc_val, false) != NRFX_SUCCESS) {
		printk("Failed setting trigger\n");
	}

	nrfx_timer_compare(&app_timer_instance, 0, timer_val, false);
	nrfx_gppi_channels_enable(BIT(ppi_chan_on_rtc_match));
}

uint32_t controller_time_trigger_event_addr_get(void)
{
	return nrf_egu_event_address_get(NRF_EGU0, NRF_EGU_EVENT_TRIGGERED0);
}

/* The controller time initialization must happen before
 * starting the network core.
 */
SYS_INIT(controller_time_init, POST_KERNEL, CONFIG_KERNEL_INIT_PRIORITY_DEFAULT);
```

## src/controller_time_nrf54.c
```c
/*
 * Copyright (c) 2024 Nordic Semiconductor ASA
 *
 * SPDX-License-Identifier: LicenseRef-Nordic-5-Clause
 */

/** This file implements controller time management for 54 Series devices
 */

#include <zephyr/kernel.h>
#include <nrfx_grtc.h>
#include "iso_time_sync.h"

static uint8_t grtc_channel;

int controller_time_init(void)
{
	int ret;

	ret = nrfx_grtc_channel_alloc(&grtc_channel);
	if (ret != NRFX_SUCCESS) {
		printk("Failed allocating GRTC channel (ret: %d)\n",
		       ret - NRFX_ERROR_BASE_NUM);
		return -ENODEV;
	}

	nrf_grtc_sys_counter_compare_event_enable(NRF_GRTC, grtc_channel);

	return 0;
}

uint64_t controller_time_us_get(void)
{
	int ret;
	uint64_t current_time_us;

	ret = nrfx_grtc_syscounter_get(&current_time_us);
	if (ret != NRFX_SUCCESS) {
		printk("Failed obtaining system time (ret: %d)\n", ret - NRFX_ERROR_BASE_NUM);
		return 0;
	}

	return current_time_us;
}

void controller_time_trigger_set(uint64_t timestamp_us)
{
	int ret;

	nrfx_grtc_channel_t chan_data = {
		.channel = grtc_channel,
	};

	ret = nrfx_grtc_syscounter_cc_absolute_set(&chan_data, timestamp_us, false);
	if (ret != NRFX_SUCCESS) {
		printk("Failed setting CC (ret: %d)\n", ret - NRFX_ERROR_BASE_NUM);
	}
}

uint32_t controller_time_trigger_event_addr_get(void)
{
	return nrf_grtc_event_address_get(NRF_GRTC,
					  nrf_grtc_sys_counter_compare_event_get(grtc_channel));
}

SYS_INIT(controller_time_init, POST_KERNEL, CONFIG_KERNEL_INIT_PRIORITY_DEFAULT);
```

## src/timed_led_toggle.c
```c
/*
 * Copyright (c) 2024 Nordic Semiconductor ASA
 *
 * SPDX-License-Identifier: LicenseRef-Nordic-5-Clause
 */

/** This file implements timed toggling a LED
 *
 * To achieve accurate toggling, it interacts with the controller
 * clock using PPI.
 */

#include <zephyr/kernel.h>
#include <zephyr/device.h>
#include <zephyr/drivers/gpio.h>
#include <soc.h>
#include <nrfx_gpiote.h>
#include <helpers/nrfx_gppi.h>
#include "iso_time_sync.h"

#define GPIOTE_INST NRF_DT_GPIOTE_INST(DT_ALIAS(led1), gpios)
#define GPIOTE_NODE DT_NODELABEL(_CONCAT(gpiote, GPIOTE_INST))
#define LED_PIN NRF_DT_GPIOS_TO_PSEL(DT_ALIAS(led1), gpios)

BUILD_ASSERT(IS_ENABLED(_CONCAT(CONFIG_, _CONCAT(NRFX_GPIOTE, GPIOTE_INST))),
	     "NRFX_GPIOTE" STRINGIFY(GPIOTE_INST) " must be enabled in Kconfig");

static const nrfx_gpiote_t gpiote = NRFX_GPIOTE_INSTANCE(GPIOTE_INST);
static struct gpio_dt_spec led = GPIO_DT_SPEC_GET_OR(DT_ALIAS(led1), gpios, {0});

static uint8_t previous_led_value;

int timed_led_toggle_init(void)
{
	int err;
	uint8_t ppi_chan_led_toggle;
	uint8_t gpiote_chan_led_toggle;

	const nrfx_gpiote_output_config_t gpiote_output_cfg = NRFX_GPIOTE_DEFAULT_OUTPUT_CONFIG;

	err = gpio_pin_configure_dt(&led, GPIO_OUTPUT_INACTIVE);
	if (err != 0) {
		printk("Error %d: failed to configure LED device %s pin %d\n", err, led.port->name,
		       led.pin);
		return err;
	}

	if (nrfx_gpiote_channel_alloc(&gpiote, &gpiote_chan_led_toggle) != NRFX_SUCCESS) {
		printk("Failed allocating GPIOTE chan for setting led\n");
		return -ENOMEM;
	}

	const nrfx_gpiote_task_config_t task_cfg_led_toggle = {
		.task_ch = gpiote_chan_led_toggle,
		.polarity = NRF_GPIOTE_POLARITY_TOGGLE,
		.init_val = (led.dt_flags & GPIO_ACTIVE_LOW) ?
			NRF_GPIOTE_INITIAL_VALUE_HIGH : NRF_GPIOTE_INITIAL_VALUE_LOW,
	};

	if (nrfx_gpiote_output_configure(&gpiote, LED_PIN, &gpiote_output_cfg,
					 &task_cfg_led_toggle) != NRFX_SUCCESS) {
		printk("Failed configuring GPIOTE chan for toggling led\n");
		return -ENOMEM;
	}

	if (nrfx_gppi_channel_alloc(&ppi_chan_led_toggle) != NRFX_SUCCESS) {
		printk("Failed allocating PPI chan for toggling led\n");
		return -ENOMEM;
	}

	nrfx_gppi_channel_endpoints_setup(ppi_chan_led_toggle,
					  controller_time_trigger_event_addr_get(),
					  nrfx_gpiote_out_task_address_get(&gpiote, LED_PIN));

	nrfx_gppi_channels_enable(BIT(ppi_chan_led_toggle));
	nrfx_gpiote_out_task_enable(&gpiote, LED_PIN);

	return 0;
}

void timed_led_toggle_trigger_at(uint8_t value, uint32_t timestamp_us)
{
	if (value == previous_led_value) {
		/* No need to set up trigger, as a trigger has already been configured. */
		return;
	}

	/* First obtain the full 64-bit time. */
	const uint64_t current_time_us = controller_time_us_get();
	const uint64_t current_time_most_significant_word = current_time_us & 0xFFFFFFFF00000000UL;

	uint64_t full_timestamp_us = current_time_most_significant_word | timestamp_us;

	if (timestamp_us < (current_time_us & UINT32_MAX)) {
		/* Trigger time is after UINT32 wrap */
		full_timestamp_us += 0x100000000UL;
	}

	controller_time_trigger_set(full_timestamp_us);

	previous_led_value = value;
}
```
