## prj.conf
```kconfig
CONFIG_BT_CTLR_PHY_2M=y

CONFIG_BT=y
CONFIG_BT_OBSERVER=y
CONFIG_BT_BROADCASTER=y
CONFIG_BT_EXT_ADV=y
CONFIG_BT_PER_ADV_SYNC=y
CONFIG_BT_DEVICE_NAME="PAwR sync sample"

CONFIG_BT_MAX_CONN=1
CONFIG_BT_CONN_TX_MAX=10
CONFIG_BT_PERIPHERAL=y

CONFIG_BT_PER_ADV_SYNC_TRANSFER_SENDER=y
CONFIG_BT_PER_ADV_SYNC_TRANSFER_RECEIVER=y

CONFIG_BT_PER_ADV_SYNC_RSP=y
CONFIG_BT_PER_ADV_SYNC_BUF_SIZE=260

# Enable PHY update for 2M PHY
CONFIG_BT_USER_PHY_UPDATE=y

# Optimized buffer and data length configuration
CONFIG_BT_BUF_ACL_RX_SIZE=502
CONFIG_BT_BUF_ACL_TX_SIZE=502
CONFIG_BT_L2CAP_TX_MTU=498
CONFIG_BT_DATA_LEN_UPDATE=y
CONFIG_BT_GAP_AUTO_UPDATE_CONN_PARAMS=n

# Controller buffer configuration
CONFIG_BT_CTLR_DATA_LENGTH_MAX=251
CONFIG_BT_CTLR_SDC_TX_PACKET_COUNT=10
CONFIG_BT_CTLR_SDC_RX_PACKET_COUNT=10

# Controller optimizations for throughput
CONFIG_BT_CTLR_SDC_MAX_CONN_EVENT_LEN_DEFAULT=4000000
CONFIG_BT_CTLR_TX_PWR_DYNAMIC_CONTROL=y

CONFIG_BT_CTLR_SDC_PERIODIC_SYNC_RSP_TX_BUFFER_COUNT=6

# Increase stack for Bluetooth RX thread to accommodate PAwR callbacks
CONFIG_BT_RX_STACK_SIZE=4096

CONFIG_PRINTK=y
CONFIG_SERIAL=y
CONFIG_CONSOLE=y
CONFIG_UART_CONSOLE=y
CONFIG_BOOT_BANNER=y
```

## src/main.c
```c
/*
 * Copyright (c) 2025 Nordic Semiconductor ASA
 *
 * SPDX-License-Identifier: Apache-2.0
 */

#include <zephyr/bluetooth/bluetooth.h>
#include <zephyr/bluetooth/hci.h>
#include <zephyr/kernel.h>
#include <zephyr/sys/byteorder.h>
#include <zephyr/random/random.h>
#include <string.h>

#define TARGET_NAME                     "PAwR adv sample"
#define NORDIC_COMPANY_ID               0x0059
#define MSD_HEADER_LEN                  4                       /* Manufacturer specific data header length */
#define ACK_ENTRY_SIZE                  5                       /* token (4B) + slot (1B) */
#define ACK_SLOT_OFFSET                 4                       /* offset of slot in ACK entry */
#define MIN_PAYLOAD_SIZE                (MSD_HEADER_LEN + 5)    /* MSD header (4B) + protocol version (1B) + protocl flags (1B), open_len (1B), ack_count(1B), rt_len(1B) */
#define MAX_INDIVIDUAL_RESPONSE_SIZE    247            

/* Variables for token based claim/ack protocol*/
#define CLAIM_MSG_ID                    0xC1
#define CLAIM_TOKEN_LEN                 4
#define CLAIM_TOKEN_OFFSET              1
#define CLAIM_MSG_LEN                   (CLAIM_TOKEN_LEN + CLAIM_TOKEN_OFFSET) 

static  K_SEM_DEFINE(sem_per_sync, 0, 1);
static  K_SEM_DEFINE(sem_per_sync_lost, 0, 1);

/* Join/assignment state */
static  uint8_t  target_subevent         =  0;   /* single subevent flow */
static  int8_t   assigned_slot           = -1;   /* -1 means unassigned */
static  uint32_t my_token                =  0;   /* 0 means no token yet */
static  uint8_t  join_backoff_mod        =  3;   /* attempt every N events initially */
static  uint8_t  join_backoff_increase   =  0;   /* linear backoff growth */


static  struct   bt_le_per_adv_sync     *sync_handle;
static  struct   k_work_delayable       retry_subevent_sync_work;
static  uint8_t  subevent_retry_tries;

static bool name_match_cb(struct bt_data *data, void *user_data)
{
	bool *matched = user_data;
	if (data->type == BT_DATA_NAME_COMPLETE || data->type == BT_DATA_NAME_SHORTENED) {
		const char *target  = TARGET_NAME;
		size_t target_len   = strlen(target);
		/* data->data is not null-terminated; compare lengths and bytes */
		if (data->data_len == target_len &&
		    memcmp(data->data, target, target_len) == 0) {
			*matched = true;
			return false; /* stop parsing */
		}
	}
	return true; /* continue parsing */
}

static bool ad_has_target_name(struct net_buf_simple *ad)
{
	bool matched = false;
	bt_data_parse(ad, name_match_cb, &matched);
	return matched;
}

static void attempt_subevent_sync(void)
{
    if (!sync_handle) {
        subevent_retry_tries = 0;
        return;
    }

    struct bt_le_per_adv_sync_subevent_params sync_param = {
        .properties     = 0,
        .num_subevents  = 1,
    };

    uint8_t desired_subevent_id = target_subevent;
    sync_param.subevents = &desired_subevent_id;

    int err = bt_le_per_adv_sync_subevent(sync_handle, &sync_param);
    if (err) {
        if (++subevent_retry_tries <= 5U) { /* retry up to 5 times*/
            (void)k_work_reschedule(&retry_subevent_sync_work, K_MSEC(10));
        } else {
            printk("[SYNC] Failed to set subevents after %u tries (err %d)\n",
                   subevent_retry_tries, err);
        }
    } else {
        subevent_retry_tries = 0;
        (void)k_work_cancel_delayable(&retry_subevent_sync_work);
    }
}

static void set_subevent_retry(struct k_work *work)
{
    ARG_UNUSED(work);
    attempt_subevent_sync();
}

static void sync_cb(struct bt_le_per_adv_sync *sync, 
                   struct bt_le_per_adv_sync_synced_info *info)
{
    struct  bt_le_per_adv_sync_subevent_params params;
    uint8_t subevents[1];
    char    le_addr[BT_ADDR_LE_STR_LEN];
    int     err;

    bt_addr_le_to_str(info->addr, le_addr, sizeof(le_addr));
    printk("[SYNC] Synced to %s with %d subevents\n", le_addr, info->num_subevents);

    sync_handle             = sync;
    params.properties       = 0;
    params.num_subevents    = 1;
    params.subevents        = subevents;
    subevents[0]            = target_subevent;

    err = bt_le_per_adv_sync_subevent(sync, &params);
    if (err || info->num_subevents == 0){
        printk("[SYNC] Failed to set subevents (err %d)\n", err);
        subevent_retry_tries = 0;
        (void)k_work_reschedule(&retry_subevent_sync_work, K_NO_WAIT);
    } else {
        printk("[SYNC] Changed sync to subevent %d\n", subevents[0]);
        subevent_retry_tries = 0;
        (void)k_work_cancel_delayable(&retry_subevent_sync_work);
    }
    k_sem_give(&sem_per_sync);
}

static void term_cb(struct bt_le_per_adv_sync *sync, const struct bt_le_per_adv_sync_term_info *info)
{
    char le_addr[BT_ADDR_LE_STR_LEN];
    bt_addr_le_to_str(info->addr, le_addr, sizeof(le_addr));
    sync_handle = NULL;
    (void)k_work_cancel_delayable(&retry_subevent_sync_work);
    subevent_retry_tries = 0;
    k_sem_give(&sem_per_sync_lost);
}


void build_claim_payload(struct net_buf_simple *rsp_buf, uint32_t my_token)
{
    /* Build CLAIM payload: [Claim ID][Claim token (4B) + Claim token offset (1B)] */
    net_buf_simple_reset(rsp_buf);
    net_buf_simple_add_u8(rsp_buf, CLAIM_MSG_ID);
    net_buf_simple_add_le32(rsp_buf, my_token);
}


static void recv_cb(struct bt_le_per_adv_sync *sync, const struct bt_le_per_adv_sync_recv_info *info, struct net_buf_simple *buf)
{
    static uint16_t payload_rsp_size;
    static struct bt_le_per_adv_response_params rsp_params;
    NET_BUF_SIMPLE_DEFINE_STATIC(rsp_buf, 260);
    const int data_buf_size = 3;  /* 1 byte for manufacturer data ID, 2 bytes for company ID */
    static uint8_t open_seen_consecutive;

    /* Initialize payload response size if not set */
    if (payload_rsp_size == 0) {
        payload_rsp_size = MAX_INDIVIDUAL_RESPONSE_SIZE - data_buf_size;
    }

    if (buf && buf->len) {
        uint8_t         open_len            = 0;
        uint8_t         open_bitmap[32];
        memset(open_bitmap, 0, sizeof(open_bitmap));
        uint8_t         ack_count           = 0;
        const uint8_t   *acks_ptr           = NULL;
        uint8_t         rt_len              = 0; 
        uint32_t        retransmit_bitmap32 = 0;

        /* Parsing incoming PAwR control AD payload in buf->data to extract open-slot bitmap, ACK list and retransmit bitmap */
        if (buf->len >= MIN_PAYLOAD_SIZE) {
            uint8_t *data = buf->data;
            if (data[1] == BT_DATA_MANUFACTURER_DATA && data[2] == NORDIC_COMPANY_ID && data[3] == 0x00) {
                uint8_t idx = MSD_HEADER_LEN;
                if (buf->len > idx + 1) {
                    /* skip protocol version */
                    idx += 1;
                }
                if (buf->len > idx + 1) {
                    /* skip protocol flags */
                    idx += 1;
                }
                if (buf->len > idx) {
                    open_len = data[idx++];
                }
                if (open_len > sizeof(open_bitmap)) {
                    open_len = sizeof(open_bitmap);
                }
                if (buf->len >= idx + open_len) {
                    memcpy(open_bitmap, &data[idx], open_len);
                    idx += open_len;
                }
                if (buf->len > idx) {
                    ack_count = data[idx++];
                }
                if (buf->len >= idx + ack_count * ACK_ENTRY_SIZE) {
                    acks_ptr = &data[idx];
                    idx += ack_count * ACK_ENTRY_SIZE;
                }
                if (buf->len > idx) {
                    rt_len = data[idx++];
                }
                /* Extract up to 4 bytes of retransmit bitmap for quick checks */
                for (int i = 0; i < rt_len && i < 4; i++) {
                    if (buf->len > idx + i) {
                        retransmit_bitmap32 |= ((uint32_t)data[idx + i]) << (8 * i);
                    }
                }
            }
        }

        if (assigned_slot >= 0) {
            uint8_t idx_b = (uint8_t)(assigned_slot / 8);
            uint8_t bit_b = (uint8_t)(assigned_slot % 8);
            bool is_open = (idx_b < open_len) && (open_bitmap[idx_b] & (uint8_t)(1U << bit_b));
        
            if (is_open) {
                if (++open_seen_consecutive >= 2) {
                    printk("[JOIN] Evicted: slot %d marked open; rejoining\n", assigned_slot);
                    assigned_slot = -1;              /* drop claim */
                    open_seen_consecutive = 0;
                    join_backoff_increase = 0;       /* optional: speed up re-join */
                }
            } else {
                open_seen_consecutive = 0;
            }
        }

        /* If we're unassigned, look for ACK with our token */
        if (assigned_slot < 0 && my_token != 0 && acks_ptr && ack_count > 0) {
            for (uint8_t a = 0; a < ack_count; a++) {
                uint32_t tok  = sys_get_le32(&acks_ptr[a * ACK_ENTRY_SIZE]);
                uint8_t  slot = acks_ptr[a * ACK_ENTRY_SIZE + ACK_SLOT_OFFSET];
                if (tok == my_token) {
                    assigned_slot = slot;
                    printk("[JOIN] Acked: token 0x%08x assigned slot %d\n", my_token, assigned_slot);
                    break;
                }
            }
        }

        /* If still unassigned, probabilistically attempt a claim to reduce collisions */
        if (assigned_slot < 0) {
            uint32_t ev = info->periodic_event_counter;
            uint8_t mod = join_backoff_mod + join_backoff_increase;
            if (mod == 0) { mod = 1; }
            if ((ev % mod) == 0) {
                /* Choose a random open slot from variable-length bitmap */
                if (open_len > 0) {
                    /* Compute max slots*/
                    uint16_t max_slots          = (uint16_t)(open_len * 8);
                    uint16_t bitmap_slots_cap   = (uint16_t)(sizeof(open_bitmap) * 8);
                    if (max_slots > bitmap_slots_cap) {
                        max_slots = bitmap_slots_cap;
                    }
                    /* Collect open indices from bitmap*/
                    uint16_t open_indices[256];
                    uint16_t open_count = 0;
                    for (uint16_t s = 0; s < max_slots; s++) {
                        uint8_t idx_b = s / 8;
                        uint8_t bit_b = s % 8;
                        if (open_bitmap[idx_b] & (1U << bit_b)) {
                            open_indices[open_count++] = s;
                        }
                    }
                    if (open_count > 0) {
                        /* Pick a random open index*/
                        uint32_t r      = sys_rand32_get();
                        uint16_t pick   = (uint16_t)(r % open_count);

                        /* Ensure nonzero token */
                        uint8_t try_slot = (uint8_t)open_indices[pick];
                        if (my_token == 0) {
                            my_token = sys_rand32_get();
                            if (my_token == 0) {
                                my_token = 1; /* avoid 0 */
                            }
                        }

                        build_claim_payload(&rsp_buf, my_token);
                        rsp_params.request_event        = info->periodic_event_counter;
                        rsp_params.request_subevent     = info->subevent;
                        rsp_params.response_subevent    = info->subevent;
                        rsp_params.response_slot        = try_slot;

                        int err2 = bt_le_per_adv_set_response_data(sync, &rsp_params, &rsp_buf);
                        if (err2) {
                            printk("[JOIN] Failed to send claim (slot %d, err %d)\n", try_slot, err2);
                        } else {
                            printk("[JOIN] Sent claim for slot %d with token 0x%08x\n", try_slot, my_token);
                        }

                        /* Linear backoff increase to spread retries if not acked */
                        if (join_backoff_increase < 10) {
                            join_backoff_increase++;
                        }
                    }
                }
            }
        }

        /* Generate test data only when assigned */
        if (assigned_slot >= 0) {
            net_buf_simple_reset(&rsp_buf);
            for (int i = 0; i < payload_rsp_size; i++) {
                net_buf_simple_add_u8(&rsp_buf, (uint8_t)(assigned_slot + i));
            }

            rsp_params.request_event        = info->periodic_event_counter;
            rsp_params.request_subevent     = info->subevent;
            rsp_params.response_subevent    = info->subevent;
            rsp_params.response_slot        = assigned_slot;

            int err3 = bt_le_per_adv_set_response_data(sync, &rsp_params, &rsp_buf);
            if (err3) {
                printk("[SYNC] Failed to send response (err %d)\n", err3);
            }
        }
    } else {
        /* No data to process for this subevent*/
    }
}


/* Scan callback to detect periodic advertiser and create sync */
static void scan_recv_cb(const struct bt_le_scan_recv_info *info, struct net_buf_simple *ad)
{
    if (sync_handle) {
        return;
    }
    if (!(info->adv_props & BT_GAP_ADV_PROP_EXT_ADV)) {
        return;
    }
    if (info->sid == 0xFF) {
        return;
    }
    if (!ad_has_target_name(ad)) {
        return;
    }

    struct bt_le_per_adv_sync_param param = {0};
    bt_addr_le_copy(&param.addr, info->addr);
    param.sid       = info->sid;
    param.skip      = 0; 
    param.timeout   = 1000; /* 10s */

    int err = bt_le_per_adv_sync_create(&param, &sync_handle);
    if (!err) {
        printk("[SCAN] Creating periodic sync to SID %u\n", info->sid);
        (void)bt_le_scan_stop();
    }
}



int main(void)
{
    int             err;
    static struct   bt_le_scan_cb scan_cb                 = { .recv = scan_recv_cb };
    static struct   bt_le_per_adv_sync_cb sync_callbacks  = {.synced = sync_cb, .term = term_cb, .recv = recv_cb };
    printk("Starting PAwR Synchronizer\n");

    k_work_init_delayable(&retry_subevent_sync_work, set_subevent_retry);

    err = bt_enable(NULL);
    if (err) {
        printk("[INIT] Error: Bluetooth init failed (err %d)\n", err);
        return 0;
    }

    bt_le_per_adv_sync_cb_register(&sync_callbacks);
    bt_le_scan_cb_register(&scan_cb);

    err = bt_le_scan_start(BT_LE_SCAN_PASSIVE_CONTINUOUS, NULL);
    if (err) {
        printk("[SCAN] Error: start failed (err %d)\n", err);
        return 0;
    }
    printk("[SCAN] Waiting for periodic advertiser...\n");

    /* Wait for sync */
    err = k_sem_take(&sem_per_sync, K_FOREVER);
    if (err) {
        return 0;
    }

    while (true) {
        /* If sync is ever lost, restart scanning */
        (void)k_sem_take(&sem_per_sync_lost, K_FOREVER);
        assigned_slot           = -1;
        my_token                = 0;
        join_backoff_mod        = 3;
        join_backoff_increase   = 0;
        sync_handle             = NULL;
        (void)bt_le_scan_start(BT_LE_SCAN_PASSIVE_CONTINUOUS, NULL);
    }

    return 0;
}
```
