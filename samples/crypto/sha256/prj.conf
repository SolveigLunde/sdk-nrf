## CMakeLists.txt
```
#
# Copyright (c) 2021 Nordic Semiconductor ASA
#
# SPDX-License-Identifier: LicenseRef-Nordic-5-Clause
#

cmake_minimum_required(VERSION 3.20.0)

find_package(Zephyr REQUIRED HINTS $ENV{ZEPHYR_BASE})

project(sha256)

target_sources(app PRIVATE
        src/main.c)
```

## sample.yaml
```
sample:
  description: This app provides an example of hashing using SHA256
  name: SHA256 example
tests:
  sample.sha256.cc3xx:
    sysbuild: true
    tags:
      - introduction
      - psa
      - cc3xx
      - sysbuild
      - ci_samples_crypto
    platform_allow:
      - nrf5340dk/nrf5340/cpuapp/ns
      - nrf5340dk/nrf5340/cpuapp
      - nrf9160dk/nrf9160/ns
      - nrf9160dk/nrf9160
      - nrf52840dk/nrf52840
      - nrf9161dk/nrf9161
      - nrf9161dk/nrf9161/ns
      - nrf9151dk/nrf9151
      - nrf9151dk/nrf9151/ns
    harness: console
    harness_config:
      type: multi_line
      regex:
        - ".*Example finished successfully!.*"
    integration_platforms:
      - nrf5340dk/nrf5340/cpuapp/ns
      - nrf5340dk/nrf5340/cpuapp
      - nrf9160dk/nrf9160/ns
      - nrf9160dk/nrf9160
      - nrf9161dk/nrf9161/ns
      - nrf9161dk/nrf9161
      - nrf52840dk/nrf52840
      - nrf9151dk/nrf9151
      - nrf9151dk/nrf9151/ns
  sample.sha256.oberon:
    sysbuild: true
    extra_args:
      - CONFIG_PSA_CRYPTO_DRIVER_OBERON=y
      - CONFIG_PSA_CRYPTO_DRIVER_CRACEN=n
    tags:
      - introduction
      - psa
      - oberon
      - sysbuild
      - ci_samples_crypto
    platform_allow:
      - nrf5340dk/nrf5340/cpunet
      - nrf54l15dk/nrf54l15/cpuapp
    harness: console
    harness_config:
      type: multi_line
      regex:
        - .*Example finished successfully!.*
    integration_platforms:
      - nrf5340dk/nrf5340/cpunet
      - nrf54l15dk/nrf54l15/cpuapp
  sample.sha256.cracen:
    sysbuild: true
    tags:
      - introduction
      - psa
      - cracen
      - sysbuild
      - ci_samples_crypto
    platform_allow:
      - nrf54l15dk/nrf54l15/cpuapp
      - nrf54l15dk/nrf54l15/cpuapp/ns
      - nrf54l15dk/nrf54l10/cpuapp
      - nrf54l15dk/nrf54l10/cpuapp/ns
      - nrf54l15dk/nrf54l05/cpuapp
      - nrf54lm20pdk/nrf54lm20a/cpuapp
      - nrf54lv10dk/nrf54lv10a/cpuapp
      - nrf54lv10dk@0.0.0/nrf54lv10a/cpuapp
    harness: console
    harness_config:
      type: multi_line
      regex:
        - ".*Example finished successfully!.*"
    integration_platforms:
      - nrf54l15dk/nrf54l15/cpuapp
      - nrf54l15dk/nrf54l15/cpuapp/ns
      - nrf54l15dk/nrf54l10/cpuapp
      - nrf54l15dk/nrf54l10/cpuapp/ns
      - nrf54l15dk/nrf54l05/cpuapp
      - nrf54lm20pdk/nrf54lm20a/cpuapp
      - nrf54lv10dk/nrf54lv10a/cpuapp
  # Build integration regression protection.
  sample.nrf_security.sha256.integration:
    sysbuild: true
    build_only: true
    extra_args: SB_CONFIG_BOOTLOADER_MCUBOOT=y
    platform_allow:
      - nrf5340dk/nrf5340/cpuapp/ns
      - nrf52840dk/nrf52840
      - nrf52833dk/nrf52833
    integration_platforms:
      - nrf5340dk/nrf5340/cpuapp/ns
      - nrf52840dk/nrf52840
      - nrf52833dk/nrf52833
    tags:
      - sysbuild
      - ci_samples_crypto
  sample.newlib_libc.sha256:
    sysbuild: true
    build_only: true
    extra_args: CONFIG_NEWLIB_LIBC=y
    platform_allow:
      - nrf5340dk/nrf5340/cpuapp/ns
      - nrf52840dk/nrf52840
      - nrf54h20dk/nrf54h20/cpuapp
    integration_platforms:
      - nrf5340dk/nrf5340/cpuapp/ns
      - nrf52840dk/nrf52840
      - nrf54h20dk/nrf54h20/cpuapp
    tags:
      - sysbuild
      - ci_samples_crypto
  sample.sha256.cracen.crypto_service:
    sysbuild: true
    tags:
      - introduction
      - psa
      - cracen
      - sysbuild
      - crypto
      - ci_samples_crypto
    platform_allow:
      - nrf54h20dk/nrf54h20/cpuapp
    harness: console
    harness_config:
      type: multi_line
      regex:
        - ".*Example finished successfully!.*"
    integration_platforms:
      - nrf54h20dk/nrf54h20/cpuapp
```

## prj.conf
```kconfig
#
# Copyright (c) 2024 Nordic Semiconductor ASA
#
# SPDX-License-Identifier: LicenseRef-Nordic-5-Clause
#
# The Zephyr CMSIS emulation assumes that ticks are ms, currently
CONFIG_SYS_CLOCK_TICKS_PER_SEC=1000

CONFIG_MAIN_STACK_SIZE=4096
CONFIG_HEAP_MEM_POOL_SIZE=4096

# Enable logging
CONFIG_CONSOLE=y
CONFIG_LOG=y

# Enable nordic security backend and PSA APIs
CONFIG_NRF_SECURITY=y
CONFIG_MBEDTLS_PSA_CRYPTO_C=y

CONFIG_PSA_WANT_ALG_SHA_256=y
```

## boards/nrf54h20dk_nrf54h20_cpuapp_iron.conf
```kconfig
#
# Copyright (c) 2024 Nordic Semiconductor
#
# SPDX-License-Identifier: LicenseRef-Nordic-5-Clause
#

# Disable Oberon PSA crypto drivers
CONFIG_PSA_CRYPTO_DRIVER_OBERON=n

# Enable PSA crypto from SSF client
CONFIG_PSA_SSF_CRYPTO_CLIENT=y

# Mbedtls configuration
CONFIG_MBEDTLS_ENABLE_HEAP=y
CONFIG_MBEDTLS_HEAP_SIZE=8192
```

## boards/nrf54lv10dk_nrf54lv10a_cpuapp.conf
```kconfig
# Copyright (c) 2024 Nordic Semiconductor ASA
#
# SPDX-License-Identifier: LicenseRef-Nordic-5-Clause

CONFIG_PSA_CRYPTO_DRIVER_OBERON=n
CONFIG_PSA_CRYPTO_DRIVER_CRACEN=y

CONFIG_MBEDTLS_ENABLE_HEAP=y
CONFIG_MBEDTLS_HEAP_SIZE=8192
```

## src/main.c
```c
/*
 * Copyright (c) 2021 Nordic Semiconductor ASA
 *
 * SPDX-License-Identifier: LicenseRef-Nordic-5-Clause
 */

#include <zephyr/kernel.h>
#include <zephyr/sys/printk.h>
#include <zephyr/sys/util.h>
#include <stdio.h>
#include <stdlib.h>
#include <string.h>
#include <psa/crypto.h>
#include <psa/crypto_extra.h>
#include <zephyr/logging/log.h>

#ifdef CONFIG_BUILD_WITH_TFM
#include <tfm_ns_interface.h>
#endif

#define APP_SUCCESS		(0)
#define APP_ERROR		(-1)
#define APP_SUCCESS_MESSAGE "Example finished successfully!"
#define APP_ERROR_MESSAGE "Example exited with error!"

#define PRINT_HEX(p_label, p_text, len)\
	({\
		LOG_INF("---- %s (len: %u): ----", p_label, len);\
		LOG_HEXDUMP_INF(p_text, len, "Content:");\
		LOG_INF("---- %s end  ----", p_label);\
	})

LOG_MODULE_REGISTER(sha256, LOG_LEVEL_DBG);

/* ====================================================================== */
/*				Global variables/defines for the SHA256 example			  */

#define NRF_CRYPTO_EXAMPLE_SHA256_TEXT_SIZE (150)
#define NRF_CRYPTO_EXAMPLE_SHA256_SIZE (32)

/* Below text is used as plaintext for computing/verifying the hash. */
static uint8_t m_plain_text[NRF_CRYPTO_EXAMPLE_SHA256_TEXT_SIZE] = {
	"Example string to demonstrate basic usage of SHA256."
	"That uses single and multi-part PSA crypto API's to "
	"perform a SHA-256 hashing operation."
};

static uint8_t m_hash[NRF_CRYPTO_EXAMPLE_SHA256_SIZE];

/* ====================================================================== */

int crypto_init(void)
{
	psa_status_t status;

	/* Initialize PSA Crypto */
	status = psa_crypto_init();
	if (status != PSA_SUCCESS)
		return APP_ERROR;

	return APP_SUCCESS;
}

int hash_singlepart_sha256(void)
{
	uint32_t olen;
	psa_status_t status;

	LOG_INF("Hashing using SHA256...");

	/* Calculate the SHA256 hash */
	status = psa_hash_compute(
		PSA_ALG_SHA_256, m_plain_text, sizeof(m_plain_text), m_hash, sizeof(m_hash), &olen);
	if (status != PSA_SUCCESS) {
		LOG_INF("psa_hash_compute failed! (Error: %d)", status);
		return APP_ERROR;
	}

	LOG_INF("Hashing successful!");
	PRINT_HEX("SHA256 hash", m_hash, sizeof(m_hash));

	return APP_SUCCESS;
}

int hash_multipart_sha256(void)
{
	uint32_t olen;
	psa_status_t status;
	uint8_t *input_ptr = m_plain_text;
	psa_hash_operation_t hash_operation = {0};

	LOG_INF("Hashing using multi-part SHA256...");

	/* Setup a multipart hash operation */
	status = psa_hash_setup(&hash_operation, PSA_ALG_SHA_256);
	if (status != PSA_SUCCESS) {
		LOG_ERR("Could not setup the hash operation! Error %d", status);
		return APP_ERROR;
	}


	/* Feed the chunks of the input data to the PSA driver */
	status = psa_hash_update(&hash_operation, input_ptr, 42);
	if (status != PSA_SUCCESS) {
		LOG_ERR("Could not hash the next chunk! Error %d", status);
		return APP_ERROR;

	}
	LOG_INF("Added %d bytes", 42);
	input_ptr += 42;


	status = psa_hash_update(&hash_operation, input_ptr, 58);
	if (status != PSA_SUCCESS) {
		LOG_ERR("Could not hash the next chunk! Error %d", status);
		return APP_ERROR;

	}
	LOG_INF("Added %d bytes", 58);
	input_ptr += 58;

	status = psa_hash_update(&hash_operation, input_ptr, 50);
	if (status != PSA_SUCCESS) {
		LOG_ERR("Could not hash the next chunk! Error %d", status);
		return APP_ERROR;

	}
	LOG_INF("Added %d bytes", 50);

	status = psa_hash_finish(&hash_operation, m_hash, sizeof(m_hash), &olen);
	if (status != PSA_SUCCESS) {
		LOG_ERR("Could not finish the hash operation! Error %d", status);
		return APP_ERROR;
	}

	LOG_INF("Hashing successful!");
	PRINT_HEX("SHA256 hash", m_hash, sizeof(m_hash));

	return APP_SUCCESS;
}

int verify_sha256(void)
{
	psa_status_t status;

	LOG_INF("Verifying the SHA256 hash...");

	/* Verify the hash */
	status = psa_hash_compare(
		PSA_ALG_SHA_256, m_plain_text, sizeof(m_plain_text), m_hash, sizeof(m_hash));
	if (status != PSA_SUCCESS) {
		LOG_INF("psa_hash_compare failed! (Error: %d)", status);
		return APP_ERROR;
	}

	LOG_INF("SHA256 verification successful!");

	return APP_SUCCESS;
}

int main(void)
{
	int status;

	LOG_INF("Starting SHA256 example...");

	status = crypto_init();
	if (status != APP_SUCCESS) {
		LOG_INF(APP_ERROR_MESSAGE);
		return APP_ERROR;
	}

	PRINT_HEX("Plaintext to hash", m_plain_text, sizeof(m_plain_text));

	status = hash_singlepart_sha256();
	if (status != APP_SUCCESS) {
		LOG_INF(APP_ERROR_MESSAGE);
		return APP_ERROR;
	}

	status = verify_sha256();
	if (status != APP_SUCCESS) {
		LOG_INF(APP_ERROR_MESSAGE);
		return APP_ERROR;
	}

	/* Reset the hash */
	memset(m_hash, 0, sizeof(m_hash));

	status = hash_multipart_sha256();
	if (status != APP_SUCCESS) {
		LOG_INF(APP_ERROR_MESSAGE);
		return APP_ERROR;
	}

	status = verify_sha256();
	if (status != APP_SUCCESS) {
		LOG_INF(APP_ERROR_MESSAGE);
		return APP_ERROR;
	}

	LOG_INF(APP_SUCCESS_MESSAGE);

	return APP_SUCCESS;
}
```
