## CMakeLists.txt
```
#
# Copyright (c) 2021 Nordic Semiconductor
#
# SPDX-License-Identifier: LicenseRef-Nordic-5-Clause
#

cmake_minimum_required(VERSION 3.20.0)

find_package(Zephyr REQUIRED HINTS $ENV{ZEPHYR_BASE})
project("Application Event Manager Profiler sample")

# Include application application event headers
zephyr_library_include_directories(src/events)

# Application sources
# NORDIC SDK APP START
target_sources(app PRIVATE src/main.c)

target_sources(app PRIVATE
		src/events/five_sec_event.c
		src/events/config_event.c
		src/events/one_sec_event.c
		src/events/burst_event.c
)

target_sources(app PRIVATE
		src/modules/module_a.c
		src/modules/module_b.c
)
# NORDIC SDK APP END
```

## sample.yaml
```
sample:
  description: Sample showing usage of profiling Application Event Manager events
  name: Application Event Manager profiler tracer sample
tests:
  sample.app_event_manager_profiler_tracer:
    sysbuild: true
    build_only: true
    platform_exclude: native_sim
    platform_allow:
      - nrf52dk/nrf52832
      - nrf52840dk/nrf52840
      - nrf9160dk/nrf9160/ns
      - nrf21540dk/nrf52840
    integration_platforms:
      - nrf52dk/nrf52832
      - nrf52840dk/nrf52840
      - nrf9160dk/nrf9160/ns
      - nrf21540dk/nrf52840
    tags:
      - ci_build
      - sysbuild
      - ci_samples_app_event_manager_profiler_tracer
```

## prj.conf
```kconfig
#
# Copyright (c) 2021 Nordic Semiconductor ASA
#
# SPDX-License-Identifier: LicenseRef-Nordic-5-Clause
#
# Enabling assert
CONFIG_ASSERT=y

# Logger configuration
CONFIG_LOG=y
CONFIG_LOG_DEFAULT_LEVEL=2
CONFIG_LOG_BACKEND_UART=y

# Configuration required by Application Event Manager
CONFIG_APP_EVENT_MANAGER=y
CONFIG_HEAP_MEM_POOL_SIZE=2048
CONFIG_REBOOT=y

# Configuration required by Application Event Manager profiler tracer
CONFIG_APP_EVENT_MANAGER_PROFILER_TRACER=y
CONFIG_APP_EVENT_MANAGER_PROFILER_TRACER_PROFILE_EVENT_DATA=y
```

## src/main.c
```c
/*
 * Copyright (c) 2021 Nordic Semiconductor ASA
 *
 * SPDX-License-Identifier: LicenseRef-Nordic-5-Clause
 */

#include <app_event_manager.h>
#include <config_event.h>
#include <zephyr/logging/log.h>

#define MODULE main

LOG_MODULE_REGISTER(MODULE);

int main(void)
{
	if (app_event_manager_init()) {
		LOG_ERR("Application Event Manager not initialized");
	} else {
		struct config_event *event = new_config_event();

		APP_EVENT_SUBMIT(event);
	}
	return 0;
}
```
