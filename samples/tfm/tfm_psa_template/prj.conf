## CMakeLists.txt
```
#
# Copyright (c) 2020 Nordic Semiconductor ASA
#
# SPDX-License-Identifier: LicenseRef-Nordic-5-Clause
#

cmake_minimum_required(VERSION 3.20.0)

find_package(Zephyr REQUIRED HINTS $ENV{ZEPHYR_BASE})

project(tfm_psa_template)

# NORDIC SDK APP START
target_sources(app PRIVATE src/main.c)
# NORDIC SDK APP END


target_include_directories(app PRIVATE
  $<TARGET_PROPERTY:tfm,TFM_BINARY_DIR>/api_ns/interface/include
)
```

## Kconfig.sysbuild
```
#
# Copyright (c) 2024 Nordic Semiconductor
#
# SPDX-License-Identifier: LicenseRef-Nordic-5-Clause
#

source "share/sysbuild/Kconfig"

if BOARD_NRF5340DK_NRF5340_CPUAPP_NS

choice NETCORE
	default NETCORE_EMPTY
endchoice

config SECURE_BOOT_NETCORE
	default y

config NETCORE_APP_UPDATE
	default y

config MCUBOOT_APP_SYNC_UPDATEABLE_IMAGES
	default y

config PM_EXTERNAL_FLASH_MCUBOOT_SECONDARY
	default y

config MCUBOOT_USE_ALL_AVAILABLE_RAM
	default y

endif
```

## sample.yaml
```
sample:
  description: TF-M PSA Template
  name: TF-M PSA Template
common:
  tags:
    - tfm
    - ci_samples_tfm
  platform_allow:
    - nrf5340dk/nrf5340/cpuapp/ns
    - nrf9151dk/nrf9151/ns
    - nrf9160dk/nrf9160/ns
    - nrf9161dk/nrf9161/ns
  integration_platforms:
    - nrf5340dk/nrf5340/cpuapp/ns
    - nrf9151dk/nrf9151/ns
    - nrf9160dk/nrf9160/ns
    - nrf9161dk/nrf9161/ns
tests:
  sample.tfm.psa_template:
    sysbuild: true
    tags:
      - ci_build
      - sysbuild
      - ci_samples_tfm
    build_only: true
```

## sysbuild.conf
```
#
# Copyright (c) 2023 Nordic Semiconductor
#
# SPDX-License-Identifier: LicenseRef-Nordic-5-Clause
#

SB_CONFIG_BOOTLOADER_MCUBOOT=y
SB_CONFIG_SECURE_BOOT_APPCORE=y
SB_CONFIG_BOOT_SIGNATURE_TYPE_ECDSA_P256=y
SB_CONFIG_MCUBOOT_MODE_OVERWRITE_ONLY=y
SB_CONFIG_APPROTECT_LOCK=y
SB_CONFIG_SECURE_APPROTECT_LOCK=y
SB_CONFIG_TFM_OTP_PSA_CERTIFICATE_REFERENCE=y
```

## prj.conf
```kconfig
#
# Copyright (c) 2020 Nordic Semiconductor ASA
#
# SPDX-License-Identifier: LicenseRef-Nordic-5-Clause
#

CONFIG_TFM_PROFILE_TYPE_NOT_SET=y

CONFIG_TFM_LOG_LEVEL_SILENCE=n
CONFIG_TFM_SPM_LOG_LEVEL_DEBUG=y
CONFIG_TFM_EXCEPTION_INFO_DUMP=y

CONFIG_TFM_PARTITION_INITIAL_ATTESTATION=y
CONFIG_TFM_NRF_PROVISIONING=y
CONFIG_IDENTITY_KEY_TFM=y

CONFIG_SECURE_BOOT=y

# Enable mcumgr.
CONFIG_MCUMGR=y
CONFIG_NET_BUF=y
CONFIG_ZCBOR=y
CONFIG_CRC=y
CONFIG_FLASH=y
CONFIG_FLASH_MAP=y
CONFIG_STREAM_FLASH=y
CONFIG_IMG_MANAGER=y
CONFIG_BASE64=y

# Some command handlers require a large stack.
CONFIG_SYSTEM_WORKQUEUE_STACK_SIZE=2304
CONFIG_MAIN_STACK_SIZE=2048

# Enable MCUboot so the application is built as MCUboot-compatible image
CONFIG_BOOTLOADER_MCUBOOT=y

# Enable flash operations.
CONFIG_FLASH=y

# Required by the `taskstat` command.
CONFIG_THREAD_MONITOR=y

# Support for taskstat command
CONFIG_MCUMGR_GRP_OS_TASKSTAT=y

# Enable statistics and statistic names.
CONFIG_STATS=y
CONFIG_STATS_NAMES=y

# Enable most core commands.
CONFIG_MCUMGR_GRP_IMG=y
CONFIG_MCUMGR_GRP_OS=y
CONFIG_MCUMGR_GRP_STAT=y

# Enable logging
CONFIG_LOG=y
CONFIG_MCUBOOT_UTIL_LOG_LEVEL_WRN=y

# Enable the serial mcumgr transport.
CONFIG_MCUMGR_TRANSPORT_UART=y

# Ensure clean log output
CONFIG_LOG_MODE_IMMEDIATE=y

# Enable TFM isolation level 2
CONFIG_TFM_ISOLATION_LEVEL=2

# Initial Attestation requires RNG
CONFIG_PSA_WANT_GENERATE_RANDOM=y

# Optional attestation token fields
CONFIG_TFM_ATTEST_VERIFICATION_SERVICE_URL="verification_url"
```

## boards/nrf5340dk_nrf5340_cpuapp_ns.conf
```kconfig
#
# Copyright (c) 2024 Nordic Semiconductor ASA
#
# SPDX-License-Identifier: LicenseRef-Nordic-5-Clause
#

CONFIG_FPU=y
CONFIG_BOARD_ENABLE_CPUNET=y
CONFIG_PM_PARTITION_SIZE_TFM_SRAM=0x16000
```

## boards/nrf54l15dk_nrf54l15_cpuapp_ns.conf
```kconfig
CONFIG_SPI_NOR=n
CONFIG_PM_PARTITION_SIZE_TFM=0x50800

# Since provisioning is not supported for the nRF54L15 yet,
# we will use dummy provisioning for now.
CONFIG_TFM_NRF_PROVISIONING=n
CONFIG_TFM_DUMMY_PROVISIONING=y
```

## boards/nrf9160dk_nrf9160_ns.conf
```kconfig
#
# Copyright (c) 2022 Nordic Semiconductor ASA
#
# SPDX-License-Identifier: LicenseRef-Nordic-5-Clause
#

CONFIG_FPU=y
```

## src/main.c
```c
/*
 * Copyright (c) 2020 Nordic Semiconductor ASA.
 *
 * SPDX-License-Identifier: LicenseRef-Nordic-5-Clause
 */

#include <zephyr/kernel.h>
#include <zephyr/stats/stats.h>
#include <zephyr/sys/printk.h>
#include <tfm_ns_interface.h>
#include "psa/initial_attestation.h"
#include <tfm_ioctl_api.h>
#include <pm_config.h>
#include <ctype.h>

/* Define an example stats group; approximates seconds since boot. */
STATS_SECT_START(smp_svr_stats)
STATS_SECT_ENTRY(ticks)
STATS_SECT_END;

/* Assign a name to the `ticks` stat. */
STATS_NAME_START(smp_svr_stats)
STATS_NAME(smp_svr_stats, ticks)
STATS_NAME_END(smp_svr_stats);

/* Define an instance of the stats group. */
STATS_SECT_DECL(smp_svr_stats) smp_svr_stats;

void dump_hex_ascii(const uint8_t *data, size_t size)
{
	char ascii[17];
	size_t i, j;

	ascii[16] = '\0';

	printk("\n");
	printk("0  1  2  3  4  5  6  7   8  9  A  B  C  D  E  F\n");

	for (i = 0; i < size; ++i) {
		printk("%02X ", ((unsigned char *)data)[i]);

		ascii[i % 16] = isprint(data[i]) ? data[i] : '.';

		if ((i + 1) % 8 == 0 || i + 1 == size) {
			printk(" ");
			if ((i + 1) % 16 == 0) {
				printk("|  %s\n", ascii);
			} else if ((i + 1) == size) {
				ascii[(i + 1) % 16] = '\0';

				if ((i + 1) % 16 <= 8) {
					printk(" ");
				}

				for (j = (i + 1) % 16; j < 16; ++j) {
					printk("   ");
				}
				printk("|  %s\n", ascii);
			}
		}
	}

	printk("\n");
}

static void get_fw_info_address(uint32_t fw_address)
{
	struct fw_info info;
	int err;

	err = tfm_platform_firmware_info(fw_address, &info);
	if (err) {
		printk("Failed to retrieve fw_info for address 0x%08x\n", fw_address);
		return;
	}

	printk("Magic: 0x");
	for (int i = 0; i < MAGIC_LEN_WORDS; i++) {
		printk("%08x", info.magic[i]);
	}
	printk("\n");

	printk("Total Size: %d\n", info.total_size);
	printk("Size: 0x%08x\n", info.size);
	printk("Version: %u\n", info.version);
	printk("Address: 0x%08x\n", info.address);
	printk("Boot address: 0x%08x\n", info.boot_address);
	printk("Valid: 0x%08x (CONFIG_FW_INFO_VALID_VAL=0x%08x)\n", info.valid,
	       CONFIG_FW_INFO_VALID_VAL);
}

static void get_fw_info(void)
{
	bool s0_active = false;
	int ret;

	ret = tfm_platform_s0_active(PM_S0_ADDRESS, PM_S1_ADDRESS, &s0_active);
	if (ret != 0) {
		printk("Unexpected failure from tfm_platform_s0_active [%d]\n", ret);
	}

	printk("\nFW info S0:\n");
	get_fw_info_address(PM_S0_ADDRESS);

	printk("\nFW info S1:\n");
	get_fw_info_address(PM_S1_ADDRESS);

	printk("\nActive slot: %s\n", s0_active ? "S0" : "S1");
}

static void get_attestation_token(void)
{
	printk("\n");

	static uint8_t token_buf[PSA_INITIAL_ATTEST_MAX_TOKEN_SIZE];
	int err;

	/* 64-byte challenge, encrypted using the default public key;
	 *
	 * 00 11 22 33 44 55 66 77 88 99 AA BB CC DD EE FF
	 * 00 11 22 33 44 55 66 77 88 99 AA BB CC DD EE FF
	 * 00 11 22 33 44 55 66 77 88 99 AA BB CC DD EE FF
	 * 00 11 22 33 44 55 66 77 88 99 AA BB CC DD EE FF
	 */
	static uint8_t challenge_buf[PSA_INITIAL_ATTEST_CHALLENGE_SIZE_64] = {
		0x00, 0x11, 0x22, 0x33, 0x44, 0x55, 0x66, 0x77, 0x88, 0x99, 0xAA, 0xBB, 0xCC,
		0xDD, 0xEE, 0xFF, 0x00, 0x11, 0x22, 0x33, 0x44, 0x55, 0x66, 0x77, 0x88, 0x99,
		0xAA, 0xBB, 0xCC, 0xDD, 0xEE, 0xFF, 0x00, 0x11, 0x22, 0x33, 0x44, 0x55, 0x66,
		0x77, 0x88, 0x99, 0xAA, 0xBB, 0xCC, 0xDD, 0xEE, 0xFF, 0x00, 0x11, 0x22, 0x33,
		0x44, 0x55, 0x66, 0x77, 0x88, 0x99, 0xAA, 0xBB, 0xCC, 0xDD, 0xEE, 0xFF,
	};

	size_t challenge_buf_size = sizeof(challenge_buf);
	size_t token_buf_size = sizeof(token_buf);
	size_t token_size;

	/* Request the initial attestation token w/the challenge data. */
	printk("Requesting initial attestation token with %u byte challenge.\n",
	       challenge_buf_size);
	err = psa_initial_attest_get_token(challenge_buf, challenge_buf_size, token_buf,
					   token_buf_size, &token_size);

	if (err) {
		printk("psa_initial_attest_get_token (err %d)\n", err);
	} else {
		printk("Received initial attestation token of %zu bytes.\n", token_size);

		dump_hex_ascii(token_buf, token_size);
	}
}

int main(void)
{
	int err;

	err = STATS_INIT_AND_REG(smp_svr_stats, STATS_SIZE_32, "smp_svr_stats");
	if (err < 0) {
		printk("Error initializing stats system [%d]\n", err);
	}

	/* using __TIME__ ensure that a new binary will be built on every
	 * compile which is convenient when testing firmware upgrade.
	 */
	printk("build time: " __DATE__ " " __TIME__ "\n");

	get_fw_info();
	get_attestation_token();

	/* The system work queue handles all incoming mcumgr requests.  Let the
	 * main thread idle while the mcumgr server runs.
	 */
	while (1) {
		k_sleep(K_MSEC(1000));
		STATS_INC(smp_svr_stats, ticks);
	}
}
```
