## CMakeLists.txt
```
#
# Copyright (c) 2022 Nordic Semiconductor ASA
#
# SPDX-License-Identifier: LicenseRef-Nordic-5-Clause
#

cmake_minimum_required(VERSION 3.20.0)

find_package(Zephyr REQUIRED HINTS $ENV{ZEPHYR_BASE})
project(nrf_wifi_shell)

target_sources_ifdef(CONFIG_NRF70_RAW_DATA_TX
	app
	PRIVATE
	src/wifi_raw_tx_pkt_shell.c)

target_sources_ifdef(CONFIG_NRF70_PROMISC_DATA_RX
	app
	PRIVATE
	src/wifi_promiscuous_shell.c)

target_sources(app PRIVATE src/main.c)
```

## Kconfig
```
#
# Copyright (c) 2024 Nordic Semiconductor
#
# SPDX-License-Identifier: LicenseRef-Nordic-5-Clause
#

menu "Nordic Shell sample"

if NET_BUF_FIXED_DATA_SIZE

config NET_BUF_DATA_SIZE
	default 1100

endif

# Configure variable network buffer pool sizes for TX and RX
if NET_BUF_VARIABLE_DATA_SIZE

# nRF52 and nRF54 Series targets have less memory
# so smaller pool sizes are recommended for these targets.
config NET_PKT_BUF_TX_DATA_POOL_SIZE
	default 40000 if SOC_SERIES_NRF54HX
	default 50000 if !SOC_SERIES_NRF52X && !SOC_SERIES_NRF54LX

config NET_PKT_BUF_RX_DATA_POOL_SIZE
	default 20000 if !SOC_SERIES_NRF52X && !SOC_SERIES_NRF54LX

endif

source "Kconfig.zephyr"

endmenu
```

## sample.yaml
```
sample:
  description: Wi-Fi shell sample application
  name: Wi-Fi shell
tests:
  sample.nrf7002.shell:
    sysbuild: true
    build_only: true
    integration_platforms:
      - nrf7002dk/nrf5340/cpuapp
    platform_allow: nrf7002dk/nrf5340/cpuapp
    tags:
      - ci_build
      - sysbuild
      - ci_samples_wifi
  # Disable optional features to reduce memory usage
  sample.nrf7002.shell.disable_adv_features:
    sysbuild: true
    build_only: true
    extra_args: -DCONFIG_WIFI_NM_WPA_SUPPLICANT_ADVANCED_FEATURES=n
    integration_platforms:
      - nrf7002dk/nrf5340/cpuapp
    platform_allow: nrf7002dk/nrf5340/cpuapp
    tags:
      - ci_build
      - sysbuild
      - ci_samples_wifi
  sample.nrf7001.shell:
    sysbuild: true
    build_only: true
    integration_platforms:
      - nrf7002dk/nrf5340/cpuapp/nrf7001
    platform_allow: nrf7002dk/nrf5340/cpuapp/nrf7001
    tags:
      - ci_build
      - sysbuild
      - ci_samples_wifi
  sample.nrf7002_eks.shell:
    sysbuild: true
    build_only: true
    extra_args: SHIELD=nrf7002ek
    integration_platforms:
      - nrf5340dk/nrf5340/cpuapp
      - nrf52840dk/nrf52840
    platform_allow:
      - nrf5340dk/nrf5340/cpuapp
      - nrf52840dk/nrf52840
    tags:
      - ci_build
      - sysbuild
      - ci_samples_wifi
  sample.nrf7000_eks.shell:
    sysbuild: true
    build_only: true
    extra_args:
      - SHIELD=nrf7002ek_nrf7000
      - CONFIG_WIFI_NM_WPA_SUPPLICANT=n
      - SB_CONFIG_WIFI_NRF70_SCAN_ONLY=y
    integration_platforms:
      - nrf5340dk/nrf5340/cpuapp
      - nrf52840dk/nrf52840
    platform_allow:
      - nrf5340dk/nrf5340/cpuapp
      - nrf52840dk/nrf52840
    tags:
      - ci_build
      - sysbuild
      - ci_samples_wifi
  sample.nrf7001_eks.shell:
    sysbuild: true
    build_only: true
    extra_args: SHIELD=nrf7002ek_nrf7001
    integration_platforms:
      - nrf5340dk/nrf5340/cpuapp
      - nrf52840dk/nrf52840
    platform_allow:
      - nrf5340dk/nrf5340/cpuapp
      - nrf52840dk/nrf52840
    tags:
      - ci_build
      - sysbuild
      - ci_samples_wifi
  sample.nrf7002_eks_cpunet.shell:
    sysbuild: true
    build_only: true
    extra_args:
      - SHIELD=nrf7002ek
      - CONFIG_SOC_NRF53_CPUNET_ENABLE=y
    integration_platforms:
      - nrf5340dk/nrf5340/cpuapp
    platform_allow: nrf5340dk/nrf5340/cpuapp
    tags:
      - ci_build
      - sysbuild
      - ci_samples_wifi
  sample.nrf7000_eks_cpunet.shell:
    sysbuild: true
    build_only: true
    extra_args:
      - SHIELD=nrf7002ek_nrf7000
      - CONFIG_SOC_NRF53_CPUNET_ENABLE=y
      - CONFIG_WIFI_NM_WPA_SUPPLICANT=n
      - SB_CONFIG_WIFI_NRF70_SCAN_ONLY=y
    integration_platforms:
      - nrf5340dk/nrf5340/cpuapp
    platform_allow: nrf5340dk/nrf5340/cpuapp
    tags:
      - ci_build
      - sysbuild
      - ci_samples_wifi
  sample.nrf7001_eks_cpunet.shell:
    sysbuild: true
    build_only: true
    extra_args:
      - SHIELD=nrf7002ek_nrf7001
      - CONFIG_SOC_NRF53_CPUNET_ENABLE=y
    integration_platforms:
      - nrf5340dk/nrf5340/cpuapp
    platform_allow: nrf5340dk/nrf5340/cpuapp
    tags:
      - ci_build
      - sysbuild
      - ci_samples_wifi
  sample.nrf7002.shell.zperf:
    sysbuild: true
    build_only: true
    extra_args: EXTRA_CONF_FILE=overlay-zperf.conf
    integration_platforms:
      - nrf7002dk/nrf5340/cpuapp
    platform_allow: nrf7002dk/nrf5340/cpuapp
    tags:
      - ci_build
      - sysbuild
      - ci_samples_wifi
  sample.nrf7001.shell.zperf:
    sysbuild: true
    build_only: true
    extra_args: EXTRA_CONF_FILE=overlay-zperf.conf
    integration_platforms:
      - nrf7002dk/nrf5340/cpuapp/nrf7001
    platform_allow: nrf7002dk/nrf5340/cpuapp/nrf7001
    tags:
      - ci_build
      - sysbuild
      - ci_samples_wifi
  sample.nrf7002.shell.wpa_cli:
    sysbuild: true
    build_only: true
    extra_args: CONFIG_WPA_CLI=y
    integration_platforms:
      - nrf7002dk/nrf5340/cpuapp
    platform_allow: nrf7002dk/nrf5340/cpuapp
    tags:
      - ci_build
      - sysbuild
      - ci_samples_wifi
  sample.nrf7001.shell.wpa_cli:
    sysbuild: true
    build_only: true
    extra_args: CONFIG_WPA_CLI=y
    integration_platforms:
      - nrf7002dk/nrf5340/cpuapp/nrf7001
    platform_allow: nrf7002dk/nrf5340/cpuapp/nrf7001
    tags:
      - ci_build
      - sysbuild
      - ci_samples_wifi
  sample.nrf7002.shell.scan_only_7002:
    sysbuild: true
    build_only: true
    extra_args:
      - EXTRA_CONF_FILE=overlay-scan-only.conf
      - SB_CONFIG_WIFI_NRF70_SCAN_ONLY=y
    integration_platforms:
      - nrf7002dk/nrf5340/cpuapp
    platform_allow: nrf7002dk/nrf5340/cpuapp
    tags:
      - ci_build
      - sysbuild
      - ci_samples_wifi
  sample.nrf7000.shell.scan_only_91:
    sysbuild: true
    build_only: true
    extra_args:
      - EXTRA_CONF_FILE=overlay-scan-only.conf
      - SHIELD=nrf7002ek_nrf7000
      - CONFIG_WIFI_NM_WPA_SUPPLICANT=n
      - SB_CONFIG_WIFI_NRF70_SCAN_ONLY=y
    integration_platforms:
      - nrf9160dk/nrf9160/ns
      - nrf9161dk/nrf9161/ns
    platform_allow:
      - nrf9160dk/nrf9160/ns
      - nrf9161dk/nrf9161/ns
      - nrf9151dk/nrf9151/ns
    tags:
      - ci_build
      - sysbuild
      - ci_samples_wifi
  sample.nrf7002.shell.scan_only_thingy91x:
    sysbuild: true
    build_only: true
    extra_args:
      - EXTRA_CONF_FILE=overlay-scan-only.conf
      - SB_CONFIG_WIFI_NRF70_SCAN_ONLY=y
    platform_allow:
      - thingy91x/nrf9151/ns
    tags:
      - ci_build
      - sysbuild
      - ci_samples_wifi
  sample.nrf7002.shell.full_stack_thingy91x:
    sysbuild: true
    build_only: true
    extra_args: SB_CONFIG_THINGY91X_STATIC_PARTITIONS_NRF53_EXTERNAL_FLASH=y
    platform_allow:
      - thingy91x/nrf5340/cpuapp
    tags:
      - ci_build
      - sysbuild
      - ci_samples_wifi
  sample.nrf7002.shell.otbr:
    sysbuild: true
    build_only: true
    extra_args: EXTRA_CONF_FILE=overlay-openthread.conf
    integration_platforms:
      - nrf7002dk/nrf5340/cpuapp
    platform_allow: nrf7002dk/nrf5340/cpuapp
    tags:
      - ci_build
      - sysbuild
      - ci_samples_wifi
  sample.nrf7002_ns.shell:
    sysbuild: true
    build_only: true
    platform_allow: nrf7002dk/nrf5340/cpuapp/ns
    tags:
      - sysbuild
      - ci_samples_wifi
  sample.nrf7002_eb.thingy53.shell:
    sysbuild: true
    build_only: true
    extra_args:
      - shell_SHIELD=nrf7002eb
      - CONFIG_SOC_NRF53_CPUNET_ENABLE=y
    integration_platforms:
      - thingy53/nrf5340/cpuapp
    platform_allow: thingy53/nrf5340/cpuapp
    tags:
      - ci_build
      - sysbuild
      - ci_samples_wifi
  sample.qspi.ext_flash_xip:
    sysbuild: true
    build_only: true
    extra_args:
      - shell_SHIELD=nrf7002ek
      - SB_CONFIG_WIFI_PATCHES_EXT_FLASH_XIP=y
      - SB_CONFIG_PARTITION_MANAGER=n
    integration_platforms:
      - nrf5340dk/nrf5340/cpuapp
      - nrf52840dk/nrf52840
    platform_allow:
      - nrf5340dk/nrf5340/cpuapp
      - nrf52840dk/nrf52840
    tags:
      - ci_build
      - sysbuild
      - ci_samples_wifi
  sample.qspi.ext_flash_store:
    sysbuild: true
    build_only: true
    extra_args:
      - shell_SHIELD=nrf7002ek
      - shell_SNIPPET=nrf70-fw-patch-ext-flash
    integration_platforms:
      - nrf5340dk/nrf5340/cpuapp
      - nrf52840dk/nrf52840
    platform_allow:
      - nrf5340dk/nrf5340/cpuapp
      - nrf52840dk/nrf52840
    tags:
      - ci_build
      - sysbuild
      - ci_samples_wifi
  sample.spi.ext_flash_store:
    sysbuild: true
    build_only: true
    extra_args:
      - SNIPPET=nrf70-fw-patch-ext-flash
    integration_platforms:
      - nrf7002dk/nrf5340/cpuapp
    platform_allow:
      - nrf7002dk/nrf5340/cpuapp
    tags:
      - ci_build
      - sysbuild
      - ci_samples_wifi
  sample.nrf7002eb_interposer_p1.nrf7002eb.shell:
    sysbuild: true
    build_only: true
    extra_args:
      - shell_SHIELD="nrf7002eb_interposer_p1;nrf7002eb"
      - shell_SNIPPET=nrf70-wifi
    integration_platforms:
      - nrf54h20dk/nrf54h20/cpuapp
      - nrf54l15dk/nrf54l15/cpuapp
    platform_allow:
      - nrf54h20dk/nrf54h20/cpuapp
      - nrf54l15dk/nrf54l15/cpuapp
    tags:
      - ci_build
      - sysbuild
      - ci_samples_wifi
  sample.nrf7002eb_interposer_p1.nrf7002eb.shell.superset:
    sysbuild: true
    build_only: true
    extra_args:
      - shell_SHIELD="nrf7002eb_interposer_p1;nrf7002eb"
      - shell_SNIPPET=nrf70-wifi
      - EXTRA_CONF_FILE=overlay-zperf.conf
      - CONFIG_NRF70_UTIL=y
      - CONFIG_WPA_CLI=y
      - CONFIG_NET_IPV4_FRAGMENT=y
      - CONFIG_NET_IPV4_FRAGMENT_MAX_PKT=24
      - CONFIG_NRF_WIFI_DATA_HEAP_SIZE=199000
    integration_platforms:
      - nrf54h20dk/nrf54h20/cpuapp
    platform_allow:
      - nrf54h20dk/nrf54h20/cpuapp
    tags:
      - ci_build
      - sysbuild
      - ci_samples_wifi
  sample.nrf7002eb2.shell:
    sysbuild: true
    build_only: true
    extra_args:
      - shell_SHIELD="nrf7002eb2"
      - shell_SNIPPET=nrf70-wifi
    integration_platforms:
      - nrf54h20dk/nrf54h20/cpuapp
      - nrf54l15dk/nrf54l15/cpuapp
    platform_allow:
      - nrf54h20dk/nrf54h20/cpuapp
      - nrf54l15dk/nrf54l15/cpuapp
    tags:
      - ci_build
      - sysbuild
      - ci_samples_wifi
  # Used by QA and also acts as a memory stress test
  sample.nrf7001.superset:
    sysbuild: true
    build_only: true
    extra_args:
      - EXTRA_CONF_FILE=overlay-zperf.conf
      - CONFIG_NRF70_UTIL=y
      - CONFIG_WPA_CLI=y
      - CONFIG_NET_IPV4_FRAGMENT=y
      - CONFIG_NET_IPV4_FRAGMENT_MAX_PKT=24
    integration_platforms:
      - nrf7002dk/nrf5340/cpuapp/nrf7001
    platform_allow: nrf7002dk/nrf5340/cpuapp/nrf7001
    tags:
      - ci_build_superset
      - sysbuild
      - ci_samples_wifi
  # Used by QA and also acts as a memory stress test
  sample.nrf7001_ek.superset:
    sysbuild: true
    build_only: true
    extra_args:
      - SHIELD=nrf7002ek_nrf7001
      - EXTRA_CONF_FILE=overlay-zperf.conf
      - CONFIG_NRF70_UTIL=y
      - CONFIG_WPA_CLI=y
      - CONFIG_NET_IPV4_FRAGMENT=y
      - CONFIG_NET_IPV4_FRAGMENT_MAX_PKT=24
    integration_platforms:
      - nrf5340dk/nrf5340/cpuapp
    platform_allow: nrf5340dk/nrf5340/cpuapp
    tags:
      - ci_build_superset
      - sysbuild
      - ci_samples_wifi
  # Used by QA and also acts as a memory stress test
  sample.nrf7002.superset:
    sysbuild: true
    build_only: true
    extra_args:
      - EXTRA_CONF_FILE=overlay-zperf.conf
      - CONFIG_NRF70_UTIL=y
      - CONFIG_WPA_CLI=y
      - CONFIG_NET_IPV4_FRAGMENT=y
      - CONFIG_NET_IPV4_FRAGMENT_MAX_PKT=24
    integration_platforms:
      - nrf7002dk/nrf5340/cpuapp
    platform_allow: nrf7002dk/nrf5340/cpuapp
    tags:
      - ci_build_superset
      - sysbuild
      - ci_samples_wifi
  # Used by QA and also acts as a memory stress test
  sample.nrf7002_ek.superset:
    sysbuild: true
    build_only: true
    extra_args:
      - SHIELD=nrf7002ek
      - EXTRA_CONF_FILE=overlay-zperf.conf
      - CONFIG_NRF70_UTIL=y
      - CONFIG_WPA_CLI=y
      - CONFIG_NET_IPV4_FRAGMENT=y
      - CONFIG_NET_IPV4_FRAGMENT_MAX_PKT=24
    integration_platforms:
      - nrf5340dk/nrf5340/cpuapp
    platform_allow: nrf5340dk/nrf5340/cpuapp
    tags:
      - ci_build_superset
      - sysbuild
      - ci_samples_wifi
  sample.nrf7002.superset.debug:
    sysbuild: true
    build_only: true
    extra_args:
      - shell_SNIPPET="nrf70-driver-verbose-debug;wpa-supplicant-debug"
      - EXTRA_CONF_FILE=overlay-zperf.conf
      - CONFIG_NRF70_UTIL=y
      - CONFIG_WPA_CLI=y
      - CONFIG_NET_IPV4_FRAGMENT=y
      - CONFIG_NET_IPV4_FRAGMENT_MAX_PKT=24
    integration_platforms:
      - nrf7002dk/nrf5340/cpuapp
    platform_allow: nrf7002dk/nrf5340/cpuapp
    tags:
      - ci_build_superset
      - sysbuild
      - ci_samples_wifi
  sample.nrf7002.enterprise_mode:
    sysbuild: true
    build_only: true
    extra_args: shell_SNIPPET=wifi-enterprise
    integration_platforms:
      - nrf7002dk/nrf5340/cpuapp
    platform_allow: nrf7002dk/nrf5340/cpuapp
    tags:
      - ci_build
      - sysbuild
      - ci_samples_wifi
  sample.nrf7002.ap:
    sysbuild: true
    build_only: true
    extra_args: EXTRA_CONF_FILE=overlay-sap.conf
    integration_platforms:
      - nrf7002dk/nrf5340/cpuapp
    platform_allow: nrf7002dk/nrf5340/cpuapp
    tags:
      - ci_build
      - sysbuild
      - ci_samples_wifi
  sample.nrf7002.with_overlay_raw_tx_packet:
    sysbuild: true
    build_only: true
    extra_args:
      - EXTRA_CONF_FILE=overlay-raw-tx.conf
      - SB_CONFIG_WIFI_NRF70_SYSTEM_WITH_RAW_MODES=y
    integration_platforms:
      - nrf7002dk/nrf5340/cpuapp
    platform_allow: nrf7002dk/nrf5340/cpuapp
    tags:
      - ci_build
      - sysbuild
      - ci_samples_wifi
  sample.nrf7002.with_overlay_monitor:
    sysbuild: true
    build_only: true
    extra_args:
      - EXTRA_CONF_FILE=overlay-monitor-mode.conf
      - SB_CONFIG_WIFI_NRF70_SYSTEM_WITH_RAW_MODES=y
    integration_platforms:
      - nrf7002dk/nrf5340/cpuapp
    platform_allow: nrf7002dk/nrf5340/cpuapp
    tags:
      - ci_build
      - sysbuild
      - ci_samples_wifi
  sample.nrf7002.promiscuous_mode:
    sysbuild: true
    build_only: true
    extra_args:
      - EXTRA_CONF_FILE=overlay-promiscuous-mode.conf
      - SB_CONFIG_WIFI_NRF70_SYSTEM_WITH_RAW_MODES=y
    integration_platforms:
      - nrf7002dk/nrf5340/cpuapp
    platform_allow: nrf7002dk/nrf5340/cpuapp
    tags:
      - ci_build
      - sysbuild
      - ci_samples_wifi
  sample.nrf7001.promiscuous_mode_7001:
    sysbuild: true
    build_only: true
    extra_args:
      - EXTRA_CONF_FILE=overlay-promiscuous-mode.conf
      - SB_CONFIG_WIFI_NRF70_SYSTEM_WITH_RAW_MODES=y
    integration_platforms:
      - nrf7002dk/nrf5340/cpuapp/nrf7001
    platform_allow: nrf7002dk/nrf5340/cpuapp/nrf7001
    tags:
      - ci_build
      - sysbuild
      - ci_samples_wifi
  sample.nrf7002.shell.psa:
    build_only: true
    extra_args: CONFIG_HOSTAP_CRYPTO_ALT_LEGACY_PSA=y
    integration_platforms:
      - nrf7002dk/nrf5340/cpuapp
    platform_allow: nrf7002dk/nrf5340/cpuapp
    tags:
      - ci_build
      - sysbuild
      - ci_samples_wifi
  sample.nrf54l15.softap.superset:
    sysbuild: true
    build_only: true
    extra_args:
      - softap_SHIELD="nrf7002eb_interposer_p1;nrf7002eb"
      - softap_SNIPPET=nrf70-wifi
      - CONFIG_HEAP_MEM_POOL_IGNORE_MIN=n
    integration_platforms:
      - nrf54l15dk/nrf54l15/cpuapp
    platform_allow:
      - nrf54l15dk/nrf54l15/cpuapp
    tags:
      - ci_build
      - sysbuild
      - ci_samples_wifi
```

## prj.conf
```kconfig
#
# Copyright (c) 2022 Nordic Semiconductor ASA
#
# SPDX-License-Identifier: LicenseRef-Nordic-5-Clause
#
CONFIG_WIFI=y
CONFIG_WIFI_NRF70=y

# WPA supplicant
CONFIG_WIFI_NM_WPA_SUPPLICANT=y
CONFIG_NET_L2_WIFI_SHELL=y

# Networking
CONFIG_NETWORKING=y
CONFIG_NET_SOCKETS=y
CONFIG_NET_LOG=y
CONFIG_NET_IPV6=y
CONFIG_NET_IPV4=y
CONFIG_NET_UDP=y
CONFIG_NET_TCP=y
CONFIG_NET_DHCPV4=y
CONFIG_DNS_RESOLVER=y

CONFIG_NET_STATISTICS=y
CONFIG_NET_STATISTICS_WIFI=y
CONFIG_NET_STATISTICS_USER_API=y

CONFIG_NET_PKT_RX_COUNT=8
CONFIG_NET_PKT_TX_COUNT=8

# Below section is the primary contributor to SRAM and is currently
# tuned for performance, but this will be revisited in the future.
CONFIG_NET_BUF_RX_COUNT=16
CONFIG_NET_BUF_TX_COUNT=16
CONFIG_NRF70_RX_NUM_BUFS=16
CONFIG_NRF70_MAX_TX_AGGREGATION=4
CONFIG_NET_TC_TX_COUNT=1

CONFIG_NET_IF_UNICAST_IPV6_ADDR_COUNT=4
CONFIG_NET_IF_MCAST_IPV6_ADDR_COUNT=5
CONFIG_NET_MAX_CONTEXTS=5
CONFIG_NET_CONTEXT_SYNC_RECV=y

CONFIG_INIT_STACKS=y

CONFIG_NET_L2_ETHERNET=y
CONFIG_NET_SHELL=y

# Memories
CONFIG_MAIN_STACK_SIZE=5200
CONFIG_SHELL_STACK_SIZE=5400

CONFIG_NET_TX_STACK_SIZE=4096
CONFIG_NET_RX_STACK_SIZE=4096

# Debugging
CONFIG_STACK_SENTINEL=y
CONFIG_DEBUG_COREDUMP=y
CONFIG_DEBUG_COREDUMP_BACKEND_LOGGING=y
CONFIG_DEBUG_COREDUMP_MEMORY_DUMP_MIN=y
CONFIG_SHELL_CMDS_RESIZE=n
#CONFIG_DEBUG=y
CONFIG_WIFI_NM_WPA_SUPPLICANT_LOG_LEVEL_INF=y

# Kernel options
CONFIG_ENTROPY_GENERATOR=y
CONFIG_REBOOT=y

# Logging
CONFIG_LOG=y
CONFIG_PRINTK=y
CONFIG_SHELL=y
CONFIG_SHELL_GETOPT=y
CONFIG_DEVICE_SHELL=y
CONFIG_POSIX_TIMERS=y
CONFIG_DATE_SHELL=y
CONFIG_NET_CONFIG_AUTO_INIT=n
CONFIG_POSIX_API=y

CONFIG_WIFI_CREDENTIALS=y
CONFIG_FLASH=y
CONFIG_FLASH_PAGE_LAYOUT=y
CONFIG_FLASH_MAP=y
CONFIG_NVS=y
CONFIG_SETTINGS=y
CONFIG_SETTINGS_NVS=y

# printing of scan results puts pressure on queues in new locking
# design in net_mgmt. So, use a higher timeout for a crowded
# environment.
CONFIG_NET_MGMT_EVENT_QUEUE_TIMEOUT=5000
CONFIG_NET_SOCKETS_POLL_MAX=12
CONFIG_NET_MGMT_EVENT_QUEUE_SIZE=16
```

## overlay-ipv6-only.conf
```kconfig
#
# Copyright (c) 2022 Nordic Semiconductor ASA
#
# SPDX-License-Identifier: LicenseRef-Nordic-5-Clause
#

# Configuration for IPv6 and UDP-only build variant of the shell sample.
# It relies on Router Advertisements rather than DHCP or static configuration.

CONFIG_NET_IPV4=n
CONFIG_NET_DHCPV4=n
CONFIG_NET_CONFIG_SETTINGS=n
CONFIG_NET_CONFIG_MY_IPV4_ADDR=""
CONFIG_NET_CONFIG_PEER_IPV4_ADDR=""
CONFIG_NET_CONFIG_MY_IPV6_ADDR=""
CONFIG_NET_CONFIG_PEER_IPV6_ADDR=""
CONFIG_NET_TCP=n

CONFIG_NET_STATISTICS_IPV6=y
CONFIG_NET_IPV6_ND=y
CONFIG_NET_IPV6_NBR_CACHE=y
```

## overlay-monitor-mode.conf
```kconfig
CONFIG_NRF70_RAW_DATA_RX=y
CONFIG_WIFI_NM_WPA_SUPPLICANT=n
CONFIG_NRF70_STA_MODE=n
CONFIG_NET_SOCKETS_PACKET=y
```

## overlay-net-capture.conf
```kconfig
CONFIG_NET_CAPTURE=y

CONFIG_NET_IF_MAX_IPV6_COUNT=3
CONFIG_NET_IF_MAX_IPV4_COUNT=3
CONFIG_NET_IF_UNICAST_IPV4_ADDR_COUNT=2

CONFIG_NET_CONFIG_SETTINGS=y
CONFIG_NET_CONFIG_INIT_TIMEOUT=0
CONFIG_NET_CONFIG_NEED_IPV6=y
CONFIG_NET_CONFIG_NEED_IPV4=y
```

## overlay-netusb.conf
```kconfig
# USB Device settings
CONFIG_USB_DEVICE_STACK=y

# Select USB Configurations
CONFIG_USB_DEVICE_NETWORK_ECM=y

# Logging
CONFIG_USB_DRIVER_LOG_LEVEL_INF=y
CONFIG_USB_DEVICE_LOG_LEVEL_INF=y

# Uses more Selects
CONFIG_NET_SOCKETS_POLL_MAX=10

# DUT responses are > 1500, so, need to fragment
CONFIG_NET_IPV4_FRAGMENT=y
CONFIG_NET_IPV4_FRAGMENT_MAX_COUNT=10

# For netusb WFA_THREADS_NUM
CONFIG_POSIX_THREAD_THREADS_MAX=5
```

## overlay-openthread.conf
```kconfig
# for wifi_shell to work
CONFIG_NET_DEFAULT_IF_ETHERNET=y
CONFIG_NET_CONFIG_AUTO_INIT=n
CONFIG_NET_CONFIG_SETTINGS=y
CONFIG_NET_CONFIG_INIT_TIMEOUT=0

CONFIG_OPENTHREAD_SHELL=y
CONFIG_SHELL_ARGC_MAX=26
CONFIG_SHELL_CMD_BUFF_SIZE=416

# Enable OpenThread features set
CONFIG_OPENTHREAD_NORDIC_LIBRARY_MASTER=y

CONFIG_NET_L2_OPENTHREAD=y
# Openthread supports only IPv6 and is the first interface
CONFIG_NET_CONFIG_MY_IPV4_ADDR=""
CONFIG_NET_CONFIG_PEER_IPV4_ADDR=""

CONFIG_ASSERT=y
CONFIG_ASSERT_NO_COND_INFO=y
CONFIG_FPU=y

CONFIG_GPIO_SHELL=y

# Use printk to log messages
CONFIG_LOG_MODE_MINIMAL=y

# Log only errors/hard faults
CONFIG_LOG_MAX_LEVEL=1


# Enable LTO to save flash memory
CONFIG_LTO=y
CONFIG_ISR_TABLES_LOCAL_DECLARATION=y

# Required by WIFI
CONFIG_MBEDTLS_SHA1_C=y
```

## overlay-promiscuous-mode.conf
```kconfig
CONFIG_NRF70_PROMISC_DATA_RX=y
CONFIG_NET_PROMISCUOUS_MODE=y
```

## boards/nrf52840dk_nrf52840.overlay
```dts
/*
 * Copyright (c) 2022 Nordic Semiconductor ASA
 *
 * SPDX-License-Identifier: LicenseRef-Nordic-5-Clause
 */

/* Disabled because of a conflict on P1.08 - Arduino pin D7 (host-irq-gpios
 * in nrf7002ek). */
&spi1 {
	status = "disabled";
};

/* Disabled because of conflicts on P1.01 and P1.02 - Arduino pins D0 and D1
 * (iovdd-ctrl-gpios and bucken-gpios in nrf7002ek, respectively). */
&uart1 {
	status = "disabled";
};
```

## boards/thingy91x_nrf5340_cpuapp.overlay
```dts
/* Copyright (c) 2024 Nordic Semiconductor ASA
 *
 * SPDX-License-Identifier: LicenseRef-Nordic-5-Clause
 */

#include <thingy91x_nrf53_wifi.dtsi>

&usbd {
	compatible = "nordic,nrf-usbd";
	status = "okay";
};

/ {
	chosen {
		zephyr,console = &cdc_acm_uart0;
		zephyr,shell-uart = &cdc_acm_uart0;
		zephyr,uart-mcumgr = &cdc_acm_uart0;
		zephyr,bt-mon-uart = &cdc_acm_uart0;
		zephyr,bt-c2h-uart = &cdc_acm_uart0;
		nordic,pm-ext-flash = &flash_ext;
	};
};

&rtt0 {
	status = "disabled";
};
```

## src/main.c
```c
/*
 * Copyright (c) 2022 Nordic Semiconductor ASA
 *
 * SPDX-License-Identifier: LicenseRef-Nordic-5-Clause
 */

/** @file
 * @brief WiFi shell sample main function
 */

#include <zephyr/sys/printk.h>
#include <zephyr/kernel.h>
#if NRFX_CLOCK_ENABLED && (defined(CLOCK_FEATURE_HFCLK_DIVIDE_PRESENT) || NRF_CLOCK_HAS_HFCLK192M)
#include <nrfx_clock.h>
#endif
#include <zephyr/device.h>
#include <zephyr/net/net_config.h>

#if defined(CONFIG_USB_DEVICE_STACK) && !defined(CONFIG_BOARD_THINGY91X_NRF5340_CPUAPP)
#define USES_USB_ETH 1
#else
#define USES_USB_ETH 0
#endif

#if USES_USB_ETH
#include <zephyr/usb/usb_device.h>
#endif

#if USES_USB_ETH || defined(CONFIG_SLIP)
static struct in_addr addr = { { { 192, 0, 2, 1 } } };
static struct in_addr mask = { { { 255, 255, 255, 0 } } };
#endif /* CONFIG_USB_DEVICE_STACK || CONFIG_SLIP */

#if USES_USB_ETH
int init_usb(void)
{
	int ret;

	ret = usb_enable(NULL);
	if (ret != 0) {
		printk("Cannot enable USB (%d)", ret);
		return ret;
	}

	return 0;
}
#endif


int main(void)
{
#if NRFX_CLOCK_ENABLED && (defined(CLOCK_FEATURE_HFCLK_DIVIDE_PRESENT) || NRF_CLOCK_HAS_HFCLK192M)
	/* For now hardcode to 128MHz */
	nrfx_clock_divider_set(NRF_CLOCK_DOMAIN_HFCLK,
			       NRF_CLOCK_HFCLK_DIV_1);
#endif
	printk("Starting %s with CPU frequency: %d MHz\n", CONFIG_BOARD, SystemCoreClock/MHZ(1));

#if USES_USB_ETH
	init_usb();

	/* Redirect static IP address to netusb*/
	const struct device *usb_dev = device_get_binding("eth_netusb");
	struct net_if *iface = net_if_lookup_by_dev(usb_dev);

	if (!iface) {
		printk("Cannot find network interface: %s", "eth_netusb");
		return -1;
	}

	net_if_ipv4_addr_add(iface, &addr, NET_ADDR_MANUAL, 0);
	net_if_ipv4_set_netmask_by_addr(iface, &addr, &mask);
#endif

#ifdef CONFIG_SLIP
	const struct device *slip_dev = device_get_binding(CONFIG_SLIP_DRV_NAME);
	struct net_if *slip_iface = net_if_lookup_by_dev(slip_dev);

	if (!slip_iface) {
		printk("Cannot find network interface: %s", CONFIG_SLIP_DRV_NAME);
		return -1;
	}

	net_if_ipv4_addr_add(slip_iface, &addr, NET_ADDR_MANUAL, 0);
	net_if_ipv4_set_netmask_by_addr(slip_iface, &addr, &mask);
#endif /* CONFIG_SLIP */

#ifdef CONFIG_NET_CONFIG_SETTINGS
	/* Without this, DHCPv4 starts on first interface and if that is not Wi-Fi or
	 * only supports IPv6, then its an issue. (E.g., OpenThread)
	 *
	 * So, we start DHCPv4 on Wi-Fi interface always, independent of the ordering.
	 */
	const struct device *dev = DEVICE_DT_GET(DT_CHOSEN(zephyr_wifi));
	struct net_if *wifi_iface = net_if_lookup_by_dev(dev);

	/* As both are Ethernet, we need to set specific interface*/
	net_if_set_default(wifi_iface);

	net_config_init_app(dev, "Initializing network");
#endif

	return 0;
}
```

## src/wifi_promiscuous_shell.c
```c
/*
 * Copyright (c) 2024 Nordic Semiconductor ASA
 *
 * SPDX-License-Identifier: LicenseRef-Nordic-5-Clause
 */

/** @file
 * @brief Wi-Fi Promiscuous mode shell
 */

#include <stdlib.h>
#include <zephyr/shell/shell.h>
#include <zephyr/posix/unistd.h>
#include <zephyr/logging/log.h>
LOG_MODULE_REGISTER(promiscuous_mode, CONFIG_LOG_DEFAULT_LEVEL);

#include "net_private.h"

static int cmd_wifi_promisc(const struct shell *sh, size_t argc, char *argv[])
{
	struct net_if *iface = NULL;
	bool mode_val = 0;

	if (argc != 2) {
		shell_help(sh);
		return -ENOEXEC;
	}

	if (strcmp(argv[1], "-h") == 0) {
		shell_help(sh);
		return 0;
	} else if ((strcmp(argv[1], "1") == 0) || (strcmp(argv[1], "0") == 0)) {
		mode_val = atoi(argv[1]);
	} else {
		LOG_ERR("Entered wrong input");
		shell_help(sh);
		return -ENOEXEC;
	}

	iface = net_if_get_first_wifi();
	if (!iface) {
		LOG_ERR("Failed to get Wi-Fi iface");
		return -ENOEXEC;
	}

	if (net_eth_promisc_mode(iface, mode_val)) {
		LOG_ERR("Promiscuous mode %s failed", mode_val ? "enabling" : "disabling");
	}
	return 0;
}

SHELL_STATIC_SUBCMD_SET_CREATE(
	promisc_cmd,
	SHELL_CMD_ARG(mode, NULL,
		      "This command may be used to enable or disable promiscuous mode\n"
		      "[enable: 1, disable: 0]\n"
		      "[-h, --help] : Print out the help for the mode command\n"
		      "Usage: promiscuous_set mode 1 or 0\n",
		      cmd_wifi_promisc,
		      2, 0),
	SHELL_SUBCMD_SET_END
);

SHELL_CMD_REGISTER(promiscuous_set,
		   &promisc_cmd,
		   "Promiscuous mode command (To set promiscuous mode)",
		   NULL);
```

## src/wifi_raw_tx_pkt_shell.c
```c
/*
 * Copyright (c) 2023 Nordic Semiconductor ASA
 *
 * SPDX-License-Identifier: LicenseRef-Nordic-5-Clause
 */

/** @file
 * @brief Wi-Fi Raw Tx Packet shell
 */

#include <stdlib.h>
#include <zephyr/net/ethernet.h>
#include <zephyr/shell/shell.h>
#include <zephyr/posix/unistd.h>
#include <zephyr/posix/sys/socket.h>
#include <zephyr/logging/log.h>
LOG_MODULE_REGISTER(raw_tx_pkt, CONFIG_LOG_DEFAULT_LEVEL);

#include "net_private.h"

#define BEACON_PAYLOAD_LENGTH 256
#define IEEE80211_SEQ_CTRL_SEQ_NUM_MASK 0xFFF0
#define IEEE80211_SEQ_NUMBER_INC BIT(4) /* 0-3 is fragment number */
#define NRF_WIFI_MAGIC_NUM_RAWTX 0x12345678

/* TODO: Copied from nRF70 Wi-Fi driver, need to be moved to a common place */

/**
 * @brief Transmit modes for raw packets.
 *
 */
enum nrf_wifi_fmac_rawtx_mode {
	/** Legacy mode. */
	NRF_WIFI_FMAC_RAWTX_MODE_LEGACY,
	/** HT mode. */
	NRF_WIFI_FMAC_RAWTX_MODE_HT,
	/** VHT mode. */
	NRF_WIFI_FMAC_RAWTX_MODE_VHT,
	/** HE SU mode. */
	NRF_WIFI_FMAC_RAWTX_MODE_HE_SU,
	/** HE ER SU mode. */
	NRF_WIFI_FMAC_RAWTX_MODE_HE_ER_SU,
	/** HE TB mode. */
	NRF_WIFI_FMAC_RAWTX_MODE_HE_TB,
	/** Throughput max. */
	NRF_WIFI_FMAC_RAWTX_MODE_MAX
};

struct raw_tx_pkt_header {
	unsigned int magic_num;
	unsigned char data_rate;
	unsigned short packet_length;
	unsigned char tx_mode;
	unsigned char queue;
	unsigned char raw_tx_flag;
};

struct raw_tx_pkt_header raw_tx_pkt;

struct beacon {
	uint16_t frame_control;
	uint16_t duration;
	uint8_t da[6];
	uint8_t sa[6];
	uint8_t bssid[6];
	uint16_t seq_ctrl;
	uint8_t payload[BEACON_PAYLOAD_LENGTH];
} __packed;

static struct beacon test_beacon_frame = {
	.frame_control = htons(0X8000),
	.duration = 0X0000,
	.da = {0XFF, 0XFF, 0XFF, 0XFF, 0XFF, 0XFF},
	/* Transmitter Address: A0:69:60:E3:52:15 */
	.sa = {0XA0, 0X69, 0X60, 0XE3, 0X52, 0X15},
	.bssid = {0XA0, 0X69, 0X60, 0XE3, 0X52, 0X15},
	.seq_ctrl = 0X0001,
	/* SSID: NRF_RAW_TX_PACKET_APP */
	.payload = {
		0X0C, 0XA2, 0X28, 0X00, 0X00, 0X00, 0X00, 0X00, 0X64, 0X00,
		0X11, 0X04, 0X00, 0X15, 0X4E, 0X52, 0X46, 0X5F, 0X52, 0X41,
		0X57, 0X5F, 0X54, 0X58, 0X5F, 0X50, 0X41, 0X43, 0X4B, 0X45,
		0X54, 0X5F, 0X41, 0X50, 0X50, 0X01, 0X08, 0X82, 0X84, 0X8B,
		0X96, 0X0C, 0X12, 0X18, 0X24, 0X03, 0X01, 0X06, 0X05, 0X04,
		0X00, 0X02, 0X00, 0X00, 0X2A, 0X01, 0X04, 0X32, 0X04, 0X30,
		0X48, 0X60, 0X6C, 0X30, 0X14, 0X01, 0X00, 0X00, 0X0F, 0XAC,
		0X04, 0X01, 0X00, 0X00, 0X0F, 0XAC, 0X04, 0X01, 0X00, 0X00,
		0X0F, 0XAC, 0X02, 0X0C, 0X00, 0X3B, 0X02, 0X51, 0X00, 0X2D,
		0X1A, 0X0C, 0X00, 0X17, 0XFF, 0XFF, 0X00, 0X00, 0X00, 0X00,
		0X00, 0X00, 0X00, 0X2C, 0X01, 0X01, 0X00, 0X00, 0X00, 0X00,
		0X00, 0X00, 0X00, 0X00, 0X00, 0X3D, 0X16, 0X06, 0X00, 0X00,
		0X00, 0X00, 0X00, 0X00, 0X00, 0X00, 0X00, 0X00, 0X00, 0X00,
		0X00, 0X00, 0X00, 0X00, 0X00, 0X00, 0X7F, 0X08, 0X04, 0X00,
		0X00, 0X02, 0X00, 0X00, 0X00, 0X40, 0XFF, 0X1A, 0X23, 0X01,
		0X78, 0X10, 0X1A, 0X00, 0X00, 0X00, 0X20, 0X0E, 0X09, 0X00,
		0X09, 0X80, 0X04, 0X01, 0XC4, 0X00, 0XFA, 0XFF, 0XFA, 0XFF,
		0X61, 0X1C, 0XC7, 0X71, 0XFF, 0X07, 0X24, 0XF0, 0X3F, 0X00,
		0X81, 0XFC, 0XFF, 0XDD, 0X18, 0X00, 0X50, 0XF2, 0X02, 0X01,
		0X01, 0X01, 0X00, 0X03, 0XA4, 0X00, 0X00, 0X27, 0XA4, 0X00,
		0X00, 0X42, 0X43, 0X5E, 0X00, 0X62, 0X32, 0X2F, 0X00
	}
};

void fill_raw_tx_pkt_hdr(int rate_flags, int data_rate, int queue_num)
{
	raw_tx_pkt.magic_num = NRF_WIFI_MAGIC_NUM_RAWTX;
	raw_tx_pkt.data_rate = data_rate;
	raw_tx_pkt.packet_length = sizeof(test_beacon_frame);
	raw_tx_pkt.tx_mode = rate_flags;
	raw_tx_pkt.queue = queue_num;
	raw_tx_pkt.raw_tx_flag = 0;
}

int validate(int value, int min, int max, const char *param)
{
	if (value < min || value > max) {
		LOG_ERR("Please provide %s value between %d and %d", param, min, max);
		return 0;
	}

	return 1;
}

int validate_rate(int data_rate, int flag)
{
	if ((flag == NRF_WIFI_FMAC_RAWTX_MODE_LEGACY) && ((data_rate == 1) ||
							 (data_rate == 2) ||
							 (data_rate == 55) ||
							 (data_rate == 11) ||
							 (data_rate == 6) ||
							 (data_rate == 9) ||
							 (data_rate == 12) ||
							 (data_rate == 18) ||
							 (data_rate == 24) ||
							 (data_rate == 36) ||
							 (data_rate == 48) ||
							 (data_rate == 54))) {

		return 1;
	} else if (((flag >= NRF_WIFI_FMAC_RAWTX_MODE_HT &&
		    flag <= NRF_WIFI_FMAC_RAWTX_MODE_HE_ER_SU)) &&
		    ((data_rate >= 0) && (data_rate <= 7))) {
		return 1;
	}

	LOG_ERR("Invalid data rate %d", data_rate);
	return 0;
}

static int setup_raw_pkt_socket(int *sockfd, struct sockaddr_ll *sa)
{
	struct net_if *iface;
	int ret;

	*sockfd = socket(AF_PACKET, SOCK_RAW, htons(ETH_P_ALL));
	if (*sockfd < 0) {
		LOG_ERR("Unable to create a socket %d", errno);
		return -1;
	}

	iface = net_if_get_default();
	if (!iface) {
		LOG_ERR("Unable to get default interface");
		return -1;
	}

	sa->sll_family = AF_PACKET;
	sa->sll_ifindex = net_if_get_by_iface(iface);

	/* Bind the socket */
	ret = bind(*sockfd, (struct sockaddr *)sa, sizeof(struct sockaddr_ll));
	if (ret < 0) {
		LOG_ERR("Error: Unable to bind socket to the network interface:%d", errno);
		close(*sockfd);
		return -1;
	}

	return 0;
}

static void increment_seq_control(void)
{
	test_beacon_frame.seq_ctrl = (test_beacon_frame.seq_ctrl +
				      IEEE80211_SEQ_NUMBER_INC) &
				      IEEE80211_SEQ_CTRL_SEQ_NUM_MASK;
	if (test_beacon_frame.seq_ctrl > IEEE80211_SEQ_CTRL_SEQ_NUM_MASK) {
		test_beacon_frame.seq_ctrl = 0X0010;
	}
}

static void send_packet(const char *transmission_mode,
			unsigned int num_pkts, unsigned int delay)
{
	struct sockaddr_ll sa;
	int sockfd, ret;
	char *test_frame = NULL;
	int buf_length, num_failures = 0;

	ret = setup_raw_pkt_socket(&sockfd, &sa);
	if (ret < 0) {
		LOG_ERR("Setting socket for raw pkt transmission failed %d", errno);
		return;
	}

	test_frame = malloc(sizeof(struct raw_tx_pkt_header) + sizeof(test_beacon_frame));
	if (!test_frame) {
		LOG_ERR("Malloc failed for send buffer %d", errno);
		return;
	}

	buf_length = sizeof(struct raw_tx_pkt_header) + sizeof(test_beacon_frame);
	memcpy(test_frame, &raw_tx_pkt, sizeof(struct raw_tx_pkt_header));

	for (int i = 0; i < num_pkts; i++) {
		memcpy(test_frame + sizeof(struct raw_tx_pkt_header),
		       &test_beacon_frame, sizeof(test_beacon_frame));

		ret = sendto(sockfd, test_frame, buf_length, 0,
			     (struct sockaddr *)&sa, sizeof(sa));
		if (ret < 0) {
			LOG_ERR("Unable to send beacon frame: %s", strerror(errno));
			num_failures++;
		}

		increment_seq_control();

		k_msleep(delay);
	}

	LOG_INF("Sent %d packets with %d failures on socket", num_pkts, num_failures);
	close(sockfd);
	free(test_frame);
}

static int parse_raw_tx_configure_args(const struct shell *sh,
				       size_t argc,
				       char *argv[],
				       int *flags, int *rate, int *queue)
{
	struct getopt_state *state;
	int opt;
	static struct option long_options[] = {{"rate-flags", required_argument, 0, 'f'},
					       {"data-rate", required_argument, 0, 'd'},
					       {"queue-number", required_argument, 0, 'q'},
					       {"help", no_argument, 0, 'h'},
					       {0, 0, 0, 0}};
	int opt_index = 0;
	int opt_num = 0;

	while ((opt = getopt_long(argc, argv, "f:d:q:h", long_options, &opt_index)) != -1) {
		state = getopt_state_get();
		switch (opt) {
		case 'f':
			*flags = atoi(optarg);
			if (!validate(*flags, NRF_WIFI_FMAC_RAWTX_MODE_LEGACY,
				      NRF_WIFI_FMAC_RAWTX_MODE_HE_ER_SU, "Rate Flags")) {
				return -ENOEXEC;
			}
			opt_num++;
			break;
		case 'd':
			*rate = atoi(optarg);
			if (!validate_rate(*rate, *flags)) {
				return -ENOEXEC;
			}
			opt_num++;
			break;
		case 'q':
			*queue = atoi(optarg);
			if (!validate(*queue, 0, 4, "Queue Number")) {
				return -ENOEXEC;
			}
			opt_num++;
			break;
		case'h':
			shell_help(sh);
			opt_num++;
			break;
		case '?':
		default:
			LOG_ERR("Invalid option or option usage: %s",
				argv[opt_index + 1]);
			return -ENOEXEC;
		}
	}

	return opt_num;
}

static int cmd_configure_raw_tx_pkt(
		const struct shell *sh,
		size_t argc,
		char *argv[])
{
	int opt_num, rate_flags = -1, data_rate = -1, queue_num = -1;

	if (argc == 7) {
		opt_num = parse_raw_tx_configure_args(sh, argc, argv, &rate_flags,
						      &data_rate, &queue_num);
		if (opt_num < 0) {
			shell_help(sh);
			return -ENOEXEC;
		} else if (!opt_num) {
			LOG_ERR("No valid option(s) found");
			return -ENOEXEC;
		}
	}

	LOG_INF("Rate-flags: %d Data-rate:%d queue-num:%d",
		rate_flags, data_rate, queue_num);

	fill_raw_tx_pkt_hdr(rate_flags, data_rate, queue_num);

	return 0;
}

static int parse_raw_tx_send_args(const struct shell *sh,
				  size_t argc, char *argv[],
				  char **tx_mode, int *pkt_num, int *time_delay)
{
	struct getopt_state *state;
	int opt;
	static struct option long_options[] = {{"mode", required_argument, 0, 'm'},
					       {"num-pkts", required_argument, 0, 'n'},
					       {"inter-frame-delay", required_argument, 0, 't'},
					       {"help", no_argument, 0, 'h'},
					       {0, 0, 0, 0}};
	int opt_index = 0;
	int opt_num = 0;

	while ((opt = getopt_long(argc, argv, "m:n:t:h", long_options, &opt_index)) != -1) {
		state = getopt_state_get();
		switch (opt) {
		case 'm':
			if (!((strcmp(optarg, "fixed") == 0) ||
			    (strcmp(optarg, "continuous") == 0))) {
				LOG_ERR("Invalid mode %s", optarg);
				return -ENOEXEC;
			}
			*tx_mode = optarg;
			opt_num++;
			break;
		case 't':
			*time_delay = atoi(optarg);
			if (*time_delay < 0) {
				LOG_ERR("Invalid delay %d", atoi(optarg));
				return -ENOEXEC;
			}
			opt_num++;
			break;
		case 'n':
			*pkt_num = (strcmp(*tx_mode, "continuous") == 0) ? INT_MAX : atoi(optarg);
			if (*pkt_num <= 0) {
				LOG_ERR("Invalid num of packets %d", atoi(optarg));
				return -ENOEXEC;
			}
			opt_num++;
			break;
		case'h':
			shell_help(sh);
			opt_num++;
			break;
		case '?':
		default:
			LOG_ERR("Invalid option or option usage: %s", argv[opt_index + 1]);
			return -ENOEXEC;
		}
	}

	if (strcmp(*tx_mode, "continuous") == 0) {
		*pkt_num = INT_MAX;
	} else if ((strcmp(*tx_mode, "fixed") == 0) && (*pkt_num == 0)) {
		LOG_ERR("Please provide number of packets to be transmitted");
		return -ENOEXEC;
	}

	return opt_num;
}

static int cmd_send_raw_tx_pkt(
		const struct shell *sh,
		size_t argc, char *argv[])
{
	int opt_num;
	char *mode = NULL;
	int num_packets = 0, delay = 0;

	if (argc < 5 || argc > 7) {
		shell_help(sh);
		return -ENOEXEC;
	}

	LOG_INF("argument count: %d", argc);
	opt_num = parse_raw_tx_send_args(sh, argc, argv, &mode,
					 &num_packets, &delay);
	if (opt_num < 0) {
		shell_help(sh);
		return -ENOEXEC;
	} else if (!opt_num) {
		LOG_ERR("No valid option(s) found");
		return -ENOEXEC;
	}

	LOG_INF("Selected Mode: %s Num-Packets:%u Delay:%d", mode, num_packets, delay);
	send_packet(mode, num_packets, delay);

	return 0;
}

static int cmd_tx_injection_mode(const struct shell *sh,
				 size_t argc, char *argv[])
{
	struct net_if *iface = NULL;
	bool mode_val = 0;

	if (argc != 2) {
		shell_help(sh);
		return -ENOEXEC;
	}

	iface = net_if_get_first_wifi();
	if (!iface) {
		LOG_ERR("Failed to get Wi-Fi iface");
		return -ENOEXEC;
	}

	if (strcmp(argv[1], "-h") == 0) {
		shell_help(sh);
		return 0;
	} else if ((strcmp(argv[1], "1") == 0) || (strcmp(argv[1], "0") == 0)) {
		mode_val = atoi(argv[1]);
	} else {
		LOG_ERR("Entered wrong input");
		shell_help(sh);
		return -ENOEXEC;
	}

	if (net_eth_txinjection_mode(iface, mode_val)) {
		LOG_ERR("TX Injection mode %s failed", mode_val ? "enabling" : "disabling");
		return -ENOEXEC;
	}

	LOG_INF("TX Injection mode :%s", mode_val ? "enabled" : "disabled");
	return 0;
}

SHELL_STATIC_SUBCMD_SET_CREATE(
	raw_tx_cmds,
	SHELL_CMD_ARG(mode, NULL,
		      "This command may be used to enable or disable TX Injection mode\n"
		      "[enable: 1, disable: 0]\n"
		      "[-h, --help] : Print out the help for the mode command\n"
		      "Usage: raw_tx mode 1 or 0\n",
		      cmd_tx_injection_mode,
		      2, 0),
	SHELL_CMD_ARG(configure, NULL,
		      "Configure raw TX packet header\n"
		      "This command may be used to configure raw TX packet header\n"
		      "parameters:\n"
		      "[-f, --rate-flags] : Rate flag value.\n"
		      "[-d, --data-rate] : Data rate value.\n"
		      "[-q, --queue-number] : Queue number.\n"
		      "[-h, --help] : Print out the help for the configure command\n"
		      "Usage: raw_tx configure -f 0 -d 9 -q 1\n",
		      cmd_configure_raw_tx_pkt,
		      7, 0),
	SHELL_CMD_ARG(send, NULL,
		      "Send raw TX packet\n"
		      "This command may be used to send raw TX packets\n"
		      "parameters:\n"
		      "[-m, --mode] : Mode of transmission (either continuous or fixed).\n"
		      "[-n, --number-of-pkts] : Number of packets to be transmitted.\n"
		      "[-t, --inter-frame-delay] : Delay between frames or packets in ms.\n"
		      "[-h, --help] : Print out the help for the send command\n"
		      "Usage:\n"
		      "raw_tx send -m fixed -n 9 -t 10 (For fixed mode)\n"
		      "raw_tx send -m continuous -t 10 (For continuous mode)\n",
		      cmd_send_raw_tx_pkt,
		      5, 2),
	SHELL_SUBCMD_SET_END
);

SHELL_CMD_REGISTER(raw_tx,
		   &raw_tx_cmds,
		   "raw_tx_cmds (To configure and send raw TX packets)",
		   NULL);
```
