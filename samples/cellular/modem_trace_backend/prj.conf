## CMakeLists.txt
```
#
# Copyright (c) 2022 Nordic Semiconductor
#
# SPDX-License-Identifier: LicenseRef-Nordic-5-Clause
#

cmake_minimum_required(VERSION 3.20.0)

find_package(Zephyr REQUIRED HINTS $ENV{ZEPHYR_BASE})
project(modem_trace_backend)

if(CONFIG_NRF_MODEM_LIB_TRACE)

# Only add 'custom' backend to compilation when selected.
zephyr_library_sources_ifdef(
  CONFIG_NRF_MODEM_LIB_TRACE_BACKEND_CUSTOM
  src/trace_print_stats.c
)

endif()

# NORDIC SDK APP START
target_sources(app PRIVATE src/main.c)

# NORDIC SDK APP END
```

## Kconfig
```
#
# Copyright (c) 2022 Nordic Semiconductor
#
# SPDX-License-Identifier: LicenseRef-Nordic-5-Clause
#

menu "Modem trace backend sample"

endmenu

rsource "Kconfig.trace_print_stats"

menu "Zephyr Kernel"
source "Kconfig.zephyr"
endmenu
```

## Kconfig.trace_print_stats
```
#
# Copyright (c) 2022 Nordic Semiconductor
#
# SPDX-License-Identifier: LicenseRef-Nordic-5-Clause
#

if NRF_MODEM_LIB_TRACE

# Adds NRF_MODEM_LIB_TRACE_BACKEND_CUSTOM to the trace backend choice.
choice NRF_MODEM_LIB_TRACE_BACKEND

config NRF_MODEM_LIB_TRACE_BACKEND_CUSTOM
	bool "Count modem traces and print to terminal"
	depends on NRF_CPU_LOAD
	depends on FPU
	depends on NEWLIB_LIBC_FLOAT_PRINTF || PICOLIBC_IO_FLOAT
	help
	  Print modem trace data statistics
	  and cpu utilization.

endchoice # NRF_MODEM_LIB_TRACE_BACKEND

if NRF_MODEM_LIB_TRACE_BACKEND_CUSTOM

config CUSTOM_BACKEND_PRINT_PERIOD_MSEC
	int "Statistics print interval (millisec)"
	default 500

endif # NRF_MODEM_LIB_TRACE_BACKEND_CUSTOM

endif # NRF_MODEM_LIB_TRACE
```

## sample.yaml
```
sample:
  name: Modem trace backend
tests:
  sample.cellular.modem_trace_backend:
    sysbuild: true
    build_only: true
    integration_platforms:
      - nrf9151dk/nrf9151/ns
      - nrf9160dk/nrf9160/ns
      - nrf9161dk/nrf9161/ns
    platform_allow:
      - nrf9151dk/nrf9151/ns
      - nrf9160dk/nrf9160/ns
      - nrf9161dk/nrf9161/ns
    tags:
      - ci_build
      - sysbuild
      - ci_samples_cellular
```

## prj.conf
```kconfig
#
# Copyright (c) 2022 Nordic Semiconductor ASA
#
# SPDX-License-Identifier: LicenseRef-Nordic-5-Clause
#

# Modem library
CONFIG_NRF_MODEM_LIB=y

CONFIG_MAIN_STACK_SIZE=2048

# LTE link control
CONFIG_LTE_LINK_CONTROL=y

# Modem trace
CONFIG_NRF_MODEM_LIB_TRACE=y
CONFIG_NRF_MODEM_LIB_TRACE_BACKEND_CUSTOM=y
CONFIG_CUSTOM_BACKEND_PRINT_PERIOD_MSEC=500

CONFIG_NRF_CPU_LOAD=y
CONFIG_FPU=y
CONFIG_PICOLIBC_IO_FLOAT=y
```

## src/main.c
```c
/*
 * Copyright (c) 2022 Nordic Semiconductor ASA
 *
 * SPDX-License-Identifier: LicenseRef-Nordic-5-Clause
 */

#include <zephyr/kernel.h>
#include <modem/lte_lc.h>
#include <modem/nrf_modem_lib.h>
#include <nrf_modem_at.h>

/* define callback */
NRF_MODEM_LIB_ON_CFUN(cfun_hook, on_cfun, NULL);

/* callback implementation */
static void on_cfun(int mode, void *context)
{
	printk("LTE mode changed to %d\n", mode);
}

int main(void)
{
	int err;

	printk("Modem trace backend sample started\n");

	printk("Initializing modem library\n");
	err = nrf_modem_lib_init();
	if (err) {
		printk("Modem library initialization failed, error: %d\n", err);
		return 0;
	}

	printk("Connecting to network\n");
	err = lte_lc_func_mode_set(LTE_LC_FUNC_MODE_NORMAL);
	if (err) {
		printk("Failed to change LTE mode, err %d\n", err);
		return 0;
	}

	k_sleep(K_SECONDS(5));

	err = lte_lc_func_mode_set(LTE_LC_FUNC_MODE_POWER_OFF);
	if (err) {
		printk("Failed to change LTE mode, err %d\n", err);
		return 0;
	}

	nrf_modem_lib_shutdown();

	printk("Bye\n");

	return 0;
}
```

## src/trace_print_stats.c
```c
/*
 * Copyright (c) 2022 Nordic Semiconductor ASA
 *
 * SPDX-License-Identifier: LicenseRef-Nordic-5-Clause
 */

#include <zephyr/kernel.h>
#include <sys/errno.h>
#include <debug/cpu_load.h>
#include <modem/trace_backend.h>

#define PRINT_PERIOD_MSEC K_MSEC(CONFIG_CUSTOM_BACKEND_PRINT_PERIOD_MSEC)

static uint32_t uptime_prev;
static uint32_t num_bytes_prev;
static uint32_t tot_bytes_rcvd;
static bool show_cpu_load;
static trace_backend_processed_cb trace_processed_callback;

static void print_stats(struct k_work *item);

K_WORK_DELAYABLE_DEFINE(print_stats_work, print_stats);

static void print_stats(struct k_work *item)
{
	uint32_t uptime;
	uint32_t num_bytes;
	double throughput;
	double cpu_load_percent;

	ARG_UNUSED(item);

	uptime = k_uptime_get_32();
	num_bytes = tot_bytes_rcvd;
	throughput = (num_bytes - num_bytes_prev) / ((uptime - uptime_prev) / 1000.0);

	printk("Traces received: %5.1fkB, %4.1fkB/s", num_bytes / 1000.0, throughput / 1000.0);

	if (show_cpu_load) {
		cpu_load_percent = cpu_load_get() / 1000.0;
		printk(", CPU-load: %5.2f%%\n", cpu_load_percent);
		cpu_load_reset();
	} else {
		printk("\n");
	}

	uptime_prev = uptime;
	num_bytes_prev = num_bytes;

	k_work_schedule(&print_stats_work, PRINT_PERIOD_MSEC);
}

int trace_backend_init(trace_backend_processed_cb trace_processed_cb)
{
	int err;

	if (trace_processed_cb == NULL) {
		return -EFAULT;
	}

	trace_processed_callback = trace_processed_cb;

	err = cpu_load_init();
	if (err) {
		if (err == -ENODEV) {
			printk("Failed to allocate PPI channels for cpu load estimation\n");
		} else if (err == -EBUSY) {
			printk("Failed to allocate TIMER instance for cpu load estimation\n");
		} else {
			printk("Failed to initialize cpu load module\n");
		}

		show_cpu_load = false;
	} else {
		show_cpu_load = true;
		cpu_load_reset();
	}

	num_bytes_prev = tot_bytes_rcvd;
	uptime_prev = k_uptime_get_32();

	k_work_schedule(&print_stats_work, PRINT_PERIOD_MSEC);

	printk("Custom trace backend initialized\n");

	return 0;
}

int trace_backend_deinit(void)
{
	k_work_cancel_delayable(&print_stats_work);

	printk("Custom trace backend deinitialized\n");

	return 0;
}

int trace_backend_write(const void *data, size_t len)
{
	ARG_UNUSED(data);

	tot_bytes_rcvd += len;

	trace_processed_callback(len);

	return (int)len;
}

struct nrf_modem_lib_trace_backend trace_backend = {
	.init = trace_backend_init,
	.deinit = trace_backend_deinit,
	.write = trace_backend_write,
};
```
