## CMakeLists.txt
```
#
# Copyright (c) 2024 Nordic Semiconductor
#
# SPDX-License-Identifier: LicenseRef-Nordic-5-Clause
#

cmake_minimum_required(VERSION 3.20.0)

find_package(Zephyr REQUIRED HINTS $ENV{ZEPHYR_BASE})
project(uicc_lwm2m)

# NORDIC SDK APP START
target_sources(app PRIVATE src/main.c)
# NORDIC SDK APP END

zephyr_include_directories(src)
```

## sample.yaml
```
sample:
  name: UICC LwM2M sample
tests:
  sample.cellular.uicc_lwm2m:
    sysbuild: true
    build_only: true
    platform_allow:
      - nrf9151dk/nrf9151/ns
      - nrf9160dk/nrf9160/ns
      - nrf9161dk/nrf9161/ns
      - thingy91/nrf9160/ns
      - thingy91x/nrf9151/ns
    integration_platforms:
      - nrf9151dk/nrf9151/ns
      - nrf9160dk/nrf9160/ns
      - nrf9161dk/nrf9161/ns
      - thingy91/nrf9160/ns
    tags:
      - ci_build
      - sysbuild
      - ci_samples_cellular
```

## prj.conf
```kconfig
#
# Copyright (c) 2024 Nordic Semiconductor ASA
#
# SPDX-License-Identifier: LicenseRef-Nordic-5-Clause
#

# General config
CONFIG_SERIAL=y

# Modem library
CONFIG_NRF_MODEM_LIB=y

# UICC LwM2M library
CONFIG_UICC_LWM2M=y

# Heap and stacks
CONFIG_HEAP_MEM_POOL_SIZE=1024
CONFIG_MAIN_STACK_SIZE=1536
```

## src/main.c
```c
/*
 * Copyright (c) 2024 Nordic Semiconductor ASA
 *
 * SPDX-License-Identifier: LicenseRef-Nordic-5-Clause
 */

#include <stdio.h>
#include <ctype.h>

#include <zephyr/kernel.h>
#include <modem/nrf_modem_lib.h>
#include <modem/uicc_lwm2m.h>
#include <nrf_modem_at.h>

uint8_t buffer[UICC_RECORD_BUFFER_MAX];

static void printk_hexdump(char *data, int len)
{
	static const char hexchars[16] = { '0', '1', '2', '3', '4', '5', '6', '7', '8', '9',
					   'a', 'b', 'c', 'd', 'e', 'f' };
	int pos = 0;

	while (pos < len) {
		char hexbuf[256];
		char *cur = hexbuf;
		int i;

		/* Dump offset */
		cur += snprintf(cur, 20, "%04x  ", pos);

		/* Dump bytes as hex */
		for (i = 0; i < 16 && pos + i < len; i++) {
			*cur++ = hexchars[(data[pos + i] & 0xf0) >> 4];
			*cur++ = hexchars[data[pos + i] & 0x0f];
			*cur++ = ' ';
			if (i == 7) {
				*cur++ = ' ';
			}
		}

		while (cur < hexbuf + 58) {
			/* Fill it up with space to ascii column */
			*cur++ = ' ';
		}

		/* Dump bytes as text */
		for (i = 0; i < 16 && pos + i < len; i++) {
			if (isprint((int)data[pos + i])) {
				*cur++ = data[pos + i];
			} else {
				*cur++ = '.';
			}
			if (i == 7) {
				*cur++ = ' ';
			}
		}

		pos += i;
		*cur = 0;

		printk("%s\n", hexbuf);
	}
}

int main(void)
{
	int ret;

	printk("UICC LwM2M sample started\n");

	ret = nrf_modem_lib_init();
	if (ret) {
		printk("Modem library initialization failed, error: %d\n", ret);
		return -1;
	}

	ret = nrf_modem_at_printf("AT+CFUN=41");
	if (ret) {
		printk("Activate UICC failed, error: %d\n", ret);
		return -1;
	}

	ret = uicc_lwm2m_bootstrap_read(buffer, sizeof(buffer));
	if (ret > 0) {
		printk("LwM2M bootstrap data found, length: %d\n\n", ret);
		printk_hexdump(buffer, ret);
	} else {
		printk("Failed to read data, error: %d\n", -ret);
	}

	ret = nrf_modem_lib_shutdown();
	if (ret) {
		printk("Modem library shutdown failed, error: %d\n", ret);
		return -1;
	}

	return 0;
}
```
