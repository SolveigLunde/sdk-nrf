## CMakeLists.txt
```
#
# Copyright (c) 2022 Nordic Semiconductor
#
# SPDX-License-Identifier: LicenseRef-Nordic-5-Clause
#

cmake_minimum_required(VERSION 3.20.0)

find_package(Zephyr REQUIRED HINTS $ENV{ZEPHYR_BASE})
project("HW ID sample")

# NORDIC SDK APP START
target_sources(app PRIVATE src/main.c)
# NORDIC SDK APP END
```

## sample.yaml
```
sample:
  description: Sample showing HW ID library
  name: HW ID sample
tests:
  sample.hw_id.device_id:
    sysbuild: true
    build_only: true
    integration_platforms:
      - nrf5340dk/nrf5340/cpuapp
      - nrf5340dk/nrf5340/cpuapp/ns
      - nrf9160dk/nrf9160
      - nrf9160dk/nrf9160/ns
    platform_allow:
      - nrf5340dk/nrf5340/cpuapp
      - nrf5340dk/nrf5340/cpuapp/ns
      - nrf9160dk/nrf9160
      - nrf9160dk/nrf9160/ns
    tags:
      - ci_build
      - sysbuild
      - ci_samples_hw_id
  sample.hw_id.uuid:
    sysbuild: true
    build_only: true
    integration_platforms:
      - nrf9160dk/nrf9160/ns
    platform_allow: nrf9160dk/nrf9160/ns
    tags:
      - ci_build
      - sysbuild
      - ci_samples_hw_id
    extra_args: OVERLAY_CONFIG=overlay-uuid.conf
  sample.hw_id.imei:
    sysbuild: true
    build_only: true
    integration_platforms:
      - nrf9160dk/nrf9160/ns
    platform_allow: nrf9160dk/nrf9160/ns
    tags:
      - ci_build
      - sysbuild
      - ci_samples_hw_id
    extra_args: OVERLAY_CONFIG=overlay-imei.conf
  sample.hw_id.ble:
    sysbuild: true
    build_only: true
    integration_platforms:
      - nrf51dk/nrf51822
      - nrf52840dk/nrf52840
      - nrf5340dk/nrf5340/cpuapp
      - nrf5340dk/nrf5340/cpuapp/ns
    platform_allow:
      - nrf51dk/nrf51822
      - nrf52840dk/nrf52840
      - nrf5340dk/nrf5340/cpuapp
      - nrf5340dk/nrf5340/cpuapp/ns
    tags:
      - ci_build
      - sysbuild
      - ci_samples_hw_id
    extra_args: OVERLAY_CONFIG=overlay-ble-mac.conf
```

## prj.conf
```kconfig
#
# Copyright (c) 2022 Nordic Semiconductor ASA
#
# SPDX-License-Identifier: LicenseRef-Nordic-5-Clause
#
CONFIG_HW_ID_LIBRARY=y
```

## overlay-ble-mac.conf
```kconfig
#
# Copyright (c) 2022 Nordic Semiconductor ASA
#
# SPDX-License-Identifier: LicenseRef-Nordic-5-Clause
#
CONFIG_BT=y
CONFIG_HW_ID_LIBRARY_SOURCE_BLE_MAC=y
```

## overlay-imei.conf
```kconfig
#
# Copyright (c) 2022 Nordic Semiconductor ASA
#
# SPDX-License-Identifier: LicenseRef-Nordic-5-Clause
#
CONFIG_NRF_MODEM_LIB=y
CONFIG_HW_ID_LIBRARY_SOURCE_IMEI=y
```

## overlay-uuid.conf
```kconfig
#
# Copyright (c) 2022 Nordic Semiconductor ASA
#
# SPDX-License-Identifier: LicenseRef-Nordic-5-Clause
#
CONFIG_MODEM_JWT=y
CONFIG_HW_ID_LIBRARY_SOURCE_UUID=y
CONFIG_HEAP_MEM_POOL_SIZE=4096
```

## src/main.c
```c
/*
 * Copyright (c) 2022 Nordic Semiconductor ASA
 *
 * SPDX-License-Identifier: LicenseRef-Nordic-5-Clause
 */

#include <zephyr/kernel.h>
#include <hw_id.h>

#if defined(CONFIG_BT)
#include <zephyr/bluetooth/bluetooth.h>
#endif /* defined(CONFIG_BT) */

#if defined(CONFIG_NRF_MODEM_LIB)
#include <modem/nrf_modem_lib.h>
#endif /* defined(CONFIG_NRF_MODEM_LIB) */

int main(void)
{
	int err;

#if defined(CONFIG_BT)
	err = bt_enable(NULL);
	if (err) {
		printk("Bluetooth init failed (err %d)\n", err);
	}
#endif /* defined(CONFIG_BT) */

#if defined(CONFIG_NRF_MODEM_LIB)
	err = nrf_modem_lib_init();
	if (err) {
		printk("Modem init failed (err %d)\n", err);
	}
#endif /* defined(CONFIG_NRF_MODEM_LIB) */

	char buf[HW_ID_LEN] = "unsupported";
	err = hw_id_get(buf, ARRAY_SIZE(buf));
	if (err) {
		printk("hw_id_get failed (err %d)\n", err);
		return 0;
	}

	printk("hw_id: %s\n", buf);

	return 0;
}
```
