## CMakeLists.txt
```
#
# Copyright (c) 2023 Nordic Semiconductor
#
# SPDX-License-Identifier: LicenseRef-Nordic-5-Clause
#

cmake_minimum_required(VERSION 3.20.0)

find_package(Zephyr REQUIRED HINTS $ENV{ZEPHYR_BASE})
project(ipc_radio)

target_include_directories(app PRIVATE ./src)

target_sources_ifdef(CONFIG_IPC_RADIO_802154 app PRIVATE src/802154.c)

if(CONFIG_IPC_RADIO_BT_HCI_IPC)
  target_sources(app PRIVATE src/bt_hci_ipc.c)
else()
  target_sources(app PRIVATE src/bt_empty.c)
endif()

# NORDIC SDK APP START
target_sources(app PRIVATE
  src/main.c
)
# NORDIC SDK APP END
```

## Kconfig
```
#
# Copyright (c) 2023 Nordic Semiconductor
#
# SPDX-License-Identifier: LicenseRef-Nordic-5-Clause
#

mainmenu "Nordic ipc_radio firmware"

config IPC_RADIO_802154
	bool "IPC IEEE 802.15.4 radio"
	select NRF_802154_SER_RADIO
	help
	  Enable the IPC IEEE 802.15.4 radio serialization.

config IPC_RADIO_BT
	bool "IPC Bluetooth"
	help
	  Enable the IPC Bluetooth radio serialization.

if IPC_RADIO_BT

choice IPC_RADIO_BT_SER
	default IPC_RADIO_BT_HCI_IPC
	prompt "Bluetooth serialization type"
	help
	  Type of the IPC Bluetooth radio serialization used.

config IPC_RADIO_BT_HCI_IPC
	bool "Bluetooth HCI serialization"
	depends on IPC_SERVICE
	depends on IPC_SERVICE_BACKEND_ICBMSG || IPC_SERVICE_BACKEND_RPMSG
	depends on BT_HCI_RAW
	help
	  Use Bluetooth HCI serialization over ipc_service.

config IPC_RADIO_BT_RPC
	bool "Bluetooth host API serialization over RPC"
	depends on BT_RPC_HOST
	help
	  Use nRF RPC serialization for Bluetooth.

endchoice # IPC_RADIO_BT_SER

if IPC_RADIO_BT_HCI_IPC

config QUEUE_THREAD_STACK_SIZE
	int "Queue thread stack size"
	default 512
	help
	  Stack size for the queue thread.

config QUEUE_THREAD_PRIO
	int "Queue thread priority"
	default 7
	help
	  Priority for the queue thread.

endif # IPC_RADIO_BT_HCI_IPC

config SETTINGS
	imply ZMS if SOC_FLASH_NRF_MRAM
	imply NVS if !SOC_FLASH_NRF_MRAM

config BT_MAX_CONN
	default 4 if IPC_RADIO_802154
	default 16 if !IPC_RADIO_802154

endif # IPC_RADIO_BT

module = IPC_RADIO
module-str = "ipc_radio"
source "${ZEPHYR_BASE}/subsys/logging/Kconfig.template.log_config"

source "Kconfig.zephyr"
```

## sample.yaml
```
sample:
  name: IPC radio firmware
  description: IPC radio firmware application
tests:
  applications.ipc_radio.hci:
    sysbuild: true
    build_only: true
    platform_allow:
      - nrf5340dk/nrf5340/cpunet
      - thingy53/nrf5340/cpunet
    tags:
      - bluetooth
      - ci_build
      - sysbuild
      - ci_applications_ipc_radio
    integration_platforms:
      - nrf5340dk/nrf5340/cpunet
      - thingy53/nrf5340/cpunet
    extra_args: EXTRA_CONF_FILE=overlay-bt_hci_ipc.conf
  applications.ipc_radio.hci.sysbuild:
    sysbuild: true
    build_only: true
    platform_allow:
      - nrf5340dk/nrf5340/cpunet
      - thingy53/nrf5340/cpunet
    tags:
      - bluetooth
      - ci_build
      - ci_applications_ipc_radio
    integration_platforms:
      - nrf5340dk/nrf5340/cpunet
      - thingy53/nrf5340/cpunet
    extra_args: EXTRA_CONF_FILE=overlay-bt_hci_ipc.conf
  applications.ipc_radio.hci.nrf54h.sysbuild:
    sysbuild: true
    build_only: true
    platform_allow: nrf54h20dk/nrf54h20/cpurad
    tags:
      - bluetooth
      - ci_build
      - ci_applications_ipc_radio
    integration_platforms:
      - nrf54h20dk/nrf54h20/cpurad
    extra_args:
      - EXTRA_CONF_FILE=overlay-bt_hci_ipc.conf
      - SB_CONFIG_PARTITION_MANAGER=n
  applications.ipc_radio.rpc:
    sysbuild: true
    build_only: true
    platform_allow:
      - nrf5340dk/nrf5340/cpunet
      - thingy53/nrf5340/cpunet
    tags:
      - bluetooth
      - ci_build
      - sysbuild
      - ci_applications_ipc_radio
    integration_platforms:
      - nrf5340dk/nrf5340/cpunet
      - thingy53/nrf5340/cpunet
    extra_args: EXTRA_CONF_FILE=overlay-bt_rpc.conf
  applications.ipc_radio.rpc.sysbuild:
    sysbuild: true
    build_only: true
    platform_allow:
      - nrf5340dk/nrf5340/cpunet
      - thingy53/nrf5340/cpunet
    tags:
      - bluetooth
      - ci_build
      - ci_applications_ipc_radio
    integration_platforms:
      - nrf5340dk/nrf5340/cpunet
      - thingy53/nrf5340/cpunet
    extra_args: EXTRA_CONF_FILE=overlay-bt_rpc.conf
  applications.ipc_radio.rpc.nrf54h.sysbuild:
    sysbuild: true
    build_only: true
    platform_allow: nrf54h20dk/nrf54h20/cpurad
    tags:
      - bluetooth
      - ci_build
      - ci_applications_ipc_radio
    integration_platforms:
      - nrf54h20dk/nrf54h20/cpurad
    extra_args:
      - EXTRA_CONF_FILE=overlay-bt_rpc.conf
      - SB_CONFIG_PARTITION_MANAGER=n
  applications.ipc_radio.802154:
    sysbuild: true
    build_only: true
    platform_allow:
      - nrf5340dk/nrf5340/cpunet
      - thingy53/nrf5340/cpunet
    tags:
      - ci_build
      - sysbuild
      - ci_applications_ipc_radio
    integration_platforms:
      - nrf5340dk/nrf5340/cpunet
      - thingy53/nrf5340/cpunet
    extra_args: EXTRA_CONF_FILE=overlay-802154.conf
  applications.ipc_radio.802154.sysbuild:
    sysbuild: true
    build_only: true
    platform_allow:
      - nrf5340dk/nrf5340/cpunet
      - thingy53/nrf5340/cpunet
    tags:
      - ci_build
      - ci_applications_ipc_radio
    integration_platforms:
      - nrf5340dk/nrf5340/cpunet
      - thingy53/nrf5340/cpunet
    extra_args: EXTRA_CONF_FILE=overlay-802154.conf
  applications.ipc_radio.hci802154:
    sysbuild: true
    build_only: true
    platform_allow:
      - nrf5340dk/nrf5340/cpunet
      - thingy53/nrf5340/cpunet
    tags:
      - bluetooth
      - ci_build
      - sysbuild
      - ci_applications_ipc_radio
    integration_platforms:
      - nrf5340dk/nrf5340/cpunet
      - thingy53/nrf5340/cpunet
    extra_args: EXTRA_CONF_FILE="overlay-bt_hci_ipc.conf;overlay-802154.conf"
  applications.ipc_radio.hci802154.sysbuild:
    sysbuild: true
    build_only: true
    platform_allow:
      - nrf5340dk/nrf5340/cpunet
      - thingy53/nrf5340/cpunet
    tags:
      - bluetooth
      - ci_build
      - ci_applications_ipc_radio
    integration_platforms:
      - nrf5340dk/nrf5340/cpunet
      - thingy53/nrf5340/cpunet
    extra_args: EXTRA_CONF_FILE="overlay-bt_hci_ipc.conf;overlay-802154.conf"
```

## prj.conf
```kconfig
#
# Copyright (c) 2023 Nordic Semiconductor
#
# SPDX-License-Identifier: LicenseRef-Nordic-5-Clause
#

CONFIG_SERIAL=n
CONFIG_UART_CONSOLE=n
CONFIG_LOG=n
```

## overlay-802154.conf
```kconfig
#
# Copyright (c) 2023 Nordic Semiconductor
#
# SPDX-License-Identifier: LicenseRef-Nordic-5-Clause
#

CONFIG_NRF_802154_SER_RADIO=y
CONFIG_NRF_RTC_TIMER_USER_CHAN_COUNT=2

CONFIG_IPC_RADIO_802154=y
```

## overlay-bt_hci_ipc.conf
```kconfig
#
# Copyright (c) 2023 Nordic Semiconductor
#
# SPDX-License-Identifier: LicenseRef-Nordic-5-Clause
#

CONFIG_HEAP_MEM_POOL_SIZE=8192
CONFIG_MAIN_STACK_SIZE=2048
CONFIG_SYSTEM_WORKQUEUE_STACK_SIZE=2048

CONFIG_MBOX=y
CONFIG_IPC_SERVICE=y

CONFIG_BT=y
CONFIG_BT_HCI_RAW=y
CONFIG_BT_CTLR_ASSERT_HANDLER=y

CONFIG_ASSERT=y

CONFIG_IPC_RADIO_BT=y
CONFIG_IPC_RADIO_BT_HCI_IPC=y
```

## overlay-bt_rpc.conf
```kconfig
#
# Copyright (c) 2023 Nordic Semiconductor
#
# SPDX-License-Identifier: LicenseRef-Nordic-5-Clause
#

CONFIG_HEAP_MEM_POOL_SIZE=4096
CONFIG_NRF_RPC_THREAD_STACK_SIZE=4096
CONFIG_SYSTEM_WORKQUEUE_STACK_SIZE=4096

CONFIG_BT=y
CONFIG_BT_RPC=y
CONFIG_BT_RPC_HOST=y

# Host side registers all GATT services using dynamic database
CONFIG_BT_GATT_DYNAMIC_DB=y

# Enable bonding
CONFIG_BT_SMP=y
CONFIG_BT_SETTINGS=y
CONFIG_FLASH=y
CONFIG_FLASH_PAGE_LAYOUT=y
CONFIG_FLASH_MAP=y
CONFIG_SETTINGS=y

CONFIG_IPC_RADIO_BT=y
CONFIG_IPC_RADIO_BT_RPC=y
```

## src/main.c
```c
/*
 * Copyright (c) 2023 Nordic Semiconductor ASA
 *
 * SPDX-License-Identifier: LicenseRef-Nordic-5-Clause
 */

#include <errno.h>
#include <zephyr/logging/log.h>

#include "ipc_bt.h"

LOG_MODULE_REGISTER(ipc_radio, CONFIG_IPC_RADIO_LOG_LEVEL);

#if !(CONFIG_IPC_RADIO_802154 || CONFIG_IPC_RADIO_BT)
#error "No radio serialization selected."
#endif

int main(void)
{
	int err;

	err = ipc_bt_init();
	if ((err) && (err != -ENOSYS)) {
		LOG_ERR("Error initializing ipc radio %d", err);
		return err;
	}

	for (;;) {
		err = ipc_bt_process();

		if (err == -ENOSYS) {
			/* Particular implementation does not need the process function */
			return 0;
		} else if (err) {
			LOG_ERR("Error processing ipc radio %d", err);
			return err;
		}
	}
}
```

## src/802154.c
```c
/*
 * Copyright (c) 2023 Nordic Semiconductor ASA
 *
 * SPDX-License-Identifier: LicenseRef-Nordic-5-Clause
 */

#include <stddef.h>
#include <zephyr/kernel.h>
#include <nrf_802154_serialization_error.h>

void nrf_802154_serialization_error(const nrf_802154_ser_err_data_t *err)
{
	ARG_UNUSED(err);
	__ASSERT(false, "802.15.4 serialization error");
	k_oops();
}

void nrf_802154_sl_fault_handler(uint32_t id, int32_t line, const char *err)
{
	__ASSERT(false, "module_id: %u, line: %d, %s", id, line, err);
	k_oops();
}
```

## src/bt_empty.c
```c
/*
 * Copyright (c) 2023 Nordic Semiconductor ASA
 *
 * SPDX-License-Identifier: LicenseRef-Nordic-5-Clause
 */

#include <errno.h>
#include <zephyr/logging/log.h>

#include "ipc_bt.h"

LOG_MODULE_DECLARE(ipc_radio, CONFIG_IPC_RADIO_LOG_LEVEL);

int ipc_bt_init(void)
{
	LOG_DBG("Empty ipc_bt_init called.");
	return -ENOSYS;
}

int ipc_bt_process(void)
{
	LOG_DBG("Empty ipc_bt_process called.");
	return -ENOSYS;
}
```

## src/bt_hci_ipc.c
```c
/*
 * Copyright (c) 2023 Nordic Semiconductor ASA
 *
 * SPDX-License-Identifier: LicenseRef-Nordic-5-Clause
 */

#include <errno.h>
#include <stddef.h>
#include <stdio.h>

#include <zephyr/kernel.h>
#include <zephyr/device.h>

#include <zephyr/sys/byteorder.h>
#include <zephyr/sys/util.h>
#include <zephyr/net_buf.h>

#include <zephyr/bluetooth/bluetooth.h>
#include <zephyr/bluetooth/l2cap.h>
#include <zephyr/bluetooth/hci.h>
#include <zephyr/bluetooth/buf.h>
#include <zephyr/bluetooth/hci_raw.h>

#include <zephyr/ipc/ipc_service.h>

#if defined(CONFIG_BT_HCI_VS_FATAL_ERROR)
#include <zephyr/logging/log_ctrl.h>
#endif /* CONFIG_BT_HCI_VS_FATAL_ERROR */

#include <zephyr/logging/log.h>

#include "ipc_bt.h"

#if DT_NODE_HAS_COMPAT(DT_CHOSEN(zephyr_bt_hci_ipc), zephyr_ipc_openamp_static_vrings)
#include <openamp/rpmsg_virtio.h>
#define IPC_BUF_SIZE DT_PROP_OR(DT_CHOSEN(zephyr_bt_hci_ipc), zephyr_buffer_size, RPMSG_BUFFER_SIZE)
#define IPC_MEM_SIZE (DT_REG_SIZE(DT_PHANDLE(DT_CHOSEN(zephyr_bt_hci_ipc), memory_region)) / 2)
#define MAX_IPC_BLOCKS DIV_ROUND_UP(IPC_MEM_SIZE, IPC_BUF_SIZE)
#elif DT_NODE_HAS_COMPAT(DT_CHOSEN(zephyr_bt_hci_ipc), zephyr_ipc_icbmsg)
#define MAX_IPC_BLOCKS DT_PROP(DT_CHOSEN(zephyr_bt_hci_ipc), rx_blocks)
#else
#error "IPC backends other than rpmsg or icbmsg are not supported."
#endif

LOG_MODULE_DECLARE(ipc_radio, CONFIG_IPC_RADIO_LOG_LEVEL);

#if defined(CONFIG_BT_CTLR_ASSERT_HANDLER) || defined(CONFIG_BT_HCI_VS_FATAL_ERROR)
static bool ipc_ept_ready;
#endif /* CONFIG_BT_CTLR_ASSERT_HANDLER || CONFIG_BT_HCI_VS_FATAL_ERROR */

static K_SEM_DEFINE(ipc_bound_sem, 0, 1);

static struct ipc_ept hci_ept;

struct ipc_block_item {
	const void *ptr;
	size_t len;
};

K_MSGQ_DEFINE(ipc_block_queue, sizeof(struct ipc_block_item), MAX_IPC_BLOCKS, sizeof(void *));

static K_FIFO_DEFINE(tx_queue);
static K_FIFO_DEFINE(rx_queue);

enum hci_h4_type {
	HCI_H4_CMD = 0x01, /* rx */
	HCI_H4_ACL = 0x02, /* rx */
	HCI_H4_EVT = 0x04, /* tx */
	HCI_H4_ISO = 0x05  /* rx */
};

#define HCI_FATAL_MSG true
#define HCI_REGULAR_MSG false

static struct net_buf *recv_cmd(const uint8_t *data, size_t len)
{
	const struct bt_hci_cmd_hdr *hdr = (const struct bt_hci_cmd_hdr *)data;
	struct net_buf *buf;

	if (len < sizeof(*hdr)) {
		LOG_ERR("Not enough data for command header.");
		return NULL;
	}

	if ((len - sizeof(*hdr)) != hdr->param_len) {
		LOG_ERR("Command param_len does not match the remaining data length.");
		return NULL;
	}

	buf = bt_buf_get_tx(BT_BUF_CMD, K_FOREVER, hdr, sizeof(*hdr));
	data += sizeof(*hdr);
	len -= sizeof(*hdr);

	if (len > net_buf_tailroom(buf)) {
		LOG_ERR("Not enough space in buffer.");
		net_buf_unref(buf);
		return NULL;
	}

	LOG_DBG("Received HCI CMD packet (opcode: %#x, len: %u).",
						sys_le16_to_cpu(hdr->opcode), hdr->param_len);

	net_buf_add_mem(buf, data, len);
	return buf;
}

static struct net_buf *recv_acl(const uint8_t *data, size_t len)
{
	const struct bt_hci_acl_hdr *hdr = (const struct bt_hci_acl_hdr *)data;
	struct net_buf *buf;

	if (len < sizeof(*hdr)) {
		LOG_ERR("Not enough data for ACL header.");
		return NULL;
	}

	if ((len - sizeof(*hdr)) != sys_le16_to_cpu(hdr->len)) {
		LOG_ERR("ACL payload length does not match the remaining data length.");
		return NULL;
	}

	buf = bt_buf_get_tx(BT_BUF_ACL_OUT, K_FOREVER, hdr, sizeof(*hdr));
	data += sizeof(*hdr);
	len -= sizeof(*hdr);

	if (len > net_buf_tailroom(buf)) {
		LOG_ERR("Not enough space in buffer.");
		net_buf_unref(buf);
		return NULL;
	}

	LOG_DBG("Received HCI ACL packet (handle: %u, len: %u).",
					sys_le16_to_cpu(hdr->handle), sys_le16_to_cpu(hdr->len));

	net_buf_add_mem(buf, data, len);
	return buf;
}

static struct net_buf *recv_iso(const uint8_t *data, size_t len)
{
	const struct bt_hci_iso_hdr *hdr = (const struct bt_hci_iso_hdr *)data;
	struct net_buf *buf;

	if (len < sizeof(*hdr)) {
		LOG_ERR("Not enough data for ISO header.");
		return NULL;
	}

	if ((len - sizeof(*hdr)) != bt_iso_hdr_len(sys_le16_to_cpu(hdr->len))) {
		LOG_ERR("ISO payload length does not match the remaining data length.");
		return NULL;
	}

	buf = bt_buf_get_tx(BT_BUF_ISO_OUT, K_FOREVER, hdr, sizeof(*hdr));
	data += sizeof(*hdr);
	len -= sizeof(*hdr);

	if (len > net_buf_tailroom(buf)) {
		LOG_ERR("Not enough space in buffer.");
		net_buf_unref(buf);
		return NULL;
	}

	LOG_DBG("Received HCI ISO packet (handle: %u, len: %u).",
					sys_le16_to_cpu(hdr->handle), sys_le16_to_cpu(hdr->len));

	net_buf_add_mem(buf, data, len);
	return buf;
}

static void send(struct net_buf *buf, bool is_fatal_err)
{
	uint8_t retries = 0;
	int ret;

	LOG_DBG("buf %p type %u len %u", buf, buf->data[0], buf->len);
	LOG_HEXDUMP_DBG(buf->data, buf->len, "Controller buffer:");

	do {
		ret = ipc_service_send(&hci_ept, buf->data, buf->len);
		if (ret < 0) {
			retries++;
			if (retries > 10) {
				LOG_WRN("IPC send has been blocked during 10 retires.");
				retries = 0;
			}

			if (is_fatal_err) {
				LOG_ERR("IPC service send error: %d", ret);
			} else {
				k_yield();
			}
		}
	} while (ret < 0);

	LOG_INF("Sent message of %d bytes.", ret);

	net_buf_unref(buf);
}

static void bound(void *priv)
{
#if defined(CONFIG_BT_CTLR_ASSERT_HANDLER) || defined(CONFIG_BT_HCI_VS_FATAL_ERROR)
	ipc_ept_ready = true;
#endif /* CONFIG_BT_CTLR_ASSERT_HANDLER || CONFIG_BT_HCI_VS_FATAL_ERROR */

	k_sem_give(&ipc_bound_sem);
}

static void recv(const void *data, size_t len, void *priv)
{
	struct ipc_block_item block;
	int err;

	LOG_INF("Received hci message of %u bytes.", len);
	LOG_HEXDUMP_DBG(data, len, "HCI data:");

	block.ptr = data;
	block.len = len;

	err = ipc_service_hold_rx_buffer(&hci_ept, (void *)data);
	if (err) {
		LOG_ERR("Failed to hold rx buffer: %d.", err);
	}

	err = k_msgq_put(&ipc_block_queue, &block, K_NO_WAIT);
	__ASSERT(err == 0, "Failed to put data into msgq: %d.", err);
}

static void queue_thread(void)
{
	struct ipc_block_item block;
	struct net_buf *buf;
	const uint8_t *tmp;
	enum hci_h4_type type;
	int err;

	while (1) {
		err = k_msgq_get(&ipc_block_queue, &block, K_FOREVER);
		__ASSERT(err == 0, "Failed to get data from msgq: %d.", err);

		tmp = (const uint8_t *)block.ptr;
		type = (enum hci_h4_type)*tmp++;
		block.len -= sizeof(type);

		switch (type) {
		case HCI_H4_CMD:
			buf = recv_cmd(tmp, block.len);
			break;

		case HCI_H4_ACL:
			buf = recv_acl(tmp, block.len);
			break;

		case HCI_H4_ISO:
			buf = recv_iso(tmp, block.len);
			break;

		default:
			LOG_ERR("Unknown HCI type %u.", type);
			buf = NULL;
			break;
		}

		err = ipc_service_release_rx_buffer(&hci_ept, (void *)block.ptr);
		if (err < 0) {
			LOG_ERR("Failed to release rx buffer: %d.", err);
		} else {
			LOG_DBG("Released rx buffer with ret %d.", err);
		}

		if (buf) {
			k_fifo_put(&tx_queue, buf);
		}
	}
}

K_THREAD_DEFINE(queue_thread_id, CONFIG_QUEUE_THREAD_STACK_SIZE, queue_thread,
		NULL, NULL, NULL,
		CONFIG_QUEUE_THREAD_PRIO, 0, 0);

static void tx_thread(void)
{
	struct net_buf *buf;
	int err;

	while (1) {
		buf = k_fifo_get(&tx_queue, K_FOREVER);
		err = bt_send(buf);
		if (err) {
			LOG_ERR("bt_send failed err: %d.", err);
			net_buf_unref(buf);
		}

		k_yield();
	}
}

K_THREAD_DEFINE(tx_thread_id, CONFIG_BT_HCI_TX_STACK_SIZE, tx_thread,
		NULL, NULL, NULL,
		CONFIG_BT_HCI_TX_PRIO, 0, 0);

static struct ipc_ept_cfg hci_ept_cfg = {
	.name = "nrf_bt_hci",
	.cb = {
		.bound    = bound,
		.received = recv,
	},
};

#if defined(CONFIG_BT_CTLR_ASSERT_HANDLER)
void bt_ctlr_assert_handle(char *file, uint32_t line)
{
	(void)irq_lock();

	LOG_ERR("HCI Fatal error in: %s at %d.", file, line);

#if defined(CONFIG_BT_HCI_VS_FATAL_ERROR)
	if (ipc_ept_ready) {
		struct net_buf *buf;

		buf = hci_vs_err_assert(file, line);
		if (!buf) {
			send(buf, HCI_FATAL_MSG);
		} else {
			LOG_ERR("Can't send Fatal Error HCI event.");
		}
	} else {
		LOG_ERR("HCI Fatal error before IPC endpoint is ready.");
	}

#else /* !CONFIG_BT_HCI_VS_FATAL_ERROR */
	LOG_ERR("Controller assert in: %s at %d.", file, line);

#endif /* !CONFIG_BT_HCI_VS_FATAL_ERROR */

	for (;;) {
	};
}
#endif /* CONFIG_BT_CTLR_ASSERT_HANDLER */

#if defined(CONFIG_BT_HCI_VS_FATAL_ERROR)
void k_sys_fatal_error_handler(unsigned int reason, const struct arch_esf *esf)
{
	LOG_PANIC();

	(void)irq_lock();

	if ((!esf) && (ipc_ept_ready)) {
		struct net_buf *buf;

		buf = hci_vs_err_stack_frame(reason, esf);
		if (!buf) {
			send(buf, HCI_FATAL_MSG);
		} else {
			LOG_ERR("Can't create Fatal Error HCI event.");
		}
	}

	for (;;) {
	};

	CODE_UNREACHABLE;
}
#endif /* CONFIG_BT_HCI_VS_FATAL_ERROR */

int ipc_bt_init(void)
{
	int err;
	const struct device *hci_ipc_instance = DEVICE_DT_GET(DT_CHOSEN(zephyr_bt_hci_ipc));

	LOG_INF("Initializing ipc_radio bt_hci.");

	err = bt_enable_raw(&rx_queue);
	if (err) {
		LOG_ERR("bt_enable_raw failed: %d.", err);
		return err;
	}

	err = ipc_service_open_instance(hci_ipc_instance);
	if ((err < 0) && (err != -EALREADY)) {
		LOG_ERR("IPC service instance initialization failed: %d.", err);
		return err;
	}

	err = ipc_service_register_endpoint(hci_ipc_instance, &hci_ept, &hci_ept_cfg);
	if (err) {
		LOG_ERR("Registering endpoint failed: %d.", err);
		return err;
	}

	return 0;
}

int ipc_bt_process(void)
{
	struct net_buf *buf;

	k_sem_take(&ipc_bound_sem, K_FOREVER);

	while (1) {
		buf = k_fifo_get(&rx_queue, K_FOREVER);
		send(buf, HCI_REGULAR_MSG);
	}

	return 0;
}
```

## src/ipc_bt.h
```c
/*
 * Copyright (c) 2023 Nordic Semiconductor ASA
 *
 * SPDX-License-Identifier: LicenseRef-Nordic-5-Clause
 */

#ifndef IPC_BT_H_
#define IPC_BT_H_

#ifdef __cplusplus
extern "C" {
#endif

/** @brief Initialize the IPC Bluetooth interface.
 *
 * The function might not have any functionality if the interface
 * does not need to be initialized (or is initialized automatically).
 * When this function is not needed, it should be implemented as an empty
 * function and return -ENOSYS.
 *
 * @retval -ENOSYS The function is not implemented.
 * @return 0 in case of success or negative value in case of error.
 */
int ipc_bt_init(void);

/** @brief Give processing time to the IPC Bluetooth interface.
 *
 * The function might not have any functionality if the interface
 * does not need to be given processing time (or is processed automatically).
 * When this function is not needed, it should be implemented as an empty
 * function and return -ENOSYS.
 *
 * @retval -ENOSYS The function is not implemented.
 * @return 0 in case of success or negative value in case of error.
 */
int ipc_bt_process(void);

#ifdef __cplusplus
}
#endif

#endif /* IPC_BT_H_ */
```
