## CMakeLists.txt
```
#
# Copyright (c) 2021 Nordic Semiconductor ASA
#
# SPDX-License-Identifier: LicenseRef-Nordic-5-Clause
#

cmake_minimum_required(VERSION 3.13.1)

find_package(Zephyr REQUIRED HINTS $ENV{ZEPHYR_BASE})
project(NONE)

FILE(GLOB app_sources src/*.c)
target_sources(app PRIVATE ${app_sources})
target_include_directories(app PRIVATE .)
```

## Kconfig.sysbuild
```
#
# Copyright (c) 2024 Nordic Semiconductor
#
# SPDX-License-Identifier: LicenseRef-Nordic-5-Clause
#

config PM_EXTERNAL_FLASH_MCUBOOT_SECONDARY
	default y if BOARD_NRF5340DK_NRF5340_CPUAPP || BOARD_NRF52840DK_NRF52840

choice MCUBOOT_MODE
	default MCUBOOT_MODE_OVERWRITE_ONLY if SOC_SERIES_NRF53X
endchoice

choice NETCORE
	default NETCORE_EMPTY if SOC_NRF5340_CPUAPP
endchoice

config SECURE_BOOT_NETCORE
	default y if SOC_NRF5340_CPUAPP

config NETCORE_APP_UPDATE
	default y if SOC_NRF5340_CPUAPP

source "share/sysbuild/Kconfig"
```

## prj.conf
```kconfig
#
# Copyright (c) 2021-2023 Nordic Semiconductor ASA
#
# SPDX-License-Identifier: LicenseRef-Nordic-5-Clause
#

CONFIG_ZTEST=y

CONFIG_BOOTLOADER_MCUBOOT=y
```

## boards/nrf5340dk_nrf5340_cpuapp.conf
```kconfig
#
# Copyright (c) 2021 Nordic Semiconductor ASA
#
# SPDX-License-Identifier: LicenseRef-Nordic-5-Clause
#

CONFIG_SOC_NRF53_CPUNET_ENABLE=y
```

## src/main.c
```c
/*
 * Copyright (c) 2021 Nordic Semiconductor ASA
 *
 * SPDX-License-Identifier: LicenseRef-Nordic-5-Clause
 */

#include <zephyr/ztest.h>
#include <stdio.h>


ZTEST(mcuboot_external_flash, test_external_flash)
{
	zassert_true(true, "Needed to pass.");
}

ZTEST_SUITE(mcuboot_external_flash, NULL, NULL, NULL, NULL, NULL);
```
