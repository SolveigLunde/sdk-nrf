## CMakeLists.txt
```
#
# Copyright (c) 2025 Nordic Semiconductor ASA
#
# SPDX-License-Identifier: LicenseRef-Nordic-5-Clause
#

cmake_minimum_required(VERSION 3.20.0)

find_package(Zephyr REQUIRED HINTS $ENV{ZEPHYR_BASE})

project(uart_console)

target_sources(app PRIVATE src/main.c)
```

## prj.conf
```kconfig
CONFIG_PM=y
CONFIG_PM_DEVICE=y
CONFIG_PM_DEVICE_RUNTIME=y
CONFIG_POWEROFF=y

# For nrf54h only, will be ingored for other platforms
CONFIG_PM_S2RAM=y
CONFIG_PM_S2RAM_CUSTOM_MARKING=y

CONFIG_SERIAL=y
CONFIG_LOG=y
CONFIG_LOG_BACKEND_UART_ASYNC=y
CONFIG_UART_ASYNC_API=y
CONFIG_LOG_MODE_DEFERRED=y
CONFIG_LOG_PRINTK=y
CONFIG_PRINTK=y
CONFIG_CONSOLE=y
CONFIG_UART_CONSOLE=y
CONFIG_LOG_BACKEND_UART=y
```

## src/main.c
```c
/*
 * Copyright (c) 2025 Nordic Semiconductor ASA
 *
 * SPDX-License-Identifier: LicenseRef-Nordic-5-Clause
 */

#include <zephyr/kernel.h>
#include <zephyr/logging/log.h>
#include <zephyr/pm/device_runtime.h>

#define SLEEP_TIME_MS 1000

static const struct device *const console_dev = DEVICE_DT_GET(DT_CHOSEN(zephyr_console));

int main(void)
{

#if defined(CONFIG_SOC_NRF52840)
	/* [246] System: Intermittent extra current consumption when going to sleep */
	*(volatile uint32_t *)0x4007AC84ul = 0x00000002ul;
#endif

	pm_device_runtime_enable(console_dev);

	while (1) {
		printk("33 characters long string !!!!!!\n");
		k_sleep(K_MSEC(SLEEP_TIME_MS));
	}

	return 0;
}
```
