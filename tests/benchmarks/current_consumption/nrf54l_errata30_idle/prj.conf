## CMakeLists.txt
```
#
# Copyright (c) 2025 Nordic Semiconductor ASA
#
# SPDX-License-Identifier: LicenseRef-Nordic-5-Clause
#

cmake_minimum_required(VERSION 3.20.0)

find_package(Zephyr REQUIRED HINTS $ENV{ZEPHYR_BASE})

project(nrf54l_errata30_idle)

target_sources(app PRIVATE src/main.c)
```

## prj.conf
```kconfig
CONFIG_CONSOLE=n
CONFIG_UART_CONSOLE=n
CONFIG_SERIAL=n

# Enable periodic HFINT calibration to activate Errata 30 workaround
CONFIG_CLOCK_CONTROL_NRF_HFINT_CALIBRATION=y
# Make calibration period low so it impacts power consumption.
# This should be much higher for actual application.
CONFIG_CLOCK_CONTROL_NRF_HFINT_CALIBRATION_PERIOD=300
```

## src/main.c
```c
/*
 * Copyright (c) 2025 Nordic Semiconductor ASA
 *
 * SPDX-License-Identifier: LicenseRef-Nordic-5-Clause
 */

#include <zephyr/kernel.h>

int main(void)
{
	/* Return immediately - sleep forever */
	return 0;
}
```
