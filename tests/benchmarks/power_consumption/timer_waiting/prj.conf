## CMakeLists.txt
```
#
# Copyright (c) 2024 Nordic Semiconductor
#
# SPDX-License-Identifier: LicenseRef-Nordic-5-Clause
#

cmake_minimum_required(VERSION 3.13.1)
find_package(Zephyr REQUIRED HINTS $ENV{ZEPHYR_BASE})
zephyr_include_directories(include)

project(timer_waiting)

target_sources(app PRIVATE src/driver_test.c)
```

## prj.conf
```kconfig
# Drivers and peripherals
CONFIG_COUNTER=y

# Enable runtime power management for peripheral
CONFIG_PM_DEVICE=y
CONFIG_PM_DEVICE_RUNTIME=y

CONFIG_PM=y
CONFIG_PM_S2RAM=y
CONFIG_PM_S2RAM_CUSTOM_MARKING=y
CONFIG_POWEROFF=y
CONFIG_CONSOLE=n
CONFIG_UART_CONSOLE=n
CONFIG_SERIAL=n
CONFIG_BOOT_BANNER=n
```

## boards/nrf54h20dk_nrf54h20_cpuapp_16M.overlay
```dts
/* TIMER130, 16MHz */

/ {
	aliases {
		led = &led0;
		/delete-property/ led1;
		counter = &timer130;
	};
};

&timer130 {
	status = "okay";
};

/delete-node/ &led1;
```

## boards/nrf54h20dk_nrf54h20_cpuapp_320M.overlay
```dts
/* TIMER120, 320MHz */

/ {
	aliases {
		led = &led0;
		/delete-property/ led1;
		counter = &timer120;
	};
};

&timer120 {
	status = "okay";
};

/delete-node/ &led1;
```

## boards/nrf54l_128M.overlay
```dts
/* TIMER00, 128MHz */

/ {
	aliases {
		counter = &timer00;
	};
};

&timer00 {
	status = "okay";
};
```

## boards/nrf54l_16M.overlay
```dts
/* TIMER20, 16MHz */

/ {
	aliases {
		counter = &timer20;
	};
};

&timer20 {
	status = "okay";
};
```

## boards/nrf54l_32M.overlay
```dts
/* TIMER10, 32MHz */

/ {
	aliases {
		counter = &timer10;
	};
};

&timer10 {
	status = "okay";
};
```

## boards/nrf54lm20pdk_nrf54lm20a_cpuapp.overlay
```dts
/ {
	aliases {
		led = &led0;
	};
};
```

## src/driver_test.c
```c
/*
 * Copyright (c) 2024 Nordic Semiconductor ASA
 *
 * SPDX-License-Identifier: LicenseRef-Nordic-5-Clause
 */

#include <zephyr/kernel.h>
#include <zephyr/drivers/counter.h>

#define ALARM_CHANNEL_ID (0)
const struct device *const counter_dev = DEVICE_DT_GET(DT_ALIAS(counter));
struct counter_alarm_cfg counter_cfg;

void counter_handler(const struct device *counter_dev, uint8_t chan_id,
	uint32_t ticks, void *user_data)
{
	k_busy_wait(500000);
	counter_stop(counter_dev);
}

int main(void)
{
	while (1) {
		k_msleep(1500);
		counter_start(counter_dev);

		counter_cfg.flags = 0;
		counter_cfg.ticks = counter_us_to_ticks(counter_dev, 1000000UL);
		counter_cfg.callback = counter_handler;
		counter_cfg.user_data = &counter_cfg;

		counter_set_channel_alarm(counter_dev, ALARM_CHANNEL_ID, &counter_cfg);
		k_msleep(1500);
	}

	return 0;
}
```
