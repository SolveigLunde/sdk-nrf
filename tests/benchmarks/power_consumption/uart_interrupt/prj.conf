## CMakeLists.txt
```
#
# Copyright (c) 2024 Nordic Semiconductor
#
# SPDX-License-Identifier: LicenseRef-Nordic-5-Clause
#

cmake_minimum_required(VERSION 3.20.0)
find_package(Zephyr REQUIRED HINTS $ENV{ZEPHYR_BASE})
zephyr_include_directories(include)

project(uart_interrupt)

target_sources(app PRIVATE ./../common/main.c)
target_sources(app PRIVATE src/driver_test.c)
```

## prj.conf
```kconfig
# Drivers and peripherals
CONFIG_UART_INTERRUPT_DRIVEN=y

# Enable runtime power management for peripheral
CONFIG_PM_DEVICE=y
CONFIG_PM_DEVICE_RUNTIME=y

CONFIG_PM=y
CONFIG_PM_S2RAM=y
CONFIG_POWEROFF=y
CONFIG_PM_S2RAM_CUSTOM_MARKING=y
CONFIG_BOOT_BANNER=n
```

## boards/nrf54h20dk_nrf54h20_cpuapp.overlay
```dts
/ {
	aliases {
		led = &led0;
		/delete-property/ led1;
	};
};

/delete-node/ &led1;

&uart136 {
	zephyr,pm-device-runtime-auto;
};
```

## boards/nrf54l15dk_nrf54l15_cpuapp.overlay
```dts
/ {
	aliases {
		led = &button3;
	};
};

&uart20 {
	zephyr,pm-device-runtime-auto;
};
```

## src/driver_test.c
```c
/*
 * Copyright (c) 2024 Nordic Semiconductor ASA
 *
 * SPDX-License-Identifier: LicenseRef-Nordic-5-Clause
 */

#include <zephyr/drivers/uart.h>
#include <zephyr/kernel.h>

static const struct device *const uart_dev = DEVICE_DT_GET(DT_CHOSEN(zephyr_console));

static uint8_t tx_buf[] =  {"a\n\r"};

static void interrupt_driven_uart_callback(const struct device *dev, void *user_data)
{

	uart_irq_update(uart_dev);
	while (uart_irq_is_pending(dev)) {
		if (uart_irq_tx_ready(dev)) {
			uart_fifo_fill(dev, tx_buf, 3);
			uart_irq_tx_disable(uart_dev);
		}
	}
}

void thread_definition(void)
{
	uart_irq_callback_user_data_set(uart_dev, interrupt_driven_uart_callback, NULL);
	while (1) {
		uart_irq_tx_enable(uart_dev);
		k_usleep(600);
	}
}
```
