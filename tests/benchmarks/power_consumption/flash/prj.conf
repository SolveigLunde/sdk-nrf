## CMakeLists.txt
```
#
# Copyright (c) 2024 Nordic Semiconductor
#
# SPDX-License-Identifier: LicenseRef-Nordic-5-Clause
#

cmake_minimum_required(VERSION 3.13.1)
find_package(Zephyr REQUIRED HINTS $ENV{ZEPHYR_BASE})
zephyr_include_directories(include)

project(flash)

target_sources(app PRIVATE ./../common/main.c)
target_sources(app PRIVATE src/driver_test.c)
```

## prj.conf
```kconfig
CONFIG_FLASH=y

# Enable runtime power management for peripheral
CONFIG_PM_DEVICE=y
CONFIG_PM_DEVICE_RUNTIME=y

CONFIG_PM=y
CONFIG_PM_S2RAM=y
CONFIG_POWEROFF=y
CONFIG_PM_S2RAM_CUSTOM_MARKING=y
CONFIG_CONSOLE=n
CONFIG_UART_CONSOLE=n
CONFIG_SERIAL=n
CONFIG_BOOT_BANNER=n
CONFIG_ASSERT=y
```

## boards/nrf54h20dk_nrf54h20_cpuapp.conf
```kconfig
CONFIG_SOC_NRF54H20_CPURAD_ENABLE=y
```

## boards/nrf54h20dk_nrf54h20_cpuapp.overlay
```dts
&mx25uw63 {
	status = "okay";
};

&exmif {
	zephyr,pm-device-runtime-auto;
};

/ {
	aliases {
		led = &led0;
		/delete-property/ led1;
		jedec-spi-nor = &mx25uw63;
	};
};

/delete-node/ &led1;
```

## boards/nrf54l15dk_nrf54l15_cpuapp.overlay
```dts
/ {
	aliases {
		led = &button3;
	};
};
```

## boards/nrf54lm20pdk_nrf54lm20a_cpuapp.overlay
```dts
/ {
	aliases {
		led = &led0;
		/delete-property/ led1;
	};
};

/delete-node/ &led1;

&mx25r64 {
	status = "okay";
};
```

## src/driver_test.c
```c
/*
 * Copyright (c) 2024 Nordic Semiconductor ASA
 *
 * SPDX-License-Identifier: LicenseRef-Nordic-5-Clause
 */

#include <zephyr/drivers/flash.h>
#include <zephyr/storage/flash_map.h>
#include <zephyr/kernel.h>

#if DT_HAS_COMPAT_STATUS_OKAY(jedec_spi_nor)
#define FLASH_NODE DT_COMPAT_GET_ANY_STATUS_OKAY(jedec_spi_nor)
#elif DT_HAS_COMPAT_STATUS_OKAY(jedec_mspi_nor)
#define FLASH_NODE DT_COMPAT_GET_ANY_STATUS_OKAY(jedec_mspi_nor)
#else
#error Unsupported flash driver
#define FLASH_NODE DT_INVALID_NODE
#endif

#define TEST_AREA_OFFSET 0xff000
#define EXPECTED_SIZE	 512
#define FLASH_PAGE_SIZE	 4096

uint8_t buf[EXPECTED_SIZE];

static const struct device *flash_dev = DEVICE_DT_GET(FLASH_NODE);

static bool suspend_req;

bool self_suspend_req(void)
{
	suspend_req = true;
	return true;
}

void thread_definition(void)
{
	int rc;
	uint8_t fill_value = 0x00;

	while (1) {
		if (suspend_req) {
			suspend_req = false;
			k_thread_suspend(k_current_get());
		}

		rc = flash_erase(flash_dev, TEST_AREA_OFFSET, FLASH_PAGE_SIZE);
		__ASSERT(rc == 0, "flash_erase %d\n", rc);
		rc = flash_fill(flash_dev, fill_value, TEST_AREA_OFFSET, EXPECTED_SIZE);
		__ASSERT(rc == 0, "flash_fill %d\n", rc);
		rc = flash_read(flash_dev, TEST_AREA_OFFSET, buf, EXPECTED_SIZE);
		__ASSERT(rc == 0, "flash_read %d\n", rc);
		for (size_t i = 0; i < EXPECTED_SIZE; i++) {
			__ASSERT(buf[i] == fill_value, "flash value %d but expected %d\n", buf[i],
				 fill_value);
			buf[i] = (uint8_t)i;
		}
		fill_value++;
	};
};
```
