## CMakeLists.txt
```
# SPDX-License-Identifier: Apache-2.0

cmake_minimum_required(VERSION 3.20.0)

LIST(APPEND QEMU_EXTRA_FLAGS -serial unix:/tmp/bt-stack-tester)

find_package(Zephyr REQUIRED HINTS $ENV{ZEPHYR_BASE})
project(tester)

zephyr_library_include_directories(${ZEPHYR_BASE}/samples/bluetooth)
zephyr_library_include_directories(${ZEPHYR_BASE}/subsys/bluetooth/mesh)
zephyr_library_include_directories(${ZEPHYR_NRF_MODULE_DIR}/subsys/bluetooth/mesh)
target_sources(app PRIVATE
    src/main.c
    src/bttester.c
    src/gap.c
    )

if(CONFIG_BT_MESH)
target_sources(app PRIVATE src/mesh.c)
target_sources(app PRIVATE src/mmdl.c)
target_sources(app PRIVATE src/model_handler.c)
endif()
```

## prj.conf
```kconfig
# CONFIG_TEST enforces minimal logging, which we don't want
CONFIG_TEST=n

# Enable the option below to measure stack usage
#CONFIG_INIT_STACKS=y
CONFIG_THREAD_NAME=y
CONFIG_HW_STACK_PROTECTION=y
CONFIG_SYSTEM_WORKQUEUE_STACK_SIZE=3072
CONFIG_MAIN_STACK_SIZE=2560
CONFIG_BT_RX_STACK_SIZE=3072

# Log configs
CONFIG_LOG=y
CONFIG_LOG_BUFFER_SIZE=4096
CONFIG_LOG_BACKEND_RTT=y
CONFIG_LOG_BACKEND_RTT_MODE_DROP=y
CONFIG_LOG_BACKEND_SHOW_COLOR=n
CONFIG_LOG_PROCESS_THREAD_STACK_SIZE=1024
CONFIG_LOG_DEFAULT_LEVEL=1

CONFIG_RTT_CONSOLE=y
CONFIG_USE_SEGGER_RTT=y
CONFIG_SEGGER_RTT_BUFFER_SIZE_UP=4096
CONFIG_UART_INTERRUPT_DRIVEN=y
CONFIG_UART_CONSOLE=n
CONFIG_UART_PIPE=y

# Setting
CONFIG_SETTINGS=y
CONFIG_FLASH=y
CONFIG_FLASH_MAP=y
CONFIG_PM_PARTITION_SIZE_SETTINGS_STORAGE=0x8000

# General Bluetooth Controller and Host Configs
CONFIG_BT=y
CONFIG_BT_CENTRAL=y
CONFIG_BT_PERIPHERAL=y
CONFIG_BT_PRIVACY=n
CONFIG_BT_SMP=y
CONFIG_BT_SMP_ENFORCE_MITM=n
CONFIG_BT_SIGNING=y
CONFIG_BT_BONDABLE=y
CONFIG_BT_ATT_PREPARE_COUNT=4
CONFIG_BT_GATT_CLIENT=y
CONFIG_BT_L2CAP_DYNAMIC_CHANNEL=y
CONFIG_BT_DEVICE_NAME="Tester"
CONFIG_BT_DEVICE_NAME_MAX=32
CONFIG_BT_DEVICE_NAME_DYNAMIC=y
CONFIG_BT_DEVICE_NAME_GATT_WRITABLE=y
CONFIG_BT_TESTING=y

# Mesh Protocol Configs
CONFIG_BT_MESH=y
CONFIG_BT_MESH_RELAY=y
CONFIG_BT_EXT_ADV=y
CONFIG_BT_MESH_PB_ADV=y
CONFIG_BT_MESH_PB_GATT=y
CONFIG_BT_MESH_LOW_POWER=y
CONFIG_BT_MESH_LPN_AUTO=n
CONFIG_BT_MESH_GATT_PROXY=y
CONFIG_BT_MESH_LABEL_COUNT=2
CONFIG_BT_MESH_SUBNET_COUNT=2
CONFIG_BT_MESH_MODEL_GROUP_COUNT=2
CONFIG_BT_MESH_APP_KEY_COUNT=4
CONFIG_BT_MESH_IV_UPDATE_TEST=y
CONFIG_BT_MESH_CFG_CLI=y
CONFIG_BT_MESH_HEALTH_CLI=y
CONFIG_BT_MESH_FRIEND=y
CONFIG_BT_MESH_FRIEND_QUEUE_SIZE=32
CONFIG_BT_MESH_RX_SEG_MAX=13
CONFIG_BT_MESH_TX_SEG_MSG_COUNT=2
CONFIG_BT_MESH_LPN_POLL_TIMEOUT=100
CONFIG_BT_MESH_TX_SEG_MAX=24
CONFIG_BT_MESH_MODEL_EXTENSIONS=y
CONFIG_BT_MESH_COMP_PAGE_1=y
CONFIG_BT_MESH_MODEL_EXTENSION_LIST_SIZE=100

# Mesh Model Configs
CONFIG_BT_MESH_PLVL_SRV=y
CONFIG_BT_MESH_BATTERY_SRV=y
CONFIG_BT_MESH_LOC_SRV=y
CONFIG_BT_MESH_PROP_SRV=y
CONFIG_BT_MESH_SENSOR_SRV=y
CONFIG_BT_MESH_TIME_SRV=y
CONFIG_BT_MESH_LIGHTNESS_SRV=y
CONFIG_BT_MESH_LIGHT_CTRL_SRV=y
CONFIG_BT_MESH_SCENE_SRV=y
CONFIG_BT_MESH_LIGHT_CTL_SRV=y
CONFIG_BT_MESH_ONOFF_CLI=y
CONFIG_BT_MESH_LVL_CLI=y
CONFIG_BT_MESH_DTT_CLI=y
CONFIG_BT_MESH_PONOFF_CLI=y
CONFIG_BT_MESH_PLVL_CLI=y
CONFIG_BT_MESH_BATTERY_CLI=y
CONFIG_BT_MESH_LOC_CLI=y
CONFIG_BT_MESH_PROP_CLI=y
CONFIG_BT_MESH_SENSOR_CLI=y
CONFIG_BT_MESH_TIME_CLI=y
CONFIG_BT_MESH_LIGHTNESS_CLI=y
CONFIG_BT_MESH_LIGHT_CTRL_CLI=y
CONFIG_BT_MESH_SCENE_CLI=y
CONFIG_BT_MESH_LIGHT_CTL_CLI=y
CONFIG_BT_MESH_LIGHT_TEMP_SRV=y
CONFIG_BT_MESH_LIGHT_XYL_CLI=y
CONFIG_BT_MESH_LIGHT_XYL_SRV=y
CONFIG_BT_MESH_LIGHT_HSL_CLI=y
CONFIG_BT_MESH_LIGHT_HSL_SRV=y
CONFIG_BT_MESH_SCHEDULER_CLI=y
CONFIG_BT_MESH_SCHEDULER_SRV=y
CONFIG_BT_MESH_SCENES_MAX=10

CONFIG_BT_MESH_LIGHT_CTRL_SRV_TIME_FADE_ON=0
CONFIG_BT_MESH_LIGHT_CTRL_SRV_TIME_FADE_PROLONG=0
CONFIG_BT_MESH_LIGHT_CTRL_SRV_TIME_FADE_STANDBY_AUTO=0
CONFIG_BT_MESH_LIGHT_CTRL_SRV_TIME_FADE_STANDBY_MANUAL=0
CONFIG_BT_MESH_LIGHT_CTRL_SRV_TIME_PROLONG=0
```

## boards/nrf52840dk_nrf52840.conf
```kconfig
CONFIG_NVS=y
CONFIG_SOC_FLASH_NRF_PARTIAL_ERASE=y
```

## boards/nrf54l15dk_nrf54l15_cpuapp.conf
```kconfig
CONFIG_ZMS=y
CONFIG_BT_RX_STACK_SIZE=5120
CONFIG_BT_MESH_ADV_STACK_SIZE=2048
```

## boards/nrf52840dk_nrf52840.overlay
```dts
/*
 * Copyright (c) 2023 Nordic Semiconductor ASA
 *
 * SPDX-License-Identifier: LicenseRef-Nordic-5-Clause
 */

/ {
	chosen {
		zephyr,uart-pipe = &uart0;
	};
};

&uart0 {
	compatible = "nordic,nrf-uarte";
	current-speed = <115200>;
	status = "okay";
	hw-flow-control;
};
```

## boards/nrf54l15dk_nrf54l15_cpuapp.overlay
```dts
/*
 * Copyright (c) 2024 Nordic Semiconductor ASA
 *
 * SPDX-License-Identifier: LicenseRef-Nordic-5-Clause
 */

/ {
	chosen {
		zephyr,uart-pipe = &uart20;
	};
};

&uart20 {
	compatible = "nordic,nrf-uarte";
	current-speed = <115200>;
	status = "okay";
	hw-flow-control;
};
```

## src/main.c
```c
/* main.c - Application main entry point */

/*
 * Copyright (c) 2015-2016 Intel Corporation
 *
 * SPDX-License-Identifier: Apache-2.0
 */

#include <zephyr/kernel.h>
#include <zephyr/types.h>
#include <zephyr/toolchain.h>

#include <zephyr/logging/log.h>
#define LOG_MODULE_NAME bttester_main
LOG_MODULE_REGISTER(LOG_MODULE_NAME);

#include "bttester.h"

int main(void)
{
	tester_init();

	return 0;
}
```

## src/bttester.c
```c
/* bttester.c - Bluetooth Tester */

/*
 * Copyright (c) 2015-2016 Intel Corporation
 *
 * SPDX-License-Identifier: Apache-2.0
 */

#include <zephyr/kernel.h>
#include <stdio.h>
#include <string.h>
#include <zephyr/types.h>

#include <zephyr/toolchain.h>
#include <zephyr/bluetooth/bluetooth.h>
#include <zephyr/sys/byteorder.h>
#include <zephyr/drivers/uart_pipe.h>

#include <zephyr/logging/log.h>
#define LOG_MODULE_NAME bttester
LOG_MODULE_REGISTER(LOG_MODULE_NAME);

#include "bttester.h"

#define STACKSIZE 4096
static K_THREAD_STACK_DEFINE(stack, STACKSIZE);
static struct k_thread cmd_thread;

#define CMD_QUEUED 2
struct btp_buf {
	intptr_t _reserved;
	union {
		uint8_t data[BTP_MTU];
		struct btp_hdr hdr;
	};
};

static struct btp_buf cmd_buf[CMD_QUEUED];

static K_FIFO_DEFINE(cmds_queue);
static K_FIFO_DEFINE(avail_queue);

static void supported_commands(uint8_t *data, uint16_t len)
{
	uint8_t buf[1];
	struct core_read_supported_commands_rp *rp = (void *) buf;

	(void)memset(buf, 0, sizeof(buf));

	tester_set_bit(buf, CORE_READ_SUPPORTED_COMMANDS);
	tester_set_bit(buf, CORE_READ_SUPPORTED_SERVICES);
	tester_set_bit(buf, CORE_REGISTER_SERVICE);
	tester_set_bit(buf, CORE_UNREGISTER_SERVICE);

	tester_send(BTP_SERVICE_ID_CORE, CORE_READ_SUPPORTED_COMMANDS,
		    BTP_INDEX_NONE, (uint8_t *) rp, sizeof(buf));
}

static void supported_services(uint8_t *data, uint16_t len)
{
	uint8_t buf[1];
	struct core_read_supported_services_rp *rp = (void *) buf;

	(void)memset(buf, 0, sizeof(buf));

	tester_set_bit(buf, BTP_SERVICE_ID_CORE);
	tester_set_bit(buf, BTP_SERVICE_ID_GAP);
#if defined(CONFIG_BT_MESH)
	tester_set_bit(buf, BTP_SERVICE_ID_MESH);
	tester_set_bit(buf, BTP_SERVICE_ID_MMDL);
#endif /* CONFIG_BT_MESH */

	tester_send(BTP_SERVICE_ID_CORE, CORE_READ_SUPPORTED_SERVICES,
		    BTP_INDEX_NONE, (uint8_t *) rp, sizeof(buf));
}

static void register_service(uint8_t *data, uint16_t len)
{
	struct core_register_service_cmd *cmd = (void *) data;
	uint8_t status;

	switch (cmd->id) {
	case BTP_SERVICE_ID_GAP:
		status = tester_init_gap();
		/* Rsp with success status will be handled by bt enable cb */
		if (status == BTP_STATUS_FAILED) {
			goto rsp;
		}
		return;
#if defined(CONFIG_BT_MESH)
	case BTP_SERVICE_ID_MESH:
		status = tester_init_mesh();
		break;
	case BTP_SERVICE_ID_MMDL:
		status = tester_init_mmdl();
		break;
#endif /* CONFIG_BT_MESH */
	default:
		LOG_WRN("unknown id: 0x%02x", cmd->id);
		status = BTP_STATUS_FAILED;
		break;
	}

rsp:
	tester_rsp(BTP_SERVICE_ID_CORE, CORE_REGISTER_SERVICE, BTP_INDEX_NONE,
		   status);
}

static void unregister_service(uint8_t *data, uint16_t len)
{
	struct core_unregister_service_cmd *cmd = (void *) data;
	uint8_t status;

	switch (cmd->id) {
	case BTP_SERVICE_ID_GAP:
		status = tester_unregister_gap();
		break;
#if defined(CONFIG_BT_MESH)
	case BTP_SERVICE_ID_MESH:
		status = tester_unregister_mesh();
		break;
	case BTP_SERVICE_ID_MMDL:
		status = tester_unregister_mmdl();
		break;
#endif /* CONFIG_BT_MESH */
	default:
		LOG_WRN("unknown id: 0x%x", cmd->id);
		status = BTP_STATUS_FAILED;
		break;
	}

	tester_rsp(BTP_SERVICE_ID_CORE, CORE_UNREGISTER_SERVICE, BTP_INDEX_NONE,
		   status);
}

static void handle_core(uint8_t opcode, uint8_t index, uint8_t *data,
			uint16_t len)
{
	if (index != BTP_INDEX_NONE) {
		LOG_WRN("index != BTP_INDEX_NONE: 0x%x", index);
		tester_rsp(BTP_SERVICE_ID_CORE, opcode, index, BTP_STATUS_FAILED);
		return;
	}

	switch (opcode) {
	case CORE_READ_SUPPORTED_COMMANDS:
		supported_commands(data, len);
		return;
	case CORE_READ_SUPPORTED_SERVICES:
		supported_services(data, len);
		return;
	case CORE_REGISTER_SERVICE:
		register_service(data, len);
		return;
	case CORE_UNREGISTER_SERVICE:
		unregister_service(data, len);
		return;
	default:
		LOG_WRN("unknown opcode: 0x%x", opcode);
		tester_rsp(BTP_SERVICE_ID_CORE, opcode, BTP_INDEX_NONE,
			   BTP_STATUS_UNKNOWN_CMD);
		return;
	}
}

static void cmd_handler(void *p1, void *p2, void *p3)
{
	while (1) {
		struct btp_buf *cmd;
		uint16_t len;

		cmd = k_fifo_get(&cmds_queue, K_FOREVER);

		len = sys_le16_to_cpu(cmd->hdr.len);

		/* TODO
		 * verify if service is registered before calling handler
		 */

		switch (cmd->hdr.service) {
		case BTP_SERVICE_ID_CORE:
			handle_core(cmd->hdr.opcode, cmd->hdr.index,
				    cmd->hdr.data, len);
			break;
		case BTP_SERVICE_ID_GAP:
			tester_handle_gap(cmd->hdr.opcode, cmd->hdr.index,
					  cmd->hdr.data, len);
			break;
#if defined(CONFIG_BT_MESH)
		case BTP_SERVICE_ID_MESH:
			tester_handle_mesh(cmd->hdr.opcode, cmd->hdr.index,
					   cmd->hdr.data, len);
			break;
		case BTP_SERVICE_ID_MMDL:
			tester_handle_mmdl(cmd->hdr.opcode, cmd->hdr.index,
					   cmd->hdr.data, len);
			break;
#endif /* CONFIG_BT_MESH */
		default:
			LOG_WRN("unknown service: 0x%x", cmd->hdr.service);
			tester_rsp(cmd->hdr.service, cmd->hdr.opcode,
				   cmd->hdr.index, BTP_STATUS_FAILED);
			break;
		}

		k_fifo_put(&avail_queue, cmd);
	}
}

static uint8_t *recv_cb(uint8_t *buf, size_t *off)
{
	struct btp_hdr *cmd = (void *) buf;
	struct btp_buf *new_buf;
	uint16_t len;

	if (*off < sizeof(*cmd)) {
		return buf;
	}

	len = sys_le16_to_cpu(cmd->len);
	if (len > BTP_MTU - sizeof(*cmd)) {
		LOG_ERR("BT tester: invalid packet length");
		*off = 0;
		return buf;
	}

	if (*off < sizeof(*cmd) + len) {
		return buf;
	}

	new_buf =  k_fifo_get(&avail_queue, K_NO_WAIT);
	if (!new_buf) {
		LOG_ERR("BT tester: RX overflow");
		*off = 0;
		return buf;
	}

	k_fifo_put(&cmds_queue, CONTAINER_OF(buf, struct btp_buf, data[0]));

	*off = 0;
	return new_buf->data;
}

void tester_init(void)
{
	int i;
	struct btp_buf *buf;

	LOG_DBG("Initializing tester");

	for (i = 0; i < CMD_QUEUED; i++) {
		k_fifo_put(&avail_queue, &cmd_buf[i]);
	}

	k_thread_create(&cmd_thread, stack, STACKSIZE, cmd_handler,
			NULL, NULL, NULL, K_PRIO_COOP(7), 0, K_NO_WAIT);

	buf = k_fifo_get(&avail_queue, K_NO_WAIT);
	uart_pipe_register(buf->data, BTP_MTU, recv_cb);

	tester_send(BTP_SERVICE_ID_CORE, CORE_EV_IUT_READY, BTP_INDEX_NONE,
		    NULL, 0);
}

void tester_send(uint8_t service, uint8_t opcode, uint8_t index, uint8_t *data,
		 size_t len)
{
	struct btp_hdr msg;

	msg.service = service;
	msg.opcode = opcode;
	msg.index = index;
	msg.len = len;

	uart_pipe_send((uint8_t *)&msg, sizeof(msg));
	if (data && len) {
		uart_pipe_send(data, len);
	}
}

void tester_rsp(uint8_t service, uint8_t opcode, uint8_t index, uint8_t status)
{
	struct btp_status s;

	if (status == BTP_STATUS_SUCCESS) {
		tester_send(service, opcode, index, NULL, 0);
		return;
	}

	s.code = status;
	tester_send(service, BTP_STATUS, index, (uint8_t *) &s, sizeof(s));
}
```

## src/bttester.h
```c
/* bttester.h - Bluetooth tester headers */

/*
 * Copyright (c) 2015-2016 Intel Corporation
 *
 * SPDX-License-Identifier: LicenseRef-Nordic-5-Clause
 */

#include <zephyr/sys/util.h>

#define BTP_MTU 1024
#define BTP_DATA_MAX_SIZE (BTP_MTU - sizeof(struct btp_hdr))

#define BTP_INDEX_NONE		0xff

#define BTP_SERVICE_ID_CORE	0
#define BTP_SERVICE_ID_GAP	1
#define BTP_SERVICE_ID_MESH	4
#define BTP_SERVICE_ID_MMDL	5

#define BTP_STATUS_SUCCESS	0x00
#define BTP_STATUS_FAILED	0x01
#define BTP_STATUS_UNKNOWN_CMD	0x02
#define BTP_STATUS_NOT_READY	0x03

struct btp_hdr {
	uint8_t  service;
	uint8_t  opcode;
	uint8_t  index;
	uint16_t len;
	uint8_t  data[];
} __packed;

#define BTP_STATUS			0x00
struct btp_status {
	uint8_t code;
} __packed;

/* Core Service */
#define CORE_READ_SUPPORTED_COMMANDS	0x01
struct core_read_supported_commands_rp {
	uint8_t data[0];
} __packed;

#define CORE_READ_SUPPORTED_SERVICES	0x02
struct core_read_supported_services_rp {
	uint8_t data[0];
} __packed;

#define CORE_REGISTER_SERVICE		0x03
struct core_register_service_cmd {
	uint8_t id;
} __packed;

#define CORE_UNREGISTER_SERVICE		0x04
struct core_unregister_service_cmd {
	uint8_t id;
} __packed;

/* events */
#define CORE_EV_IUT_READY		0x80

/* GAP Service */
/* commands */

#define GAP_SETTINGS_POWERED		0
#define GAP_SETTINGS_CONNECTABLE	1
#define GAP_SETTINGS_FAST_CONNECTABLE	2
#define GAP_SETTINGS_DISCOVERABLE	3
#define GAP_SETTINGS_BONDABLE		4
#define GAP_SETTINGS_LINK_SEC_3		5
#define GAP_SETTINGS_SSP		6
#define GAP_SETTINGS_BREDR		7
#define GAP_SETTINGS_HS			8
#define GAP_SETTINGS_LE			9
#define GAP_SETTINGS_ADVERTISING	10
#define GAP_SETTINGS_SC			11
#define GAP_SETTINGS_DEBUG_KEYS		12
#define GAP_SETTINGS_PRIVACY		13
#define GAP_SETTINGS_CONTROLLER_CONFIG	14
#define GAP_SETTINGS_STATIC_ADDRESS	15

#define GAP_READ_CONTROLLER_INFO	0x03
struct gap_read_controller_info_rp {
	uint8_t  address[6];
	uint32_t supported_settings;
	uint32_t current_settings;
	uint8_t  cod[3];
	uint8_t  name[249];
	uint8_t  short_name[11];
} __packed;

static inline void tester_set_bit(uint8_t *addr, unsigned int bit)
{
	uint8_t *p = addr + (bit / 8U);

	*p |= BIT(bit % 8);
}

static inline uint8_t tester_test_bit(const uint8_t *addr, unsigned int bit)
{
	const uint8_t *p = addr + (bit / 8U);

	return *p & BIT(bit % 8);
}

/* MESH Service */
/* commands */
#define MESH_READ_SUPPORTED_COMMANDS	0x01
struct mesh_read_supported_commands_rp {
	uint8_t data[0];
} __packed;

#define MESH_OUT_BLINK			BIT(0)
#define MESH_OUT_BEEP			BIT(1)
#define MESH_OUT_VIBRATE		BIT(2)
#define MESH_OUT_DISPLAY_NUMBER		BIT(3)
#define MESH_OUT_DISPLAY_STRING		BIT(4)

#define MESH_IN_PUSH			BIT(0)
#define MESH_IN_TWIST			BIT(1)
#define MESH_IN_ENTER_NUMBER		BIT(2)
#define MESH_IN_ENTER_STRING		BIT(3)

#define MESH_CONFIG_PROVISIONING	0x02
struct mesh_config_provisioning_cmd {
	uint8_t uuid[16];
	uint8_t static_auth[16];
	uint8_t out_size;
	uint16_t out_actions;
	uint8_t in_size;
	uint16_t in_actions;
} __packed;

#define MESH_PROVISION_NODE		0x03
struct mesh_provision_node_cmd {
	uint8_t net_key[16];
	uint16_t net_key_idx;
	uint8_t flags;
	uint32_t iv_index;
	uint32_t seq_num;
	uint16_t addr;
	uint8_t dev_key[16];
} __packed;

#define MESH_INIT			0x04
#define MESH_RESET			0x05
#define MESH_START			0x78

/* events */
#define MESH_EV_OUT_NUMBER_ACTION	0x80
struct mesh_out_number_action_ev {
	uint16_t action;
	uint32_t number;
} __packed;

#define MESH_EV_OUT_STRING_ACTION	0x81
struct mesh_out_string_action_ev {
	uint8_t string_len;
	uint8_t string[];
} __packed;

#define MESH_EV_IN_ACTION		0x82
struct mesh_in_action_ev {
	uint16_t action;
	uint8_t size;
} __packed;

#define MESH_EV_PROVISIONED		0x83

#define MESH_PROV_BEARER_PB_ADV		0x00
#define MESH_PROV_BEARER_PB_GATT	0x01
#define MESH_EV_PROV_LINK_OPEN		0x84
struct mesh_prov_link_open_ev {
	uint8_t bearer;
} __packed;

#define MESH_EV_PROV_LINK_CLOSED	0x85
struct mesh_prov_link_closed_ev {
	uint8_t bearer;
} __packed;

#define MESH_EV_NET_RECV		0x86
struct mesh_net_recv_ev {
	uint8_t ttl;
	uint8_t ctl;
	uint16_t src;
	uint16_t dst;
	uint8_t payload_len;
	uint8_t payload[];
} __packed;

#define MESH_EV_INVALID_BEARER		0x87
struct mesh_invalid_bearer_ev {
	uint8_t opcode;
} __packed;

#define MESH_EV_INCOMP_TIMER_EXP	0x88

/* MMDL Service */
struct mesh_model_transition {
	uint8_t time;
	uint8_t delay;
} __packed;

/* commands */
#define MMDL_READ_SUPPORTED_COMMANDS	0x01
struct mmdl_read_supported_commands_rp {
	uint8_t data[0];
} __packed;

#define MMDL_GEN_ONOFF_GET	0x02

#define MMDL_GEN_ONOFF_SET	0x03
struct mesh_gen_onoff_set {
	uint8_t ack;
	uint8_t onoff;
	struct mesh_model_transition transition[0];
} __packed;

#define MMDL_GEN_LVL_GET	0x04

#define MMDL_GEN_LVL_SET	0x05
struct mesh_gen_lvl_set {
	uint8_t ack;
	int16_t lvl;
	struct mesh_model_transition transition[0];
} __packed;

#define MMDL_GEN_LVL_DELTA_SET	0x06
struct mesh_gen_lvl_delta_set {
	uint8_t ack;
	int32_t delta;
	struct mesh_model_transition transition[0];
} __packed;

#define MMDL_GEN_LVL_MOVE_SET	0x07
struct mesh_gen_lvl_move_set {
	uint8_t ack;
	int16_t delta;
	struct mesh_model_transition transition[0];
} __packed;

#define MMDL_GEN_DTT_GET	0x08

#define MMDL_GEN_DTT_SET	0x09
struct mesh_gen_dtt_set {
	uint8_t ack;
	uint8_t transition_time;
} __packed;

#define MMDL_GEN_PONOFF_GET	0x0a

#define MMDL_GEN_PONOFF_SET	0x0b
struct mesh_gen_ponoff_set {
	uint8_t ack;
	uint8_t on_power_up;
} __packed;

#define MMDL_GEN_PLVL_GET	0x0c

#define MMDL_GEN_PLVL_SET	0x0d
struct mesh_gen_plvl_set {
	uint8_t ack;
	uint16_t power_lvl;
	struct mesh_model_transition transition[0];
} __packed;

#define MMDL_GEN_PLVL_LAST_GET	0x0e

#define MMDL_GEN_PLVL_DFLT_GET	0x0f

#define MMDL_GEN_PLVL_DFLT_SET	0x10
struct mesh_gen_plvl_dflt_set {
	uint8_t ack;
	uint16_t power_dflt;
} __packed;

#define MMDL_GEN_PLVL_RANGE_GET	0x11

#define MMDL_GEN_PLVL_RANGE_SET	0x12
struct mesh_gen_plvl_range_set {
	uint8_t ack;
	uint16_t range_min;
	uint16_t range_max;
} __packed;

#define MMDL_GEN_BATTERY_GET	0x13

#define MMDL_GEN_LOC_GLOBAL_GET	0x14

#define MMDL_GEN_LOC_LOCAL_GET	0x15

#define MMDL_GEN_LOC_GLOBAL_SET	0x16
struct mesh_gen_loc_global_set {
	uint8_t ack;
	uint32_t latitude;
	uint32_t longitude;
	uint16_t altitude;
} __packed;

#define MMDL_GEN_LOC_LOCAL_SET	0x17
struct mesh_gen_loc_local_set {
	uint8_t ack;
	uint16_t north;
	uint16_t east;
	uint16_t altitude;
	uint8_t floor;
	uint16_t loc_uncertainty;
} __packed;

#define MMDL_GEN_PROPS_GET	0x18
struct mesh_gen_props_get {
	uint8_t kind;
	uint16_t id;
} __packed;

#define MMDL_GEN_PROP_GET	0x19
struct mesh_gen_prop_get {
	uint8_t kind;
	uint16_t id;
} __packed;

#define MMDL_GEN_PROP_SET	0x1a
struct mesh_gen_prop_set {
	uint8_t ack;
	uint8_t kind;
	uint16_t id;
	uint8_t access;
	uint8_t len;
	uint8_t data[0];
} __packed;

#define MMDL_SENSOR_DESC_GET	0x1b
struct mesh_sensor_desc_get {
	uint16_t id;
} __packed;

#define MMDL_SENSOR_GET	0x1c
struct mesh_sensor_get {
	uint16_t id;
} __packed;

#define MMDL_SENSOR_COLUMN_GET	0x1d
struct mesh_sensor_column_get {
	uint16_t id;
	uint8_t len;
	uint8_t data[0];
} __packed;

#define MMDL_SENSOR_SERIES_GET	0x1e
struct mesh_sensor_series_get {
	uint16_t id;
	uint8_t len;
	uint8_t data[0];
} __packed;

#define MMDL_SENSOR_CADENCE_GET	0x1f
struct mesh_sensor_cadence_get {
	uint16_t id;
} __packed;

#define MMDL_SENSOR_CADENCE_SET	0x20
struct mesh_sensor_cadence_set {
	uint8_t ack;
	uint16_t id;
	uint16_t len;
	uint8_t data[0];
} __packed;

#define MMDL_SENSOR_SETTINGS_GET	0x21
struct mesh_sensor_settings_get {
	uint16_t id;
} __packed;

#define MMDL_SENSOR_SETTING_GET	0x22
struct mesh_sensor_setting_get {
	uint16_t id;
	uint16_t setting_id;
} __packed;

#define MMDL_SENSOR_SETTING_SET	0x23
struct mesh_sensor_setting_set {
	uint8_t ack;
	uint16_t id;
	uint16_t setting_id;
	uint8_t len;
	uint8_t data[0];
} __packed;

#define MMDL_TIME_GET	0x24
#define MMDL_TIME_SET	0x25
struct mesh_time_set {
	uint8_t tai[5];
	uint8_t subsecond;
	uint8_t uncertainty;
	uint16_t tai_utc_delta;
	uint8_t time_zone_offset;
} __packed;

#define MMDL_TIME_ROLE_GET	0x26
#define MMDL_TIME_ROLE_SET	0x27
struct mesh_time_role_set {
	uint8_t role;
} __packed;

#define MMDL_TIME_ZONE_GET	0x28
#define MMDL_TIME_ZONE_SET	0x29
struct mesh_time_zone_set {
	int16_t new_offset;
	uint64_t timestamp;
} __packed;

#define MMDL_TIME_TAI_UTC_DELTA_GET	0x2a
#define MMDL_TIME_TAI_UTC_DELTA_SET	0x2b
struct mesh_time_tai_utc_delta_set {
	int16_t delta_new;
	uint64_t timestamp;
} __packed;

#define MMDL_LIGHT_LIGHTNESS_GET	0x2c
#define MMDL_LIGHT_LIGHTNESS_SET	0x2d
struct mesh_light_lightness_set {
	uint8_t ack;
	uint16_t lightness;
	struct mesh_model_transition transition[0];
} __packed;

#define MMDL_LIGHT_LIGHTNESS_LINEAR_GET	0x2e
#define MMDL_LIGHT_LIGHTNESS_LINEAR_SET	0x2f

#define MMDL_LIGHT_LIGHTNESS_LAST_GET	0x30
#define MMDL_LIGHT_LIGHTNESS_DEFAULT_GET	0x31
#define MMDL_LIGHT_LIGHTNESS_DEFAULT_SET	0x32
struct mesh_light_lightness_default_set {
	uint8_t ack;
	uint16_t dflt;
} __packed;

#define MMDL_LIGHT_LIGHTNESS_RANGE_GET	0x33
#define MMDL_LIGHT_LIGHTNESS_RANGE_SET	0x34
struct mesh_light_lightness_range_set {
	uint8_t ack;
	uint16_t min;
	uint16_t max;
} __packed;

#define MMDL_LIGHT_LC_MODE_GET	0x35
#define MMDL_LIGHT_LC_MODE_SET	0x36
struct mesh_light_lc_mode_set {
	uint8_t ack;
	uint8_t enabled;
} __packed;

#define MMDL_LIGHT_LC_OCCUPANCY_MODE_GET	0x37
#define MMDL_LIGHT_LC_OCCUPANCY_MODE_SET	0x38
struct mesh_light_lc_occupancy_mode_set {
	uint8_t ack;
	uint8_t enabled;
} __packed;

#define MMDL_LIGHT_LC_LIGHT_ONOFF_MODE_GET	0x39
#define MMDL_LIGHT_LC_LIGHT_ONOFF_MODE_SET	0x3a
struct mesh_light_lc_light_onoff_mode_set {
	uint8_t ack;
	uint8_t onoff;
	struct mesh_model_transition transition[0];
} __packed;

#define MMDL_LIGHT_LC_PROPERTY_GET	0x3b
struct mesh_light_lc_property_get {
	uint16_t id;
} __packed;

#define MMDL_LIGHT_LC_PROPERTY_SET	0x3c
struct mesh_light_lc_property_set {
	uint8_t ack;
	uint16_t id;
	uint16_t val;
} __packed;

#define MMDL_SENSOR_DATA_SET	0x3d
struct mesh_sensor_data_set_cmd {
	uint16_t prop_id;
	uint8_t len;
	uint8_t data[];
} __packed;

#define MMDL_LIGHT_CTL_STATES_GET	0x3e
#define MMDL_LIGHT_CTL_STATES_SET	0x3f
struct mesh_light_ctl_states_set {
	uint8_t ack;
	uint16_t light;
	uint16_t temp;
	int16_t delta_uv;
	struct mesh_model_transition transition[0];
} __packed;

#define MMDL_LIGHT_CTL_TEMPERATURE_GET	0x40
#define MMDL_LIGHT_CTL_TEMPERATURE_SET	0x41
struct mesh_light_ctl_temperature_set {
	uint8_t ack;
	uint16_t temp;
	int16_t delta_uv;
	struct mesh_model_transition transition[0];
} __packed;

#define MMDL_LIGHT_CTL_DEFAULT_GET	0x42
#define MMDL_LIGHT_CTL_DEFAULT_SET	0x43
struct mesh_light_ctl_default_set {
	uint8_t ack;
	uint16_t light;
	uint16_t temp;
	int16_t delta_uv;
} __packed;
#define MMDL_LIGHT_CTL_TEMPERATURE_RANGE_GET	0x44
#define MMDL_LIGHT_CTL_TEMPERATURE_RANGE_SET	0x45
struct mesh_light_ctl_temp_range_set {
	uint8_t ack;
	uint16_t min;
	uint16_t max;
} __packed;

#define MMDL_SCENE_GET	0x46
#define MMDL_SCENE_REGISTER_GET	0x47
#define MMDL_SCENE_STORE_PROCEDURE	0x48
struct mesh_scene_ctl_store_procedure {
	uint8_t ack;
	uint16_t scene;
} __packed;
#define MMDL_SCENE_RECALL	0x49
struct mesh_scene_ctl_recall {
	uint8_t ack;
	uint16_t scene;
	struct mesh_model_transition transition[0];
} __packed;

#define MMDL_LIGHT_XYL_GET 0x4a
#define MMDL_LIGHT_XYL_SET 0x4b
struct mesh_light_xyl_set {
	uint8_t ack;
	uint16_t lightness;
	uint16_t x;
	uint16_t y;
	struct mesh_model_transition transition[0];
} __packed;

#define MMDL_LIGHT_XYL_TARGET_GET 0x4c
#define MMDL_LIGHT_XYL_DEFAULT_GET 0x4d
#define MMDL_LIGHT_XYL_DEFAULT_SET 0x4e
struct mesh_light_xyl_default_set {
	uint8_t ack;
	uint16_t lightness;
	uint16_t x;
	uint16_t y;
} __packed;

#define MMDL_LIGHT_XYL_RANGE_GET 0x4f
#define MMDL_LIGHT_XYL_RANGE_SET 0x50
struct mesh_light_xyl_range_set {
	uint8_t ack;
	uint16_t min_x;
	uint16_t min_y;
	uint16_t max_x;
	uint16_t max_y;
} __packed;

#define MMDL_LIGHT_HSL_GET 0x51
#define MMDL_LIGHT_HSL_SET 0x52
struct mesh_light_hsl_set {
	uint8_t ack;
	uint16_t lightness;
	uint16_t hue;
	uint16_t saturation;
	struct mesh_model_transition transition[0];
} __packed;

#define MMDL_LIGHT_HSL_TARGET_GET 0x53
#define MMDL_LIGHT_HSL_DEFAULT_GET 0x54
#define MMDL_LIGHT_HSL_DEFAULT_SET 0x55
struct mesh_light_hsl_default_set {
	uint8_t ack;
	uint16_t lightness;
	uint16_t hue;
	uint16_t saturation;
} __packed;

#define MMDL_LIGHT_HSL_RANGE_GET 0x56
#define MMDL_LIGHT_HSL_RANGE_SET 0x57
struct mesh_light_hsl_range_set {
	uint8_t ack;
	uint16_t hue_min;
	uint16_t saturation_min;
	uint16_t hue_max;
	uint16_t saturation_max;
} __packed;

#define MMDL_LIGHT_HSL_HUE_GET 0x58
#define MMDL_LIGHT_HSL_HUE_SET 0x59
struct mesh_light_hsl_hue_set {
	uint8_t ack;
	uint16_t hue;
	struct mesh_model_transition transition[0];
} __packed;

#define MMDL_LIGHT_HSL_SATURATION_GET 0x5a
#define MMDL_LIGHT_HSL_SATURATION_SET 0x5b
struct mesh_light_hsl_saturation_set {
	uint8_t ack;
	uint16_t saturation;
	struct mesh_model_transition transition[0];
} __packed;

#define MMDL_SCHEDULER_GET 0x5c
#define MMDL_SCHEDULER_ACTION_GET 0x5d
struct mesh_scheduler_action_get {
	uint8_t index;
} __packed;

#define MMDL_SCHEDULER_ACTION_SET 0x5e
struct mesh_scheduler_action_set {
	uint8_t ack;
	uint8_t index;
	uint8_t year;
	uint16_t month;
	uint8_t day;
	uint8_t hour;
	uint8_t minute;
	uint8_t second;
	uint8_t day_of_week;
	uint8_t action;
	uint8_t transition_time;
	uint16_t scene_number;
} __packed;

void tester_init(void);
void tester_rsp(uint8_t service, uint8_t opcode, uint8_t index, uint8_t status);
void tester_send(uint8_t service, uint8_t opcode, uint8_t index, uint8_t *data,
		 size_t len);

uint8_t tester_init_gap(void);
uint8_t tester_unregister_gap(void);
void tester_handle_gap(uint8_t opcode, uint8_t index, uint8_t *data,
		       uint16_t len);
uint8_t tester_init_gatt(void);
uint8_t tester_unregister_gatt(void);
void tester_handle_gatt(uint8_t opcode, uint8_t index, uint8_t *data,
			uint16_t len);

#if defined(CONFIG_BT_L2CAP_DYNAMIC_CHANNEL)
uint8_t tester_init_l2cap(void);
uint8_t tester_unregister_l2cap(void);
void tester_handle_l2cap(uint8_t opcode, uint8_t index, uint8_t *data,
			 uint16_t len);
#endif /* CONFIG_BT_L2CAP_DYNAMIC_CHANNEL */

#if defined(CONFIG_BT_MESH)
uint8_t tester_init_mesh(void);
uint8_t tester_unregister_mesh(void);
void tester_handle_mesh(uint8_t opcode, uint8_t index, uint8_t *data,
			uint16_t len);
uint8_t tester_init_mmdl(void);
uint8_t tester_unregister_mmdl(void);
void tester_handle_mmdl(uint8_t opcode, uint8_t index, uint8_t *data,
			uint16_t len);
#endif /* CONFIG_BT_MESH */
```

## src/gap.c
```c
/* gap.c - Bluetooth GAP Tester */

/*
 * Copyright (c) 2015-2016 Intel Corporation
 *
 * SPDX-License-Identifier: Apache-2.0
 */

#include <zephyr/sys/atomic.h>
#include <zephyr/types.h>
#include <string.h>

#include <zephyr/toolchain.h>
#include <zephyr/bluetooth/bluetooth.h>
#include <zephyr/bluetooth/conn.h>
#include <zephyr/bluetooth/hci.h>

#include <zephyr/sys/byteorder.h>
#include <zephyr/net_buf.h>

#include <zephyr/logging/log.h>
#define LOG_MODULE_NAME bttester_gap
LOG_MODULE_REGISTER(LOG_MODULE_NAME);

#include "bttester.h"

#define CONTROLLER_INDEX 0
#define CONTROLLER_NAME "btp_tester"

#define BT_LE_AD_DISCOV_MASK (BT_LE_AD_LIMITED | BT_LE_AD_GENERAL)
#define ADV_BUF_LEN (sizeof(struct gap_device_found_ev) + 2 * 31)

static atomic_t current_settings;
struct bt_conn_auth_cb cb;

#if !defined(CONFIG_BT_SMP_OOB_LEGACY_PAIR_ONLY)
static struct bt_le_oob oob_sc_local = { 0 };
#endif /* !defined(CONFIG_BT_SMP_OOB_LEGACY_PAIR_ONLY) */


static void controller_info(uint8_t *data, uint16_t len)
{
	struct gap_read_controller_info_rp rp;
	uint32_t supported_settings;

	(void)memset(&rp, 0, sizeof(rp));

	struct bt_le_oob oob_local = { 0 };

	bt_le_oob_get_local(BT_ID_DEFAULT, &oob_local);
	memcpy(rp.address, &oob_local.addr.a, sizeof(bt_addr_t));

	/*
	 * Re-use the oob data read here in get_oob_sc_local_data()
	 */
#if !defined(CONFIG_BT_SMP_OOB_LEGACY_PAIR_ONLY)
	oob_sc_local = oob_local;
#endif /* !defined(CONFIG_BT_SMP_OOB_LEGACY_PAIR_ONLY) */

	/*
	 * If privacy is used, the device uses random type address, otherwise
	 * static random or public type address is used.
	 */
#if !defined(CONFIG_BT_PRIVACY)
	if (oob_local.addr.type == BT_ADDR_LE_RANDOM) {
		atomic_set_bit(&current_settings, GAP_SETTINGS_STATIC_ADDRESS);
	}
#endif /* CONFIG_BT_PRIVACY */

	supported_settings = BIT(GAP_SETTINGS_POWERED);
	supported_settings |= BIT(GAP_SETTINGS_CONNECTABLE);
	supported_settings |= BIT(GAP_SETTINGS_BONDABLE);
	supported_settings |= BIT(GAP_SETTINGS_LE);
	supported_settings |= BIT(GAP_SETTINGS_ADVERTISING);

	rp.supported_settings = sys_cpu_to_le32(supported_settings);
	rp.current_settings = sys_cpu_to_le32(current_settings);

	memcpy(rp.name, CONTROLLER_NAME, sizeof(CONTROLLER_NAME));

	tester_send(BTP_SERVICE_ID_GAP, GAP_READ_CONTROLLER_INFO,
		    CONTROLLER_INDEX, (uint8_t *) &rp, sizeof(rp));
}

void tester_handle_gap(uint8_t opcode, uint8_t index, uint8_t *data,
		       uint16_t len)
{
	LOG_DBG("opcode: 0x%02x", opcode);
	switch (opcode) {
	case GAP_READ_CONTROLLER_INFO:
		controller_info(data, len);
		return;
	default:
		LOG_WRN("Unknown opcode: 0x%x", opcode);
		tester_rsp(BTP_SERVICE_ID_GAP, opcode, index,
			   BTP_STATUS_UNKNOWN_CMD);
		return;
	}
}

static void tester_init_gap_cb(int err)
{
	if (err) {
		tester_rsp(BTP_SERVICE_ID_CORE, CORE_REGISTER_SERVICE,
			   BTP_INDEX_NONE, BTP_STATUS_FAILED);
		LOG_WRN("Error: %d", err);
		return;
	}

	tester_rsp(BTP_SERVICE_ID_CORE, CORE_REGISTER_SERVICE, BTP_INDEX_NONE,
		   BTP_STATUS_SUCCESS);
}

uint8_t tester_init_gap(void)
{
	int err;

	err = bt_enable(tester_init_gap_cb);
	if (err < 0) {
		LOG_ERR("Unable to enable Bluetooth: %d", err);
		return BTP_STATUS_FAILED;
	}

	return BTP_STATUS_SUCCESS;
}

uint8_t tester_unregister_gap(void)
{
	return BTP_STATUS_SUCCESS;
}
```

## src/mesh.c
```c
/* mesh.c - Bluetooth Mesh Tester */

/*
 * Copyright (c) 2017 Intel Corporation
 *
 * SPDX-License-Identifier: LicenseRef-Nordic-5-Clause
 */

#include <zephyr/bluetooth/bluetooth.h>

#include <assert.h>
#include <errno.h>
#include <zephyr/bluetooth/mesh.h>
#include <zephyr/bluetooth/mesh/cfg.h>
#include <zephyr/sys/byteorder.h>
#include <app_keys.h>

#define LOG_LEVEL CONFIG_BT_MESH_LOG_LEVEL
#include "zephyr/logging/log.h"
LOG_MODULE_REGISTER(bttester_mesh);
#include "mesh/testing.h"
#include "model_handler.h"
#include "bttester.h"

#define CONTROLLER_INDEX 0

/* Health server data */
extern uint8_t cur_faults[CUR_FAULTS_MAX];
extern uint8_t reg_faults[CUR_FAULTS_MAX * 2];
extern struct bt_mesh_model vnd_models[1];

/* Provision node data */
static uint8_t net_key[16];
static uint16_t net_key_idx;
static uint8_t flags;
static uint32_t iv_index;
static uint16_t addr;
static uint8_t dev_key[16];
static uint8_t input_size;

/* Configured provisioning data */
static uint8_t dev_uuid[16];
static uint8_t static_auth[16];

/* Model send data */
struct model_data model_bound[MODEL_BOUNDS_MAX];

struct net_ctx net = {
	.local = BT_MESH_ADDR_UNASSIGNED,
	.dst = BT_MESH_ADDR_UNASSIGNED,
};

static void supported_commands(uint8_t *data, uint16_t len)
{
	struct net_buf_simple *buf = NET_BUF_SIMPLE(BTP_DATA_MAX_SIZE);

	net_buf_simple_init(buf, 0);

	/* 1st octet */
	net_buf_simple_add_u8(buf, 0);
	tester_set_bit(buf->data, MESH_READ_SUPPORTED_COMMANDS);
	tester_set_bit(buf->data, MESH_CONFIG_PROVISIONING);
	tester_set_bit(buf->data, MESH_INIT);
	tester_set_bit(buf->data, MESH_RESET);
	tester_set_bit(buf->data, MESH_START);

	tester_send(BTP_SERVICE_ID_MESH, MESH_READ_SUPPORTED_COMMANDS,
		    CONTROLLER_INDEX, buf->data, buf->len);
}

static void link_open(bt_mesh_prov_bearer_t bearer)
{
	struct mesh_prov_link_open_ev ev;

	LOG_DBG("bearer 0x%02x", bearer);

	switch (bearer) {
	case BT_MESH_PROV_ADV:
		ev.bearer = MESH_PROV_BEARER_PB_ADV;
		break;
	case BT_MESH_PROV_GATT:
		ev.bearer = MESH_PROV_BEARER_PB_GATT;
		break;
	default:
		LOG_ERR("Invalid bearer");

		return;
	}

	tester_send(BTP_SERVICE_ID_MESH, MESH_EV_PROV_LINK_OPEN,
		    CONTROLLER_INDEX, (uint8_t *) &ev, sizeof(ev));
}

static void link_close(bt_mesh_prov_bearer_t bearer)
{
	struct mesh_prov_link_closed_ev ev;

	LOG_DBG("bearer 0x%02x", bearer);

	switch (bearer) {
	case BT_MESH_PROV_ADV:
		ev.bearer = MESH_PROV_BEARER_PB_ADV;
		break;
	case BT_MESH_PROV_GATT:
		ev.bearer = MESH_PROV_BEARER_PB_GATT;
		break;
	default:
		LOG_ERR("Invalid bearer");

		return;
	}

	tester_send(BTP_SERVICE_ID_MESH, MESH_EV_PROV_LINK_CLOSED,
		    CONTROLLER_INDEX, (uint8_t *) &ev, sizeof(ev));
}

static int output_number(bt_mesh_output_action_t action, uint32_t number)
{
	struct mesh_out_number_action_ev ev;

	LOG_DBG("action 0x%04x number 0x%08x", action, number);

	ev.action = sys_cpu_to_le16(action);
	ev.number = sys_cpu_to_le32(number);

	tester_send(BTP_SERVICE_ID_MESH, MESH_EV_OUT_NUMBER_ACTION,
		    CONTROLLER_INDEX, (uint8_t *) &ev, sizeof(ev));

	return 0;
}

static int output_string(const char *str)
{
	struct mesh_out_string_action_ev *ev;
	struct net_buf_simple *buf = NET_BUF_SIMPLE(BTP_DATA_MAX_SIZE);

	LOG_DBG("str %s", str);

	net_buf_simple_init(buf, 0);

	ev = net_buf_simple_add(buf, sizeof(*ev));
	ev->string_len = strlen(str);

	net_buf_simple_add_mem(buf, str, ev->string_len);

	tester_send(BTP_SERVICE_ID_MESH, MESH_EV_OUT_STRING_ACTION,
		    CONTROLLER_INDEX, buf->data, buf->len);

	return 0;
}

static int input(bt_mesh_input_action_t action, uint8_t size)
{
	struct mesh_in_action_ev ev;

	LOG_DBG("action 0x%04x number 0x%02x", action, size);

	input_size = size;

	ev.action = sys_cpu_to_le16(action);
	ev.size = size;

	tester_send(BTP_SERVICE_ID_MESH, MESH_EV_IN_ACTION, CONTROLLER_INDEX,
		    (uint8_t *) &ev, sizeof(ev));

	return 0;
}

static void prov_complete(uint16_t net_idx, uint16_t addr)
{
	LOG_DBG("net_idx 0x%04x addr 0x%04x", net_idx, addr);

	net.net_idx = net_idx,
	net.local = addr;
	net.dst = addr;

	tester_send(BTP_SERVICE_ID_MESH, MESH_EV_PROVISIONED, CONTROLLER_INDEX,
		    NULL, 0);
}

static void prov_reset(void)
{
	int err;

	LOG_DBG("");

	err = bt_mesh_prov_enable(BT_MESH_PROV_ADV | BT_MESH_PROV_GATT);
	if (err && err != -EALREADY) {
		LOG_ERR("prov enable error %d", err);
	}
}

static const struct bt_mesh_comp *comp;

static struct bt_mesh_prov prov = {
	.uuid = dev_uuid,
	.static_val = static_auth,
	.static_val_len = sizeof(static_auth),
	.output_number = output_number,
	.output_string = output_string,
	.input = input,
	.link_open = link_open,
	.link_close = link_close,
	.complete = prov_complete,
	.reset = prov_reset,
};

static void config_prov(uint8_t *data, uint16_t len)
{
	const struct mesh_config_provisioning_cmd *cmd = (void *) data;

	LOG_DBG("");

	memcpy(dev_uuid, cmd->uuid, sizeof(dev_uuid));
	memcpy(static_auth, cmd->static_auth, sizeof(static_auth));

	prov.output_size = cmd->out_size;
	prov.output_actions = sys_le16_to_cpu(cmd->out_actions);
	prov.input_size = cmd->in_size;
	prov.input_actions = sys_le16_to_cpu(cmd->in_actions);

	tester_rsp(BTP_SERVICE_ID_MESH, MESH_CONFIG_PROVISIONING,
		   CONTROLLER_INDEX, BTP_STATUS_SUCCESS);
}

static void init(uint8_t *data, uint16_t len)
{
	uint8_t status = BTP_STATUS_SUCCESS;
	int err;

	LOG_DBG("");

	comp = model_handler_init();
	err = bt_mesh_init(&prov, comp);
	if (err) {
		status = BTP_STATUS_FAILED;
	}

	tester_rsp(BTP_SERVICE_ID_MESH, MESH_INIT, CONTROLLER_INDEX,
		   status);
}

static void start(uint8_t *data, uint16_t len)
{
	uint8_t status = BTP_STATUS_SUCCESS;
	int err;

	LOG_DBG("");

	if (IS_ENABLED(CONFIG_BT_SETTINGS)) {
		printk("Loading stored settings\n");
		settings_load();
	}

	if (addr) {
		err = bt_mesh_provision(net_key, net_key_idx, flags, iv_index,
					addr, dev_key);
		if (err && err != -EALREADY) {
			status = BTP_STATUS_FAILED;
		}
	} else {
		err = bt_mesh_prov_enable(BT_MESH_PROV_ADV | BT_MESH_PROV_GATT);
		if (err && err != -EALREADY) {
			status = BTP_STATUS_FAILED;
		}
	}

	tester_rsp(BTP_SERVICE_ID_MESH, MESH_START, CONTROLLER_INDEX,
		   status);
}

static void reset(uint8_t *data, uint16_t len)
{
	LOG_DBG("");

	bt_mesh_reset();

	tester_rsp(BTP_SERVICE_ID_MESH, MESH_RESET, CONTROLLER_INDEX,
		   BTP_STATUS_SUCCESS);
}

void tester_handle_mesh(uint8_t opcode, uint8_t index, uint8_t *data, uint16_t len)
{
	switch (opcode) {
	case MESH_READ_SUPPORTED_COMMANDS:
		supported_commands(data, len);
		break;
	case MESH_CONFIG_PROVISIONING:
		config_prov(data, len);
		break;
	case MESH_INIT:
		init(data, len);
		break;
	case MESH_START:
		start(data, len);
		break;
	case MESH_RESET:
		reset(data, len);
		break;
	default:
		tester_rsp(BTP_SERVICE_ID_MESH, opcode, index,
			   BTP_STATUS_UNKNOWN_CMD);
		break;
	}
}

void net_recv_ev(uint8_t ttl, uint8_t ctl, uint16_t src, uint16_t dst, const void *payload,
		 size_t payload_len)
{
	NET_BUF_SIMPLE_DEFINE(buf, UINT8_MAX);
	struct mesh_net_recv_ev *ev;

	LOG_DBG("ttl 0x%02x ctl 0x%02x src 0x%04x dst 0x%04x payload_len %zu",
		ttl, ctl, src, dst, payload_len);

	if (payload_len > net_buf_simple_tailroom(&buf)) {
		LOG_ERR("Payload size exceeds buffer size");
		return;
	}

	ev = net_buf_simple_add(&buf, sizeof(*ev));
	ev->ttl = ttl;
	ev->ctl = ctl;
	ev->src = sys_cpu_to_le16(src);
	ev->dst = sys_cpu_to_le16(dst);
	ev->payload_len = payload_len;
	net_buf_simple_add_mem(&buf, payload, payload_len);

	tester_send(BTP_SERVICE_ID_MESH, MESH_EV_NET_RECV, CONTROLLER_INDEX,
		    buf.data, buf.len);
}

static void model_bound_cb(uint16_t addr, const struct bt_mesh_model *model,
			   uint16_t key_idx)
{
	int i;

	LOG_DBG("remote addr 0x%04x key_idx 0x%04x model %p",
		addr, key_idx, (void *)model);

	for (i = 0; i < ARRAY_SIZE(model_bound); i++) {
		if (!model_bound[i].model) {
			model_bound[i].model = model;
			model_bound[i].addr = addr;
			model_bound[i].appkey_idx = key_idx;

			return;
		}
	}

	LOG_ERR("model_bound is full");
}

static void model_unbound_cb(uint16_t addr, const struct bt_mesh_model *model,
			     uint16_t key_idx)
{
	int i;

	LOG_DBG("remote addr 0x%04x key_idx 0x%04x model %p",
		addr, key_idx, (void *)model);

	for (i = 0; i < ARRAY_SIZE(model_bound); i++) {
		if (model_bound[i].model == model) {
			model_bound[i].model = NULL;
			model_bound[i].addr = 0x0000;
			model_bound[i].appkey_idx = BT_MESH_KEY_UNUSED;

			return;
		}
	}

	LOG_INF("model not found");
}

static void invalid_bearer_cb(uint8_t opcode)
{
	struct mesh_invalid_bearer_ev ev = {
		.opcode = opcode,
	};

	LOG_DBG("opcode 0x%02x", opcode);

	tester_send(BTP_SERVICE_ID_MESH, MESH_EV_INVALID_BEARER,
		    CONTROLLER_INDEX, (uint8_t *) &ev, sizeof(ev));
}

static void incomp_timer_exp_cb(void)
{
	tester_send(BTP_SERVICE_ID_MESH, MESH_EV_INCOMP_TIMER_EXP,
		    CONTROLLER_INDEX, NULL, 0);
}

static struct bt_mesh_test_cb mesh_test_cb = {
	.net_recv = net_recv_ev,
	.model_bound = model_bound_cb,
	.model_unbound = model_unbound_cb,
	.prov_invalid_bearer = invalid_bearer_cb,
	.trans_incomp_timer_exp = incomp_timer_exp_cb,
};

uint8_t tester_init_mesh(void)
{
	if (IS_ENABLED(CONFIG_BT_TESTING)) {
		bt_mesh_test_cb_register(&mesh_test_cb);
	}

	return BTP_STATUS_SUCCESS;
}

uint8_t tester_unregister_mesh(void)
{
	return BTP_STATUS_SUCCESS;
}
```

## src/model_handler.h
```c
/* model_handler.h - Bluetooth Mesh Models handler header */

/*
 * Copyright (c) 2021 Nordic Semiconductor ASA
 *
 * SPDX-License-Identifier: LicenseRef-Nordic-5-Clause
 */

#ifndef MODEL_HANDLER_H__
#define MODEL_HANDLER_H__

#include <zephyr/bluetooth/mesh.h>

#ifdef __cplusplus
extern "C" {
#endif

#define CUR_FAULTS_MAX 4
#define HEALTH_TEST_ID 0x00

const struct bt_mesh_comp *model_handler_init(void);

extern struct bt_mesh_onoff_cli onoff_cli;
extern struct bt_mesh_lvl_cli lvl_cli;
extern struct bt_mesh_dtt_cli dtt_cli;
extern struct bt_mesh_ponoff_cli ponoff_cli;
extern struct bt_mesh_plvl_cli plvl_cli;
extern struct bt_mesh_battery_cli battery_cli;
extern struct bt_mesh_loc_cli loc_cli;
extern struct bt_mesh_prop_cli prop_cli;
extern struct bt_mesh_sensor_cli sensor_cli;
extern struct bt_mesh_time_cli time_cli;
extern struct bt_mesh_lightness_cli lightness_cli;
extern struct bt_mesh_light_ctrl_cli light_ctrl_cli;
extern struct bt_mesh_light_ctl_cli light_ctl_cli;
extern struct bt_mesh_scene_cli scene_cli;
extern struct bt_mesh_light_xyl_cli xyl_cli;
extern struct bt_mesh_light_hsl_cli light_hsl_cli;
extern struct bt_mesh_scheduler_cli scheduler_cli;

struct model_data {
	const struct bt_mesh_model *model;
	uint16_t addr;
	uint16_t appkey_idx;
};

/* Model send data */
#define MODEL_BOUNDS_MAX 100

extern struct model_data model_bound[MODEL_BOUNDS_MAX];

struct net_ctx {
	uint16_t local;
	uint16_t dst;
	uint16_t net_idx;
};

extern struct net_ctx net;
void sensor_data_set(uint8_t *data, uint16_t len);

#ifdef __cplusplus
}
#endif

#endif /* MODEL_HANDLER_H__ */
```
