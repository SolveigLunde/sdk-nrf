## CMakeLists.txt
```
#
# Copyright (c) 2020 Nordic Semiconductor
#
# SPDX-License-Identifier: LicenseRef-Nordic-5-Clause
#

cmake_minimum_required(VERSION 3.20.0)

find_package(Zephyr REQUIRED HINTS $ENV{ZEPHYR_BASE})

# This check is needed since CMake does not fail when performing
# 'set_source_files_properties' to a source file which does not exist.
set(pcd_dir ${ZEPHYR_NRF_MODULE_DIR}/subsys/pcd)
set(pcd_source ${pcd_dir}/src/pcd.c)
if (NOT EXISTS ${pcd_source})
  message(FATAL_ERROR "Unable to find source being tested")
endif()

# Set 'CONFIG_MCUBOOT' in order to include code which is conditionally included.
set_source_files_properties(
  ${pcd_source}
  DIRECTORY ${pcd_dir}
  PROPERTIES COMPILE_DEFINITIONS
  "CONFIG_MCUBOOT")

project(pcd_test)

FILE(GLOB app_sources src/*.c)

target_sources(app PRIVATE ${app_sources})
```

## Kconfig.sysbuild
```
#
# Copyright (c) 2023 Nordic Semiconductor ASA
#
# SPDX-License-Identifier: LicenseRef-Nordic-5-Clause
#

source "share/sysbuild/Kconfig"

config REMOTE_BOARD
	string "The board used for remote target"
	default "nrf5340dk/nrf5340/cpunet" if BOARD_NRF5340DK
```

## sysbuild.conf
```
#
# Copyright (c) 2024 Nordic Semiconductor
#
# SPDX-License-Identifier: LicenseRef-Nordic-5-Clause
#

SB_CONFIG_SECURE_BOOT_NETCORE=y
```

## prj.conf
```kconfig
#
# Copyright (c) 2020-2023 Nordic Semiconductor ASA
#
# SPDX-License-Identifier: LicenseRef-Nordic-5-Clause
#
CONFIG_ZTEST=y
CONFIG_FLASH=y
CONFIG_DEBUG_OPTIMIZATIONS=y
CONFIG_PCD_APP=y
CONFIG_SOC_NRF53_CPUNET_ENABLE=y
CONFIG_ZTEST_STACK_SIZE=2048
CONFIG_PARTITION_MANAGER_ENABLED=y
CONFIG_FW_INFO=y
CONFIG_FW_INFO_API=y
CONFIG_PCD_READ_NETCORE_APP_VERSION=y
```

## src/main.c
```c
/*
 * Copyright (c) 2020 Nordic Semiconductor ASA
 *
 * SPDX-License-Identifier: LicenseRef-Nordic-5-Clause
 */

#include <zephyr/ztest.h>
#include <string.h>
#include <stdbool.h>
#include <zephyr/types.h>
#include <zephyr/devicetree.h>
#include <zephyr/drivers/flash.h>
#include <dfu/pcd.h>

#define BUF_LEN ((32*1024) + 10) /* Some pages, and then some */

/* Only 'a' */
static const uint8_t data[BUF_LEN] = {[0 ... BUF_LEN - 1] = 'a'};

ZTEST(pcd_test, test_pcd_network_core_update)
{
	enum pcd_status status;
	int err;

	/* Since image does not have fw_info the update will fail */
	err = pcd_network_core_update(&data, sizeof(data));
	zassert_not_equal(err, 0, "Unexpected success");

	status = pcd_fw_copy_status_get();
	zassert_equal(status, PCD_STATUS_FAILED, "Unexpected success");

	err = pcd_network_core_app_version((uint8_t *)&data, sizeof(data));
	zassert_not_equal(err, 0, "Unexpected success");

	status = pcd_fw_copy_status_get();
	zassert_equal(status, PCD_STATUS_FAILED, "Unexpected success");
}

ZTEST_SUITE(pcd_test, NULL, NULL, NULL, NULL, NULL);
```
