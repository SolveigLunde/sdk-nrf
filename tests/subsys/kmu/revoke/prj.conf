## CMakeLists.txt
```
#
# Copyright (c) 2025 Nordic Semiconductor ASA
#
# SPDX-License-Identifier: LicenseRef-Nordic-5-Clause
#

cmake_minimum_required(VERSION 3.20.0)

find_package(Zephyr REQUIRED HINTS $ENV{ZEPHYR_BASE})
project(revoke)

target_sources(app PRIVATE src/main.c)
```

## sysbuild.conf
```
#
# Copyright (c) 2025 Nordic Semiconductor
#
# SPDX-License-Identifier: LicenseRef-Nordic-5-Clause
#
SB_CONFIG_BOOTLOADER_MCUBOOT=y
SB_CONFIG_BOOT_SIGNATURE_TYPE_ED25519=y
SB_CONFIG_MCUBOOT_SIGNATURE_USING_KMU=y
```

## prj.conf
```kconfig
#
# Copyright (c) 2025 Nordic Semiconductor
#
# SPDX-License-Identifier: LicenseRef-Nordic-5-Clause
#
CONFIG_MBEDTLS=n
CONFIG_MBEDTLS_ENABLE_HEAP=y
CONFIG_MBEDTLS_HEAP_SIZE=2048
CONFIG_PSA_WANT_ALG_PURE_EDDSA=y
CONFIG_PSA_WANT_KEY_TYPE_ECC_KEY_PAIR_IMPORT=y
```

## boards/nrf54lm20pdk_nrf54lm20a_cpuapp.conf
```kconfig
# Copyright (c) 2025 Nordic Semiconductor ASA
#
# SPDX-License-Identifier: LicenseRef-Nordic-5-Clause

CONFIG_NRF_SECURITY=y
```

## src/main.c
```c
/*
 * Copyright (c) 2025 Nordic Semiconductor ASA.
 *
 * SPDX-License-Identifier: LicenseRef-Nordic-5-Clause
 */

#include <stdio.h>
#include <psa/crypto.h>
#include <psa/crypto_types.h>
#include <cracen_psa_kmu.h>
#include <zephyr/kernel.h>

#define MAKE_PSA_KMU_KEY_ID(id)						\
PSA_KEY_HANDLE_FROM_CRACEN_KMU_SLOT(CRACEN_KMU_KEY_USAGE_SCHEME_RAW, id)

static psa_key_id_t kmu_key_ids[] =  {
	MAKE_PSA_KMU_KEY_ID(226),
	MAKE_PSA_KMU_KEY_ID(228),
	MAKE_PSA_KMU_KEY_ID(230)
};

int main(void)
{
	psa_status_t status = PSA_ERROR_BAD_STATE;

	status = psa_crypto_init();
	if (status == PSA_SUCCESS) {
		for (int i = 0; i < ARRAY_SIZE(kmu_key_ids); i++) {
			status = psa_destroy_key(kmu_key_ids[i]);
			if (status == PSA_SUCCESS) {
				printk("Destroy ok\n");
			} else {
				printk("Destroy failed: %d\n", status);
			}
		}
	} else {
		printk("PSA crypto init failed with error %d\n", status);
	}
	while (1) {
	}
	return 0;
}
```
