## CMakeLists.txt
```
#
# Copyright (c) 2024 Nordic Semiconductor ASA
#
# SPDX-License-Identifier: LicenseRef-Nordic-5-Clause
#
cmake_minimum_required(VERSION 3.20.0)

find_package(Zephyr REQUIRED HINTS $ENV{ZEPHYR_BASE})
project(bt_mesh_metadata_extraction_test)

FILE(GLOB app_sources src/*.c)
target_sources(app PRIVATE ${app_sources})

set(script_args ${PROJECT_BINARY_DIR})

if(CONFIG_COMP_DATA_LAYOUT_SINGLE)
  list(PREPEND script_args --single)
else()
  list(PREPEND script_args --multiple)
endif()
```

## Kconfig
```
choice COMP_DATA_LAYOUT
	prompt "Composition data layout"
	default COMP_DATA_LAYOUT_SINGLE

config COMP_DATA_LAYOUT_SINGLE
	bool "Single composition data"

config COMP_DATA_LAYOUT_MULTIPLE
	bool "Multiple composition data as separate variables"

config COMP_DATA_LAYOUT_ARRAY
	bool "Multiple composition data as an array"

endchoice

source "Kconfig.zephyr"
```

## Kconfig.sysbuild
```
#
# Copyright (c) 2024 Nordic Semiconductor
#
# SPDX-License-Identifier: LicenseRef-Nordic-5-Clause
#

choice COMP_DATA_LAYOUT
	prompt "Composition data layout"
	default COMP_DATA_LAYOUT_SINGLE

config COMP_DATA_LAYOUT_SINGLE
	bool "Single composition data"

config COMP_DATA_LAYOUT_MULTIPLE
	bool "Multiple composition data as separate variables"

config COMP_DATA_LAYOUT_ARRAY
	bool "Multiple composition data as an array"

endchoice

source "share/sysbuild/Kconfig"
```

## sysbuild.conf
```
#
# Copyright (c) 2024 Nordic Semiconductor
#
# SPDX-License-Identifier: LicenseRef-Nordic-5-Clause
#

SB_CONFIG_BOOTLOADER_MCUBOOT=y
SB_CONFIG_DFU_ZIP=y
SB_CONFIG_DFU_ZIP_BLUETOOTH_MESH_METADATA=y
```

## prj.conf
```kconfig
#
# Copyright (c) 2024 Nordic Semiconductor ASA
#
# SPDX-License-Identifier: LicenseRef-Nordic-5-Clause
#

# Bootloader configuration
CONFIG_BOOTLOADER_MCUBOOT=y
CONFIG_MCUBOOT_IMGTOOL_SIGN_VERSION="1.2.3+4"

# Bluetooth configuration
CONFIG_BT=y
CONFIG_BT_OBSERVER=y
CONFIG_BT_PERIPHERAL=y

# Bluetooth Mesh configuration
CONFIG_BT_MESH=y

# Set to something other than default to check that it is parsed correctly
CONFIG_BT_MESH_CRPL=64

# Enable extra mesh features to check that the features field is parsed correctly
CONFIG_BT_MESH_RELAY=y
CONFIG_BT_MESH_FRIEND=y

# Bluetooth Mesh models
CONFIG_BT_MESH_LVL_CLI=y
CONFIG_BT_MESH_ONOFF_CLI=y
```

## sysbuild_fwid_custom.conf
```kconfig
#
# Copyright (c) 2025 Nordic Semiconductor
#
# SPDX-License-Identifier: LicenseRef-Nordic-5-Clause
#

# This is a separate conf file because setting string SB options in
# testcase.yaml didn't work

SB_CONFIG_BOOTLOADER_MCUBOOT=y
SB_CONFIG_DFU_ZIP=y
SB_CONFIG_DFU_ZIP_BLUETOOTH_MESH_METADATA=y
SB_CONFIG_DFU_ZIP_BLUETOOTH_MESH_METADATA_FWID_CUSTOM=y
SB_CONFIG_DFU_ZIP_BLUETOOTH_MESH_METADATA_FWID_CUSTOM_HEX="59001234abcd"
```

## src/main.c
```c
/*
 * Copyright (c) 2024 Nordic Semiconductor ASA
 *
 * SPDX-License-Identifier: LicenseRef-Nordic-5-Clause
 */

/** @file
 *  @brief Bluetooth Mesh DFU Target role sample
 */
#include <zephyr/kernel.h>
#include <zephyr/bluetooth/bluetooth.h>
#include <zephyr/bluetooth/mesh.h>
#include <bluetooth/mesh/models.h>

#define TEST_VND_COMPANY_ID 0x1234
#define TEST_VND_MOD_ID   0x5678

static struct bt_mesh_health_srv health_srv;

BT_MESH_HEALTH_PUB_DEFINE(health_pub, 0);

static const struct bt_mesh_model models[] = {
	BT_MESH_MODEL_CFG_SRV,
	BT_MESH_MODEL_HEALTH_SRV(&health_srv, &health_pub),
};

static const struct bt_mesh_model vnd_models[] = {
	BT_MESH_MODEL_VND_CB(TEST_VND_COMPANY_ID, TEST_VND_MOD_ID, BT_MESH_MODEL_NO_OPS, NULL, NULL,
			     NULL),
};

static const struct bt_mesh_elem elements[] = {
	BT_MESH_ELEM(1, models, vnd_models),
};

#ifndef CONFIG_COMP_DATA_LAYOUT_SINGLE
static struct bt_mesh_onoff_cli onoff_cli;
static struct bt_mesh_lvl_cli lvl_cli;

static const struct bt_mesh_model extra_models[] = {
	BT_MESH_MODEL_ONOFF_CLI(&onoff_cli),
	BT_MESH_MODEL_LVL_CLI(&lvl_cli),
};

static const struct bt_mesh_elem elements_alt[] = {
	BT_MESH_ELEM(1, models, vnd_models),
	BT_MESH_ELEM(2, extra_models, BT_MESH_MODEL_NONE),
};
#endif

#ifdef CONFIG_COMP_DATA_LAYOUT_ARRAY
const struct bt_mesh_comp comp[2] = {
	{
		.cid = 1,
		.pid = 2,
		.vid = 3,
		.elem = elements,
		.elem_count = ARRAY_SIZE(elements),
	},
	{
		.cid = 4,
		.pid = 5,
		.vid = 6,
		.elem = elements_alt,
		.elem_count = ARRAY_SIZE(elements_alt),
	},
};
#else /* defined(COMP_DATA_LAYOUT_SINGLE) || defined(COMP_DATA_LAYOUT_MULTIPLE) */
static const struct bt_mesh_comp comp = {
	.cid = 1,
	.pid = 2,
	.vid = 3,
	.elem = elements,
	.elem_count = ARRAY_SIZE(elements),
};
#ifdef CONFIG_COMP_DATA_LAYOUT_MULTIPLE
static const struct bt_mesh_comp comp_alt = {
	.cid = 4,
	.pid = 5,
	.vid = 6,
	.elem = elements_alt,
	.elem_count = ARRAY_SIZE(elements_alt),
};
#endif /* CONFIG_COMP_DATA_LAYOUT_MULTIPLE */
#endif /* defined(COMP_DATA_LAYOUT_SINGLE) || defined(COMP_DATA_LAYOUT_MULTIPLE) */

static const uint8_t dev_uuid[16];

static const struct bt_mesh_prov prov = {
	.uuid = dev_uuid,
};

#ifndef CONFIG_COMP_DATA_LAYOUT_SINGLE
/* Since the value of this variable is never changed by the code, the compiler
 * might optimize it out, including any conditions that depend on it (and by
 * by extension, the entire alternate composition data structure). To prevent
 * this, the `volatile` qualifier is used.
 */
volatile bool use_alt;
#endif

static void bt_ready(int err)
{
	if (err) {
		return;
	}

#ifdef CONFIG_COMP_DATA_LAYOUT_ARRAY
	if (use_alt) {
		bt_mesh_init(&prov, &comp[1]);
	} else {
		bt_mesh_init(&prov, &comp[0]);
	}
#else /* defined(COMP_DATA_LAYOUT_SINGLE) || defined(COMP_DATA_LAYOUT_MULTIPLE) */
#ifdef CONFIG_COMP_DATA_LAYOUT_MULTIPLE
	if (use_alt) {
		bt_mesh_init(&prov, &comp_alt);
	} else
#endif /* CONFIG_COMP_DATA_LAYOUT_MULTIPLE */
	{
		err = bt_mesh_init(&prov, &comp);
		__ASSERT_NO_MSG(err == 0);
	}
#endif /* defined(COMP_DATA_LAYOUT_SINGLE) || defined(COMP_DATA_LAYOUT_MULTIPLE) */
}

int main(void)
{
	int err;

	err = bt_enable(bt_ready);
	__ASSERT_NO_MSG(err == 0);

	return 0;
}
```
