## CMakeLists.txt
```
#
# Copyright (c) 2024 Nordic Semiconductor ASA
#
# SPDX-License-Identifier: LicenseRef-Nordic-5-Clause
#

cmake_minimum_required(VERSION 3.20.0)

include(../cmake/test_template.cmake)

project(plat_retrieve_manifest_app)

target_sources(testbinary PRIVATE
  src/main.c
  ${SUIT_SUBSYS_DIR}/platform/app/src/suit_plat_retrieve_manifest_app_specific.c
)
```

## prj.conf
```kconfig
#
# Copyright (c) 2024 Nordic Semiconductor ASA
#
# SPDX-License-Identifier: LicenseRef-Nordic-5-Clause
#

CONFIG_MOCK_SUIT_PROCESSOR=y
CONFIG_MOCK_SUIT_PLATFORM_INTERNAL=y
```

## src/main.c
```c
/*
 * Copyright (c) 2024 Nordic Semiconductor ASA
 *
 * SPDX-License-Identifier: LicenseRef-Nordic-5-Clause
 */

#include <zephyr/ztest.h>
#include <suit_platform.h>
#include <suit_plat_retrieve_manifest_domain_specific.h>

ZTEST_SUITE(suit_platform_retrieve_manifest_tests, NULL, NULL, NULL, NULL, NULL);

ZTEST(suit_platform_retrieve_manifest_tests, test_retrieve_manifest_app_specific)
{
	struct zcbor_string dummy_component_id = {0};
	const uint8_t **envelope = NULL;
	size_t *envelope_len = NULL;

	/* Simply return SUIT_ERR_UNSUPPORTED_COMPONENT_ID unconditionally */
	zassert_equal(suit_plat_retrieve_manifest_domain_specific(&dummy_component_id,
								  SUIT_COMPONENT_TYPE_INSTLD_MFST,
								  envelope, envelope_len),
		      SUIT_ERR_UNSUPPORTED_COMPONENT_ID,
		      "suit_plat_retrieve_manifest_domain_specific returned incorrect error code");
}
```
