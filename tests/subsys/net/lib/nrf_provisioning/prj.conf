## CMakeLists.txt
```
#
# Copyright (c) 2023 Nordic Semiconductor ASA
#
# SPDX-License-Identifier: LicenseRef-Nordic-5-Clause
#

cmake_minimum_required(VERSION 3.20.0)
find_package(Zephyr REQUIRED HINTS $ENV{ZEPHYR_BASE})

project(nrf_provisioning_unittest)

set(app_sources)

set(options
  -DCONFIG_NRF_MODEM_LIB_MEM_DIAG=y
  -DCONFIG_NRF_PROVISIONING_JWT_MAX_VALID_TIME_S=300
  -DCONFIG_MODEM_JWT_MAX_LEN=850
)

cmock_handle(${ZEPHYR_NRF_MODULE_DIR}/include/date_time.h)
cmock_handle(${ZEPHYR_NRF_MODULE_DIR}/include/modem/lte_lc.h
	FUNC_EXCLUDE ".*(lte_lc_rai_req|lte_lc_rai_param_set)"
	WORD_EXCLUDE "__deprecated")
cmock_handle(${ZEPHYR_NRF_MODULE_DIR}/include/modem/modem_key_mgmt.h)
cmock_handle(${ZEPHYR_NRF_MODULE_DIR}/include/modem/modem_attest_token.h)
cmock_handle(${ZEPHYR_NRF_MODULE_DIR}/include/modem/modem_info.h
	WORD_EXCLUDE "__deprecated")
cmock_handle(${ZEPHYR_NRF_MODULE_DIR}/include/modem/nrf_modem_lib.h)
cmock_handle(${ZEPHYR_BASE}/include/zephyr/settings/settings.h)
cmock_handle(${ZEPHYR_NRF_MODULE_DIR}/subsys/net/lib/nrf_provisioning/include/nrf_provisioning_at.h)
cmock_handle(${ZEPHYR_NRF_MODULE_DIR}/include/net/rest_client.h)
cmock_handle(include/nrf_modem_at.h)

if(CONFIG_SETTINGS_CUSTOM)
  test_runner_generate(src/http_jwt.c)
  list(APPEND app_sources src/http_jwt.c)
  cmock_handle(${ZEPHYR_NRF_MODULE_DIR}/include/modem/modem_jwt.h)

elseif(CONFIG_NRF_PROVISIONING_COAP)
  test_runner_generate(src/coap.c)
  list(APPEND app_sources src/coap.c)
  list (APPEND options
    -DCONFIG_COAP_CLIENT_MESSAGE_HEADER_SIZE=48
    -DCONFIG_COAP_CLIENT_MESSAGE_SIZE=512
    -DCONFIG_COAP_CLIENT_STACK_SIZE=1024
    -DCONFIG_MODEM_INFO_BUFFER_SIZE=128
    -DCONFIG_COAP_CLIENT_MAX_REQUESTS=2
    -DCONFIG_COAP_CLIENT_BLOCK_SIZE=256
  )
  cmock_handle(${ZEPHYR_BASE}/include/zephyr/net/coap_client.h)
  cmock_handle(${ZEPHYR_NRF_MODULE_DIR}/subsys/net/lib/nrf_provisioning/include/nrf_provisioning_jwt.h)

elseif(CONFIG_NRF_PROVISIONING_HTTP)
  test_runner_generate(src/main.c)
  list(APPEND app_sources src/main.c)
  cmock_handle(${ZEPHYR_NRF_MODULE_DIR}/subsys/net/lib/nrf_provisioning/include/nrf_provisioning_jwt.h)

endif()

target_sources(app PRIVATE ${app_sources})

target_compile_options(app
  PRIVATE
  ${options}
)

target_compile_options(..__nrf__subsys__net__lib__nrf_provisioning
  PRIVATE
  ${options}
)

set(includes
  "include/" # Must be included first to redefine functions as non-static-inline
  "${ZEPHYR_NRF_MODULE_DIR}/include/"
  "${ZEPHYR_NRF_MODULE_DIR}/subsys/net/lib/nrf_provisioning/include/"
  "${NRFXLIB_DIR}/nrf_modem/include/"
  "${ZEPHYR_BASE}/include/"
  "src/"
)

target_include_directories(app
  PRIVATE
  ${includes}
)

target_include_directories(..__nrf__subsys__net__lib__nrf_provisioning
  PRIVATE
  ${includes}
)

target_link_libraries(..__nrf__subsys__net__lib__nrf_provisioning
  PRIVATE
  "-Wl,--wrap=k_malloc,--wrap=k_free"
)
```

## Kconfig
```
#
# Copyright (c) 2025 Nordic Semiconductor ASA
#
# SPDX-License-Identifier: LicenseRef-Nordic-5-Clause
#

menuconfig NRF_PROVISIONING
	bool "nRF Provisioning"
	select EXPERIMENTAL
	#depends on NRF_MODEM_LIB
	depends on SETTINGS
	imply FCB
	help
	  Redefinition to disable modemlib requirement from the tests as we want to mock it.

menuconfig NRF_PROVISIONING_CODEC
	bool "nRF Provisioning codec"
	select EXPERIMENTAL
	#depends on NRF_MODEM_LIB
	help
	  Redefinition to disable modemlib requirement from the tests as we want to mock it.

menu "Zephyr Kernel"
source "Kconfig.zephyr"
endmenu
```

## prj.conf
```kconfig
#
# Copyright (c) 2023 Nordic Semiconductor ASA
#
# SPDX-License-Identifier: LicenseRef-Nordic-5-Clause
#

CONFIG_UNITY=y
CONFIG_ASSERT=n

CONFIG_ASAN=y

CONFIG_DEBUG=y
CONFIG_NO_OPTIMIZATIONS=y

CONFIG_FCB=n
CONFIG_REST_CLIENT=n
CONFIG_MODEM_JWT=n

CONFIG_NRF_PROVISIONING=y
CONFIG_NRF_PROVISIONING_HTTP=y
CONFIG_NRF_PROVISIONING_ROOT_CA_SEC_TAG=-1
CONFIG_NRF_PROVISIONING_CODEC=y
CONFIG_NRF_PROVISIONING_CBOR=y
CONFIG_NRF_PROVISIONING_SPREAD_S=2

CONFIG_ZCBOR=y
CONFIG_ZCBOR_CANONICAL=y

CONFIG_SETTINGS=y
CONFIG_SETTINGS_NONE=y
```

## prj_coap.conf
```kconfig
#
# Copyright (c) 2023 Nordic Semiconductor ASA
#
# SPDX-License-Identifier: LicenseRef-Nordic-5-Clause
#

CONFIG_UNITY=y
CONFIG_ASSERT=n

CONFIG_ASAN=y

CONFIG_DEBUG=y
CONFIG_NO_OPTIMIZATIONS=y

CONFIG_FCB=n
CONFIG_REST_CLIENT=n
CONFIG_MODEM_JWT=n

CONFIG_NRF_PROVISIONING=y
CONFIG_NRF_PROVISIONING_COAP=y
CONFIG_NRF_PROVISIONING_ROOT_CA_SEC_TAG=-1
CONFIG_NRF_PROVISIONING_CODEC=y
CONFIG_NRF_PROVISIONING_CBOR=y
CONFIG_NRF_PROVISIONING_SPREAD_S=2
CONFIG_NRF_PROVISIONING_SAVE_CMD_ID=y

CONFIG_ZCBOR=y
CONFIG_ZCBOR_CANONICAL=y

CONFIG_SETTINGS=y
CONFIG_SETTINGS_NONE=y
```

## prj_jwt.conf
```kconfig
#
# Copyright (c) 2023 Nordic Semiconductor ASA
#
# SPDX-License-Identifier: LicenseRef-Nordic-5-Clause
#

CONFIG_UNITY=y
CONFIG_ASSERT=n

CONFIG_ASAN=y

CONFIG_DEBUG=y
CONFIG_NO_OPTIMIZATIONS=y

CONFIG_FCB=n
CONFIG_REST_CLIENT=n
CONFIG_MODEM_JWT=n

CONFIG_NRF_PROVISIONING=y
CONFIG_NRF_PROVISIONING_HTTP=y
CONFIG_NRF_PROVISIONING_COAP=n
CONFIG_NRF_PROVISIONING_ROOT_CA_SEC_TAG=-1
CONFIG_NRF_PROVISIONING_CODEC=y
CONFIG_NRF_PROVISIONING_CBOR=y

CONFIG_SETTINGS=y
CONFIG_SETTINGS_CUSTOM=y

CONFIG_ZCBOR=y
CONFIG_ZCBOR_CANONICAL=y
```

## include/nrf_modem_at.h
```c
/*
 * Copyright (c) 2021 Nordic Semiconductor ASA
 *
 * SPDX-License-Identifier: LicenseRef-Nordic-5-Clause
 */

/**
 * @file nrf_modem_at.h
 *
 * @defgroup nrf_modem_at AT commands interface
 * @{
 * @brief Modem library AT commands interface.
 */
#ifndef NRF_MODEM_AT_H__
#define NRF_MODEM_AT_H__

#include <stddef.h>
#include <stdbool.h>

#ifdef __cplusplus
extern "C" {
#endif

/** @brief Modem response type for 'ERROR' responses. */
#define NRF_MODEM_AT_ERROR 1
/** @brief Modem response type for '+CME ERROR' responses. */
#define NRF_MODEM_AT_CME_ERROR 2
/** @brief Modem response type for '+CMS ERROR' responses. */
#define NRF_MODEM_AT_CMS_ERROR 3

/**
 * @brief AT Notification handler prototype.
 *
 * @note This handler is executed in an interrupt service routine.
 * Offload any intensive operation as necessary.
 *
 * @param notif The AT notification.
 */
typedef void (*nrf_modem_at_notif_handler_t)(const char *notif);

/**
 * @brief Set a handler function for AT notifications.
 *
 * @note The callback is executed in an interrupt service routine.
 *	 Take care to offload any processing as appropriate.
 *
 * @param callback The AT notification callback. Use @c NULL to unset handler.
 *
 * @retval 0 On success.
 */
int nrf_modem_at_notif_handler_set(nrf_modem_at_notif_handler_t callback);

/**
 * @brief Send a formatted AT command to the modem.
 *
 * Supports all format specifiers of printf() as implemented by the selected C library.
 * This function can return a negative value, zero or a positive value.
 *
 * @param fmt Command format.
 * @param ... Format arguments.
 *
 * @retval  0 On "OK" responses.
 * @returns A positive value On "ERROR", "+CME ERROR", and "+CMS ERROR" responses.
 *	    The type of error can be distinguished using @c nrf_modem_at_err_type.
 *	    The error value can be retrieved using @c nrf_modem_at_err.
 * @retval -NRF_EPERM The Modem library is not initialized.
 * @retval -NRF_EFAULT @c fmt is @c NULL.
 * @retval -NRF_EINVAL Bad format @c fmt.
 * @retval -NRF_EAGAIN Timed out while waiting for another AT command to complete.
 * @retval -NRF_ENOMEM Not enough shared memory for this request.
 * @retval -NRF_ESHUTDOWN If modem was shut down.
 */
int nrf_modem_at_printf(const char *fmt, ...);

/**
 * @brief Send an AT command to the modem and read the formatted response
 *	  into the supplied argument list.
 *
 * Supports all the format specifiers of scanf() as implemented by the selected C library.
 * This function does not support retrieving the modem response beyond reading
 * the formatted response into the argument list.
 *
 * @param cmd AT command.
 * @param fmt Response format.
 * @param ... Variable argument list.
 *
 * @returns The number of arguments matched.
 * @retval -NRF_EPERM The Modem library is not initialized.
 * @retval -NRF_EFAULT @c cmd or @c fmt are @c NULL.
 * @retval -NRF_EBADMSG No arguments were matched.
 * @retval -NRF_EAGAIN Timed out while waiting for another AT command to complete.
 * @retval -NRF_ENOMEM Not enough shared memory for this request.
 * @retval -NRF_ESHUTDOWN If the modem was shut down.
 */
int nrf_modem_at_scanf(const char *cmd, const char *fmt, ...);

/**
 * @brief Send a formatted AT command to the modem
 *	  and receive the response into the supplied buffer.
 *
 * @param buf Buffer to receive the response into.
 * @param len Buffer length.
 * @param fmt Command format.
 * @param ... Format arguments.
 *
 * @retval  0 On "OK" responses.
 * @returns A positive value On "ERROR", "+CME ERROR", and "+CMS ERROR" responses.
 *	    The type of error can be distinguished using @c nrf_modem_at_err_type.
 *	    The error value can be retrieved using @c nrf_modem_at_err.
 * @retval -NRF_EPERM The Modem library is not initialized.
 * @retval -NRF_EFAULT @c buf or @c fmt are @c NULL.
 * @retval -NRF_EINVAL Bad format @c fmt, or @c len is zero.
 * @retval -NRF_EAGAIN Timed out while waiting for another AT command to complete.
 * @retval -NRF_ENOMEM Not enough shared memory for this request.
 * @retval -NRF_E2BIG The response is larger than the supplied buffer @c buf.
 * @retval -NRF_ESHUTDOWN If the modem was shut down.
 */
int nrf_modem_at_cmd(void *buf, size_t len, const char *fmt, ...);

/**
 * @brief AT response handler prototype.
 *
 * @note This handler is executed in an interrupt service routine.
 * Offload any intensive operations as necessary.
 *
 * @param resp The AT command response.
 */
typedef void (*nrf_modem_at_resp_handler_t)(const char *resp);

/**
 * @brief Send a formatted AT command to the modem
 *	  and receive the response asynchronously via a callback.
 *
 * This function waits for the Modem to acknowledge the AT command
 * but will return without waiting for the command execution.
 *
 * @note The callback is executed in an interrupt context.
 *	 Take care to offload any processing as appropriate.
 *
 * @param callback Callback to receive the response.
 * @param fmt Command format.
 * @param ... Format arguments.
 *
 * @retval  0 On "OK" responses.
 * @retval -NRF_EPERM The Modem library is not initialized.
 * @retval -NRF_EFAULT @c callback or @c fmt are @c NULL.
 * @retval -NRF_EINVAL Bad format @c fmt.
 * @retval -NRF_EINPROGRESS Another AT command is executing.
 * @retval -NRF_ENOMEM Not enough shared memory for this request.
 * @retval -NRF_ESHUTDOWN If the modem was shut down.
 */
int nrf_modem_at_cmd_async(nrf_modem_at_resp_handler_t callback, const char *fmt, ...);

/** @brief AT command handler prototype.
 *
 * Implements a custom AT command in the application.
 *
 * @param buf Buffer to receive the response into.
 * @param len Buffer length.
 * @param at_cmd AT command.
 *
 * @retval  0 On "OK" responses.
 * @returns A positive value On "ERROR", "+CME ERROR", and "+CMS ERROR" responses.
 *	    The type of error can be distinguished using @c nrf_modem_at_err_type.
 *	    The error value can be retrieved using @c nrf_modem_at_err.
 * @retval -NRF_EPERM The Modem library is not initialized.
 * @retval -NRF_EFAULT @c buf or @c fmt are @c NULL.
 * @retval -NRF_ENOMEM Not enough shared memory for this request.
 * @retval -NRF_E2BIG The response is larger than the supplied buffer @c buf.
 */
typedef int (*nrf_modem_at_cmd_custom_handler_t)(char *buf, size_t len, char *at_cmd);

/**
 * @brief Custom AT command.
 *
 * Application-defined AT command implementation.
 */
struct nrf_modem_at_cmd_custom {
	/** The AT command to implement. */
	const char * const cmd;
	/** The function implementing the AT command. */
	const nrf_modem_at_cmd_custom_handler_t callback;
};

/**
 * @brief Set a list of custom AT commands that are implemented in the application.
 *
 * When a custom AT command list is set, AT commands sent via @c nrf_modem_at_cmd that match any
 * AT command in the list, will be redirected to the custom callback function instead
 * of being sent to the modem.
 *
 * @note The custom commands are disabled by passing NULL to the @c custom_commands and
 * 0 to the @c len.
 *
 * @param custom_commands List of custom AT commands.
 * @param len Custom AT command list size.
 *
 * @retval  0 On success.
 * @retval -NRF_EINVAL On invalid parameters.
 */
int nrf_modem_at_cmd_custom_set(struct nrf_modem_at_cmd_custom *custom_commands, size_t len);

/**
 * @brief Configure how long to wait for ongoing AT commands to complete when sending AT commands.
 *
 * AT commands are executed one at a time. While one AT command is being executed, the other
 * AT commands wait on a semaphore for the ongoing AT command to complete.
 *
 * This function configures how long @c nrf_modem_at_printf, @c nrf_modem_at_scanf and
 * @c nrf_modem_at_cmd shall wait for ongoing AT commands to complete.
 *
 * By default, the timeout is infinite.
 *
 * @param timeout_ms Timeout in milliseconds. Use NRF_MODEM_OS_FOREVER for infinite timeout
 *		     or NRF_MODEM_OS_NO_WAIT for no timeout.
 *
 * @return int Zero on success, a negative errno otherwise.
 */
int nrf_modem_at_sem_timeout_set(int timeout_ms);

/**
 * @brief Return the error type represented by the return value of
 *	  @c nrf_modem_at_printf and @c nrf_modem_at_cmd.
 *
 * @param error The return value of @c nrf_modem_at_printf or @c nrf_modem_at_cmd.
 *
 * @retval NRF_MODEM_AT_ERROR If the modem response was 'ERROR'.
 * @retval NRF_MODEM_AT_CME_ERROR If the modem response was '+CME ERROR'.
 * @retval NRF_MODEM_AT_CMS_ERROR If the modem response was '+CMS ERROR'.
 */
int nrf_modem_at_err_type(int error);

/**
 * @brief Retrieve the specific CME or CMS error from the return value of
 *	  a @c nrf_modem_at_printf or @c nrf_modem_at_cmd call.
 *
 * @param error The return value of a @c nrf_modem_at_printf or @c nrf_modem_at_cmd call.
 *
 * @returns int The CME or CMS error code.
 */
int nrf_modem_at_err(int error);

#ifdef __cplusplus
}
#endif

#endif /* NRF_MODEM_AT_H__ */
/** @} */
```

## src/http_jwt.c
```c
/*
 * Copyright (c) 2023 Nordic Semiconductor ASA
 *
 * SPDX-License-Identifier: LicenseRef-Nordic-5-Clause
 */

#include "unity.h"
#include <zephyr/kernel.h>
#include <stdio.h>
#include <stdlib.h>

#include "nrf_provisioning_http.h"

#include "cmock_rest_client.h"
#include "cmock_modem_info.h"
#include "cmock_nrf_provisioning_at.h"
#include "cmock_modem_jwt.h"

#define AUTH_HDR_BEARER_PREFIX_JWT "Authorization: Bearer "
#define AUTH_HDR_BEARER_JWT_DUMMY "dummy_json_web_token"
#define CRLF "\r\n"

static char ok_jwt_fake[] = AUTH_HDR_BEARER_JWT_DUMMY;
static char ok_jwt_http_hdr_fake[] = AUTH_HDR_BEARER_PREFIX_JWT AUTH_HDR_BEARER_JWT_DUMMY CRLF;

void *__wrap_k_malloc(size_t size)
{
	return malloc(size);
}

void __wrap_k_free(void *ptr)
{
	free(ptr);
}

int custom_nrf_modem_at_cmd(void *buf, size_t len, const char *fmt, va_list argp)
{
	return 0;
}

static int modem_jwt_generate_fake(struct jwt_data *const jwt, int cmock_num_calls)
{
	memcpy(jwt->jwt_buf, ok_jwt_fake, strlen(ok_jwt_fake) + 1);

	return 0;
}

static int rest_client_request_auth_hdr_valid(struct rest_client_req_context *req_ctx,
				    struct rest_client_resp_context *resp_ctx, int cmock_num_calls)
{
	int cnt = 0;

	(void)cmock_num_calls;

	for (int i = 0; req_ctx->header_fields && req_ctx->header_fields[i]; i++) {
		if (strcmp(ok_jwt_http_hdr_fake, req_ctx->header_fields[i]) == 0) {
			cnt++;
		}
	}

	resp_ctx->http_status_code = NRF_PROVISIONING_HTTP_STATUS_NO_CONTENT;

	TEST_ASSERT_EQUAL_INT(1, cnt);

	return 0;
}

void setUp(void)
{
}

void tearDown(void)
{
}

/*
 * - JWT is generated and placed as one of the HTTP headers
 * - To have a valid token for authentication
 * - Retrieves a dummy token and writes an authentication header based on it
 */
void test_http_commands_auth_hdr_valid(void)
{
	int ret;
	char mfw_version[] = "mfw_nrf9160_99.99.99-DUMMY";

	struct nrf_provisioning_http_context rest_ctx = {
		.connect_socket = REST_CLIENT_SCKT_CONNECT,
	};

	__cmock_rest_client_request_defaults_set_Ignore();
	__cmock_modem_info_get_fw_version_ExpectAnyArgsAndReturn(0);
	__cmock_modem_info_get_fw_version_ReturnArrayThruPtr_buf(mfw_version, sizeof(mfw_version));

	__cmock_modem_jwt_generate_Stub(modem_jwt_generate_fake);

	__cmock_nrf_provisioning_at_time_get_ExpectAnyArgsAndReturn(0);

	__cmock_rest_client_request_Stub(rest_client_request_auth_hdr_valid);

	ret = nrf_provisioning_http_req(&rest_ctx);
}

extern int unity_main(void);

int main(void)
{
	(void)unity_main();

	return 0;
}
```
