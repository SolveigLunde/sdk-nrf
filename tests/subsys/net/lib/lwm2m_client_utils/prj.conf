## CMakeLists.txt
```
#
# Copyright (c) 2022 Nordic Semiconductor ASA
#
# SPDX-License-Identifier: LicenseRef-Nordic-5-Clause
#

cmake_minimum_required(VERSION 3.20.0)
find_package(Zephyr REQUIRED HINTS $ENV{ZEPHYR_BASE})
project(lwm2m_client_unittest)

FILE(GLOB app_sources src/*.c)
target_sources(app
  PRIVATE
    ${app_sources}
    ${ZEPHYR_BASE}/subsys/net/lib/lwm2m/lwm2m_util.c
)
zephyr_linker_sources(SECTIONS src/iterables.ld)

set(options
  -DCONFIG_LWM2M_ENGINE_MAX_PENDING=5
  -DCONFIG_LWM2M_ENGINE_MAX_REPLIES=5
  -DCONFIG_LWM2M_ENGINE_VALIDATION_BUFFER_SIZE=100
  -DCONFIG_LWM2M_DTLS_SUPPORT
  -DCONFIG_LWM2M_COAP_BLOCK_SIZE=512
  -DCONFIG_LWM2M_COAP_MAX_MSG_SIZE=512
  -DCONFIG_LWM2M_ENGINE_MESSAGE_HEADER_SIZE=10
  -DCONFIG_LWM2M_RD_CLIENT_SUPPORT_BOOTSTRAP
  -DCONFIG_LWM2M_CLIENT_UTILS_NEIGHBOUR_CELL_LISTENER
  -DCONFIG_LWM2M_CLIENT_UTILS_CONN_MON_OBJ_SUPPORT
  -DCONFIG_LWM2M_CLIENT_UTILS_SIGNAL_MEAS_INFO_OBJ_SUPPORT
  -DCONFIG_LTE_LC_TAU_PRE_WARNING_NOTIFICATIONS
  -DCONFIG_LTE_PSM_REQ_RPTAU="10101010"
  -DCONFIG_LTE_PSM_REQ_RAT="00001111"
  -DCONFIG_LTE_EDRX_REQ_VALUE_LTE_M="0001"
  -DCONFIG_LTE_PTW_VALUE_LTE_M="0000"
  -DCONFIG_DOWNLOADER_STACK_SIZE=4096
  -DCONFIG_DOWNLOADER_MAX_HOSTNAME_SIZE=128
  -DCONFIG_DOWNLOADER_MAX_FILENAME_SIZE=128
  -DCONFIG_DOWNLOADER_TRANSPORT_PARAMS_SIZE=256
  -DCONFIG_LWM2M_FIRMWARE_UPDATE_OBJ_SUPPORT
  -DCONFIG_LWM2M_FIRMWARE_UPDATE_PULL_SUPPORT
  -DCONFIG_DFU_TARGET_MCUBOOT
  -DCONFIG_FOTA_DOWNLOAD_MCUBOOT_FLASH_BUF_SZ=512
  -DCONFIG_LTE_PTW_VALUE_NBIOT="0000"
  -DCONFIG_LTE_EDRX_REQ_VALUE_NBIOT="0010"
  -DCONFIG_NET_MGMT_EVENT_INFO
  -DCONFIG_NET_MGMT_EVENT
  -DCONFIG_LWM2M_CLIENT_UTILS_RAI
  -DCONFIG_LWM2M_ENGINE_DEFAULT_LIFETIME=43200
  -DCONFIG_LWM2M_CLIENT_UTILS_DTLS_CON_MANAGEMENT
  -DCONFIG_LTE_LC_EDRX_MODULE=1
  -DCONFIG_LTE_LC_NEIGHBOR_CELL_MEAS_MODULE=1
  -DCONFIG_LTE_LC_PSM_MODULE=1
  -DCONFIG_LTE_LC_TAU_PRE_WARNING_MODULE=1
)

target_compile_options(app
  PRIVATE
  ${options}
)
target_compile_options(..__nrf__subsys__net__lib__lwm2m_client_utils
  PRIVATE
  ${options}
)

set(includes
"${ZEPHYR_BASE}/subsys/net/lib/lwm2m/"
"${ZEPHYR_BASE}/../nrfxlib/nrf_modem/include/"
"${ZEPHYR_BASE}/../modules/lib/cjson/"
"${ZEPHYR_BASE}/../nrf/subsys/net/lib/nrf_cloud/include/"
"${ZEPHYR_BASE}/../nrf/subsys/net/lib/fota_download/include/"
"src/"
)

target_include_directories(..__nrf__subsys__net__lib__lwm2m_client_utils
  PRIVATE
  ${includes}
)

target_include_directories(app
  PRIVATE
  ${includes}
)
```

## prj.conf
```kconfig
#
# Copyright (c) 2022-2023 Nordic Semiconductor ASA
#
# SPDX-License-Identifier: LicenseRef-Nordic-5-Clause
#

CONFIG_ZTEST=y
CONFIG_NEWLIB_LIBC=y
CONFIG_HEAP_MEM_POOL_SIZE=16384
CONFIG_LWM2M_CLIENT_UTILS=y
CONFIG_LWM2M_CLIENT_UTILS_FIRMWARE_UPDATE_OBJ_SUPPORT=y
CONFIG_LWM2M_CLIENT_UTILS_CONN_MON_OBJ_SUPPORT=y
CONFIG_LWM2M_CLIENT_UTILS_LOCATION_OBJ_SUPPORT=n
CONFIG_LWM2M_CLIENT_UTILS_CELL_CONN_OBJ_SUPPORT=y
CONFIG_LWM2M_CLIENT_UTILS_SIGNAL_MEAS_INFO_OBJ_SUPPORT=y
CONFIG_LWM2M_CLIENT_UTILS_GROUND_FIX_OBJ_SUPPORT=y
CONFIG_LWM2M_CLIENT_UTILS_GNSS_ASSIST_OBJ_SUPPORT=y
CONFIG_LWM2M_CLIENT_UTILS_LOCATION_ASSIST_CELL=y
CONFIG_LWM2M_CLIENT_UTILS_LOCATION_ASSIST_AGNSS=y
CONFIG_LWM2M_CLIENT_UTILS_LOCATION_ASSIST_PGPS=y
CONFIG_LWM2M_CELL_CONN_OBJ_VERSION_1_1=y
CONFIG_LWM2M_CLIENT_UTILS_BOOTSTRAP_TLS_TAG=100
CONFIG_LWM2M_CLIENT_UTILS_SERVER_TLS_TAG=200
CONFIG_LWM2M_CLIENT_UTILS_SERVER="coaps://server.example.com:5684"
CONFIG_LWM2M_CONN_HOLD_TIME_RSRP=5
CONFIG_LWM2M_CLIENT_UTILS_WIFI_AP_SCANNER=y
CONFIG_LWM2M_CLIENT_UTILS_VISIBLE_WIFI_AP_OBJ_SUPPORT=y
CONFIG_LWM2M_CLIENT_UTILS_LTE_CONNEVAL=y
```

## src/cellconn.c
```c
/*
 * Copyright (c) 2022 Nordic Semiconductor ASA
 *
 * SPDX-License-Identifier: LicenseRef-Nordic-5-Clause
 */

#include <zephyr/ztest.h>
#include <zephyr/fff.h>

#include <net/lwm2m_client_utils.h>
#include <modem/lte_lc.h>
#include "stubs.h"
#include "lwm2m_object.h"
#include "lwm2m_engine.h"

static int copy_uri_write_cb(const struct lwm2m_obj_path *path, lwm2m_engine_set_data_cb_t cb);

static lwm2m_engine_set_data_cb_t set_uri_cb;
static lwm2m_engine_set_data_cb_t set_uri_cb_psm;
static lwm2m_engine_set_data_cb_t set_uri_cb_active_time;
static lwm2m_engine_set_data_cb_t set_uri_cb_edrx;
static lwm2m_engine_set_data_cb_t set_uri_cb_psm_update;
static lwm2m_engine_set_data_cb_t set_uri_cb_rai;

static void setup(void)
{
	/* Register resets */
	DO_FOREACH_FAKE(RESET_FAKE);

	/* reset common FFF internal structures */
	FFF_RESET_HISTORY();

	lwm2m_register_post_write_callback_fake.custom_fake = copy_uri_write_cb;
	call_lwm2m_init_callbacks();
}

static int copy_uri_write_cb(const struct lwm2m_obj_path *path, lwm2m_engine_set_data_cb_t cb)
{
	if (path->obj_id == 10 && path->obj_inst_id == 0 && path->res_id == 1) {
		set_uri_cb = cb;
	} else if (path->obj_id == 10 && path->obj_inst_id == 0 && path->res_id == 4) {
		set_uri_cb_psm = cb;
	} else if (path->obj_id == 10 && path->obj_inst_id == 0 && path->res_id == 5) {
		set_uri_cb_active_time = cb;
	} else if (path->obj_id == 10 && path->obj_inst_id == 0 && path->res_id == 8) {
		set_uri_cb_edrx = cb;
	} else if (path->obj_id == 10 && path->obj_inst_id == 0 && path->res_id == 13) {
		set_uri_cb_psm_update = cb;
	} else if (path->obj_id == 10 && path->obj_inst_id == 0 && path->res_id == 14) {
		set_uri_cb_rai = cb;
	}

	return 0;
}

ZTEST_SUITE(lwm2m_client_utils_cellconn, NULL, NULL, NULL, NULL, NULL);

ZTEST(lwm2m_client_utils_cellconn, test_disable_radio_period_cb)
{
	int rc;
	uint16_t period = 1;

	setup();

	rc = set_uri_cb(10, 0, 1, (uint8_t *)&period, sizeof(period), true, sizeof(period), 0);
	zassert_equal(rc, 0, "Wrong return value");
	k_sleep(K_SECONDS(70)); /* Wait for timer */
}

ZTEST(lwm2m_client_utils_cellconn, test_psm_time_cb)
{
	int rc;
	int32_t time = 1115999;

	setup();

	rc = set_uri_cb_psm(10, 0, 4, (uint8_t *)&time, sizeof(time), true, sizeof(time), 0);
	zassert_equal(rc, 0, "Wrong return value");
}

ZTEST(lwm2m_client_utils_cellconn, test_active_time_cb)
{
	int rc;
	int32_t time = 30;

	setup();

	rc = set_uri_cb_active_time(10, 0, 5, (uint8_t *)&time, sizeof(time),
				    true, sizeof(time), 0);
	zassert_equal(rc, 0, "Wrong return value");
}

ZTEST(lwm2m_client_utils_cellconn, test_edrx_update_cb)
{
	int rc;
	uint8_t data = 0x32;

	setup();

	rc = set_uri_cb_edrx(10, 0, 8, &data, sizeof(data), true, sizeof(data), 0);
	zassert_equal(rc, 0, "Wrong return value");
}

ZTEST(lwm2m_client_utils_cellconn, test_active_psm_update_cb)
{
	int rc;
	uint8_t psm = 3;

	setup();

	rc = set_uri_cb_psm_update(10, 0, 13, &psm, sizeof(psm), true, sizeof(psm), 0);
	zassert_equal(rc, 0, "Wrong return value");
}

ZTEST(lwm2m_client_utils_cellconn, test_rai_update_cb)
{
	int rc;
	uint8_t rai = 2;

	setup();

	rc = set_uri_cb_rai(10, 0, 14, &rai, sizeof(rai), true, sizeof(rai), 0);
	zassert_equal(rc, 0, "Wrong return value");
	rai = 6;
	rc = set_uri_cb_rai(10, 0, 14, &rai, sizeof(rai), true, sizeof(rai), 0);
	zassert_equal(rc, -ENOTSUP, "Wrong return value");
	rai = 7;
	rc = set_uri_cb_rai(10, 0, 14, &rai, sizeof(rai), true, sizeof(rai), 0);
	zassert_equal(rc, -EINVAL, "Wrong return value");
}

ZTEST(lwm2m_client_utils_cellconn, test_psm_update)
{
	struct lte_lc_evt evt = {0};

	setup();

	evt.type = LTE_LC_EVT_PSM_UPDATE;
	evt.psm_cfg.tau = 600;
	evt.psm_cfg.active_time = 30;
	call_lte_handlers(&evt);
	zassert_equal(lwm2m_notify_observer_fake.call_count, 3,
		      "Incorrect number of lwm2m_notify_observer() calls");
}

ZTEST(lwm2m_client_utils_cellconn, test_edrx_update)
{
	struct lte_lc_evt evt = {0};

	setup();

	evt.type = LTE_LC_EVT_LTE_MODE_UPDATE;
	evt.lte_mode = LTE_LC_LTE_MODE_LTEM;
	call_lte_handlers(&evt);

	evt.type = LTE_LC_EVT_EDRX_UPDATE;
	evt.edrx_cfg.edrx = 20;
	evt.edrx_cfg.mode = LTE_LC_LTE_MODE_LTEM;
	call_lte_handlers(&evt);
	evt.edrx_cfg.mode = LTE_LC_LTE_MODE_NBIOT;
	call_lte_handlers(&evt);
	zassert_equal(lwm2m_notify_observer_fake.call_count, 3,
		      "Incorrect number of lwm2m_notify_observer() calls");
}
```

## src/con_management.c
```c
/*
 * Copyright (c) 2024 Nordic Semiconductor ASA
 *
 * SPDX-License-Identifier: LicenseRef-Nordic-5-Clause
 */

#include <zephyr/ztest.h>
#include <zephyr/fff.h>
#include <zephyr/net/socket_ncs.h>

#include <net/lwm2m_client_utils.h>
#include "stubs.h"

#define LIFETIME 120
#define TAU 60

static void setup(void *data)
{
	/* Register resets */
	DO_FOREACH_FAKE(RESET_FAKE);

	/* reset common FFF internal structures */
	FFF_RESET_HISTORY();
}

static int lte_lc_psm_disabled(int *tau, int *active_time)
{
	*tau = TAU;
	*active_time = -1;

	return 0;
}

static int lte_lc_psm_ok(int *tau, int *active_time)
{
	*tau = TAU;
	*active_time = 30;

	return 0;
}

static int get_lifetime(const struct lwm2m_obj_path *path, uint32_t *value)
{
	*value = LIFETIME;

	return 0;
}

static int get_lifetime_and_tau_match(const struct lwm2m_obj_path *path, uint32_t *value)
{
	*value = TAU;

	return 0;
}

static int setsockopt_save(int sock, int level, int optname, const void *optval, socklen_t optlen)
{
	zassert_equal(optname, TLS_DTLS_CONN_SAVE, "Incorrect socket option");

	return 0;
}

static int setsockopt_load(int sock, int level, int optname, const void *optval, socklen_t optlen)
{
	zassert_equal(optname, TLS_DTLS_CONN_LOAD, "Incorrect socket option");

	return 0;
}

ZTEST_SUITE(lwm2m_client_utils_con_management, NULL, NULL, setup, NULL, NULL);

ZTEST(lwm2m_client_utils_con_management, test_dtls_save_load)
{
	struct lwm2m_ctx ctx;
	enum lwm2m_rd_client_event event = LWM2M_RD_CLIENT_EVENT_QUEUE_MODE_RX_OFF;

	z_impl_zsock_setsockopt_fake.custom_fake = setsockopt_save;
	lwm2m_utils_connection_manage(&ctx, &event);

	event = LWM2M_RD_CLIENT_EVENT_REG_UPDATE;
	z_impl_zsock_setsockopt_fake.custom_fake = setsockopt_load;
	lwm2m_utils_connection_manage(&ctx, &event);

	event = LWM2M_RD_CLIENT_EVENT_DISCONNECT;
	lwm2m_utils_connection_manage(&ctx, &event);
}

ZTEST(lwm2m_client_utils_con_management, test_psm_disabled)
{
	struct lwm2m_ctx ctx;
	enum lwm2m_rd_client_event event = LWM2M_RD_CLIENT_EVENT_REGISTRATION_COMPLETE;

	lte_lc_psm_get_fake.custom_fake = lte_lc_psm_disabled;
	lwm2m_utils_connection_manage(&ctx, &event);

	zassert_equal(lwm2m_get_u32_fake.call_count, 0,
		      "Incorrect number of lwm2m_get_u32() calls");
}

ZTEST(lwm2m_client_utils_con_management, test_request_tau)
{
	struct lwm2m_ctx ctx;
	enum lwm2m_rd_client_event event = LWM2M_RD_CLIENT_EVENT_REGISTRATION_COMPLETE;

	lte_lc_psm_get_fake.custom_fake = lte_lc_psm_ok;
	lwm2m_get_u32_fake.custom_fake = get_lifetime;
	lwm2m_utils_connection_manage(&ctx, &event);

	zassert_equal(lte_lc_psm_param_set_seconds_fake.call_count, 1,
		      "Incorrect number of lte_lc_psm_param_set_seconds() calls");
	zassert_equal(lte_lc_psm_param_set_seconds_fake.arg0_val, LIFETIME, "Incorrect lifetime");
}

ZTEST(lwm2m_client_utils_con_management, test_tau_and_lifetime_match)
{
	struct lwm2m_ctx ctx;
	enum lwm2m_rd_client_event event = LWM2M_RD_CLIENT_EVENT_REGISTRATION_COMPLETE;

	lte_lc_psm_get_fake.custom_fake = lte_lc_psm_ok;
	lwm2m_get_u32_fake.custom_fake = get_lifetime_and_tau_match;
	lwm2m_utils_connection_manage(&ctx, &event);

	zassert_equal(lte_lc_psm_param_set_seconds_fake.call_count, 0,
		      "Incorrect number of lte_lc_psm_param_set_seconds() calls");
}
```

## src/conneval.c
```c
/*
 * Copyright (c) 2023 Nordic Semiconductor ASA
 *
 * SPDX-License-Identifier: LicenseRef-Nordic-5-Clause
 */

#include <zephyr/ztest.h>
#include <zephyr/fff.h>

#include <net/lwm2m_client_utils.h>
#include "stubs.h"

static int counter_int;
static int counter_short;

static int resp_cb(nrf_modem_at_resp_handler_t cb, const char *fmt, char *p)
{
	cb("my_resp");

	return 0;
}

static void setup(void *data)
{
	/* Register resets */
	DO_FOREACH_FAKE(RESET_FAKE);

	/* reset common FFF internal structures */
	FFF_RESET_HISTORY();

	counter_int = 0;
	counter_short = 0;
	nrf_modem_at_cmd_async_fake.custom_fake = resp_cb;
}

static int energy_normal(struct lte_lc_conn_eval_params *params)
{
	params->energy_estimate = LTE_LC_ENERGY_CONSUMPTION_NORMAL;

	return 0;
}

static int energy_increased(struct lte_lc_conn_eval_params *params)
{
	params->energy_estimate = LTE_LC_ENERGY_CONSUMPTION_INCREASED;

	return 0;
}

static int at_parser_int32_get_custom_fake_error(struct at_parser *parser, size_t index,
						 int32_t *value)
{
	if (counter_int <= 1) {
		*value = 1;
	} else {
		*value = 0;
	}
	counter_int++;

	return 0;
}

static int at_parser_int32_get_custom_fake_ok(struct at_parser *parser, size_t index,
					      int32_t *value)
{
	*value = 0;

	return 0;
}

int at_parser_uint16_get_changing_energy(struct at_parser *parser, size_t index, uint16_t *value)
{
	if (counter_short > 2) {
		*value = LTE_LC_ENERGY_CONSUMPTION_NORMAL;
	} else {
		*value = LTE_LC_ENERGY_CONSUMPTION_INCREASED;
	}
	counter_short++;

	return 0;
}

int at_parser_uint16_get_normal_energy(struct at_parser *parser, size_t index, uint16_t *value)
{
	*value = LTE_LC_ENERGY_CONSUMPTION_NORMAL;

	return 0;
}

int at_parser_uint16_get_increased_energy(struct at_parser *parser, size_t index, uint16_t *value)
{
	*value = LTE_LC_ENERGY_CONSUMPTION_INCREASED;

	return 0;
}

ZTEST_SUITE(lwm2m_client_utils_conneval, NULL, NULL, setup, NULL, NULL);


ZTEST(lwm2m_client_utils_conneval, test_enable)
{
	int rc;

	rc = lwm2m_utils_enable_conneval(LTE_LC_ENERGY_CONSUMPTION_NORMAL, 60, 50);
	zassert_equal(rc, -EINVAL, "Wrong return value");

	rc = lwm2m_utils_enable_conneval(LTE_LC_ENERGY_CONSUMPTION_NORMAL, 60, 5000);
	zassert_equal(rc, 0, "Wrong return value");
}

ZTEST(lwm2m_client_utils_conneval, test_disable)
{
	int rc;
	struct lwm2m_ctx ctx;
	enum lwm2m_rd_client_event client_event;

	rc = lwm2m_utils_enable_conneval(LTE_LC_ENERGY_CONSUMPTION_NORMAL, 60, 5000);
	zassert_equal(rc, 0, "Wrong return value");

	lwm2m_utils_disable_conneval();

	client_event = LWM2M_RD_CLIENT_EVENT_REG_UPDATE;
	rc = lwm2m_utils_conneval(&ctx, &client_event);
	zassert_equal(rc, 0, "Wrong return value");

	zassert_equal(lte_lc_conn_eval_params_get_fake.call_count, 0,
		      "Incorrect number of lte_lc_conn_eval_params_get() calls");
}

ZTEST(lwm2m_client_utils_conneval, test_normal)
{
	int rc;
	struct lwm2m_ctx ctx;
	enum lwm2m_rd_client_event client_event;

	rc = lwm2m_utils_enable_conneval(LTE_LC_ENERGY_CONSUMPTION_NORMAL, 60, 5000);
	zassert_equal(rc, 0, "Wrong return value");

	lte_lc_conn_eval_params_get_fake.custom_fake = energy_normal;
	client_event = LWM2M_RD_CLIENT_EVENT_REG_UPDATE;

	rc = lwm2m_utils_conneval(&ctx, &client_event);
	zassert_equal(rc, 0, "Wrong return value");
	zassert_equal(lte_lc_conn_eval_params_get_fake.call_count, 1,
		      "Incorrect number of lte_lc_conn_eval_params_get() calls");
}

ZTEST(lwm2m_client_utils_conneval, test_max_delay)
{
	int rc;
	struct lwm2m_ctx ctx;
	enum lwm2m_rd_client_event client_event;

	rc = lwm2m_utils_enable_conneval(LTE_LC_ENERGY_CONSUMPTION_NORMAL, 20, 2000);
	zassert_equal(rc, 0, "Wrong return value");

	lte_lc_conn_eval_params_get_fake.custom_fake = energy_increased;
	at_parser_int32_get_fake.custom_fake = at_parser_int32_get_custom_fake_ok;
	at_parser_uint16_get_fake.custom_fake = at_parser_uint16_get_increased_energy;
	client_event = LWM2M_RD_CLIENT_EVENT_REG_UPDATE;

	rc = lwm2m_utils_conneval(&ctx, &client_event);
	zassert_equal(rc, 0, "Wrong return value");
	k_sleep(K_SECONDS(21)); /* Wait for timer */
	zassert_equal(lwm2m_engine_pause_fake.call_count, 1,
		      "Incorrect number of lte_lc_conn_eval_params_get() calls");
	zassert_equal(lte_lc_conn_eval_params_get_fake.call_count, 1,
		      "Incorrect number of lte_lc_conn_eval_params_get() calls");
	zassert_equal(lwm2m_engine_resume_fake.call_count, 1,
		      "Incorrect number of lte_lc_conn_eval_params_get() calls");
	zassert_equal(nrf_modem_at_cmd_async_fake.call_count, 9,
		      "Incorrect number of nrf_modem_at_cmd_async() calls");

	rc = lwm2m_utils_conneval(&ctx, &client_event);
	zassert_equal(rc, 0, "Wrong return value");
}

ZTEST(lwm2m_client_utils_conneval, test_energy_change)
{
	int rc;
	struct lwm2m_ctx ctx;
	enum lwm2m_rd_client_event client_event;

	rc = lwm2m_utils_enable_conneval(LTE_LC_ENERGY_CONSUMPTION_NORMAL, 20, 2000);
	zassert_equal(rc, 0, "Wrong return value");

	lte_lc_conn_eval_params_get_fake.custom_fake = energy_increased;
	at_parser_int32_get_fake.custom_fake = at_parser_int32_get_custom_fake_ok;
	at_parser_uint16_get_fake.custom_fake = at_parser_uint16_get_changing_energy;
	client_event = LWM2M_RD_CLIENT_EVENT_REG_UPDATE;

	rc = lwm2m_utils_conneval(&ctx, &client_event);
	zassert_equal(rc, 0, "Wrong return value");

	k_sleep(K_SECONDS(21)); /* Wait for timer */
	zassert_equal(lwm2m_engine_pause_fake.call_count, 1,
		      "Incorrect number of lte_lc_conn_eval_params_get() calls");
	zassert_equal(lte_lc_conn_eval_params_get_fake.call_count, 1,
		      "Incorrect number of lte_lc_conn_eval_params_get() calls");
	zassert_equal(lwm2m_engine_resume_fake.call_count, 1,
		      "Incorrect number of lte_lc_conn_eval_params_get() calls");
	zassert_equal(nrf_modem_at_cmd_async_fake.call_count, 4,
		      "Incorrect number of nrf_modem_at_cmd_async() calls");

	rc = lwm2m_utils_conneval(&ctx, &client_event);
	zassert_equal(rc, 0, "Wrong return value");
}

ZTEST(lwm2m_client_utils_conneval, test_evaluation_failed)
{
	int rc;
	struct lwm2m_ctx ctx;
	enum lwm2m_rd_client_event client_event;

	rc = lwm2m_utils_enable_conneval(LTE_LC_ENERGY_CONSUMPTION_NORMAL, 20, 2000);
	zassert_equal(rc, 0, "Wrong return value");

	lte_lc_conn_eval_params_get_fake.custom_fake = energy_increased;
	at_parser_int32_get_fake.custom_fake = at_parser_int32_get_custom_fake_error;
	at_parser_uint16_get_fake.custom_fake = at_parser_uint16_get_normal_energy;
	client_event = LWM2M_RD_CLIENT_EVENT_REG_UPDATE;

	rc = lwm2m_utils_conneval(&ctx, &client_event);
	zassert_equal(rc, 0, "Wrong return value");

	k_sleep(K_SECONDS(21)); /* Wait for timer */
	zassert_equal(lwm2m_engine_pause_fake.call_count, 1,
		      "Incorrect number of lte_lc_conn_eval_params_get() calls");
	zassert_equal(lte_lc_conn_eval_params_get_fake.call_count, 1,
		      "Incorrect number of lte_lc_conn_eval_params_get() calls");
	zassert_equal(lwm2m_engine_resume_fake.call_count, 1,
		      "Incorrect number of lte_lc_conn_eval_params_get() calls");
	zassert_equal(nrf_modem_at_cmd_async_fake.call_count, 3,
		      "Incorrect number of nrf_modem_at_cmd_async() calls");
	zassert_equal(at_parser_uint16_get_fake.call_count, 1,
		      "Incorrect number of at_parser_uint16_get() calls");
}

ZTEST(lwm2m_client_utils_conneval, test_incorrect_event)
{
	int rc;
	struct lwm2m_ctx ctx;
	enum lwm2m_rd_client_event client_event;

	rc = lwm2m_utils_enable_conneval(LTE_LC_ENERGY_CONSUMPTION_NORMAL, 60, 5000);
	zassert_equal(rc, 0, "Wrong return value");

	lte_lc_conn_eval_params_get_fake.custom_fake = energy_normal;
	client_event = LWM2M_RD_CLIENT_EVENT_REGISTRATION_COMPLETE;

	rc = lwm2m_utils_conneval(&ctx, &client_event);
	zassert_equal(rc, 0, "Wrong return value");
	zassert_equal(lte_lc_conn_eval_params_get_fake.call_count, 0,
		      "Incorrect number of lte_lc_conn_eval_params_get() calls");
}

ZTEST(lwm2m_client_utils_conneval, test_conn_eval_params_get_fail)
{
	int rc;
	struct lwm2m_ctx ctx;
	enum lwm2m_rd_client_event client_event;

	rc = lwm2m_utils_enable_conneval(LTE_LC_ENERGY_CONSUMPTION_NORMAL, 60, 5000);
	zassert_equal(rc, 0, "Wrong return value");

	lte_lc_conn_eval_params_get_fake.return_val = -1;
	client_event = LWM2M_RD_CLIENT_EVENT_REG_UPDATE;

	rc = lwm2m_utils_conneval(&ctx, &client_event);
	zassert_equal(rc, -1, "Wrong return value");
}
```

## src/connmon.c
```c
/*
 * Copyright (c) 2022 Nordic Semiconductor ASA
 *
 * SPDX-License-Identifier: LicenseRef-Nordic-5-Clause
 */

#include <zephyr/ztest.h>
#include <zephyr/fff.h>

#include <net/lwm2m_client_utils.h>
#include <modem/modem_key_mgmt.h>
#include <modem/lte_lc.h>
#include <modem/modem_info.h>
#include <zephyr/settings/settings.h>

#include "stubs.h"

/* LTE-FDD bearer & NB-IoT bearer */
#define LTE_FDD_BEARER 6U
#define NB_IOT_BEARER 7U

static rsrp_cb_t modem_info_rsrp_cb;

static uint8_t connmon_mode;

static int16_t modem_rsrp_resource;

static enum lte_lc_lte_mode lte_mode;

static struct modem_param_info modem_param = {
		.network.ip_address.value_string = "192.168.0.2",
		.network.apn.value_string = "nat.iot.no",
		.device.modem_fw.value_string = "mfw_nrf9160_1.3.1",
		.network.cellid_dec = 1234567,
		.network.mnc.value = 10,
		.network.mcc.value = 200,
		.network.area_code.value = 12345,
};

ZTEST_SUITE(lwm2m_client_utils_connmon, NULL, NULL, NULL, NULL, NULL);

static int set_string_custom_fake(const struct lwm2m_obj_path *path, const char *data)
{
	if (path->obj_id == 3 && path->obj_inst_id == 0 && path->res_id == 3) {
		zassert_mem_equal(modem_param.device.modem_fw.value_string, data, strlen(data),
				  "Wrong FW version");
	} else if (path->obj_id == 4 && path->obj_inst_id == 0 && path->res_id == 4 &&
		   path->res_inst_id == 0) {
		zassert_mem_equal(modem_param.network.ip_address.value_string, data, strlen(data),
				  "Wrong IP Address");
	} else if (path->obj_id == 4 && path->obj_inst_id == 0 && path->res_id == 7 &&
		   path->res_inst_id == 0){
		zassert_mem_equal(modem_param.network.apn.value_string, data, strlen(data),
				  "Wrong APN");
	} else {
		zassert(0, "Invalid path");
		return -EINVAL;
	}
	return 0;
}

static int set_s16_custom_fake(const struct lwm2m_obj_path *path, int16_t value)
{
	if (path->obj_id == 4 && path->obj_inst_id == 0 && path->res_id == 2) {
		zassert_equal((int16_t)RSRP_IDX_TO_DBM(modem_rsrp_resource), value);
	} else {
		zassert(0, "Invalid path");
		return -EINVAL;
	}
	return 0;
}

static int set_u8_custom_fake(const struct lwm2m_obj_path *path, uint8_t value)
{
	if (path->obj_id == 4 && path->obj_inst_id == 0 && path->res_id == 0) {
		if (lte_mode == LTE_LC_LTE_MODE_LTEM) {
			zassert_equal(LTE_FDD_BEARER, value);
		} else if (lte_mode == LTE_LC_LTE_MODE_NBIOT) {
			zassert_equal(NB_IOT_BEARER, value);
		} else {
			zassert(0, "Invalid mode");
		}
	} else {
		zassert(0, "Invalid path");
		return -EINVAL;
	}
	return 0;
}

static int copy_modem_info(struct modem_param_info *params)
{
	params = &modem_param;
	return 0;
}
static int copy_rsrp_handler(rsrp_cb_t cb)
{
	modem_info_rsrp_cb = cb;
	return 0;
}

static void setup(void)
{
	/* Register resets */
	DO_FOREACH_FAKE(RESET_FAKE);

	/* reset common FFF internal structures */
	FFF_RESET_HISTORY();
	modem_info_rsrp_cb = NULL;
	connmon_mode = 0;
	modem_rsrp_resource = 0;
	lte_mode = LTE_LC_LTE_MODE_NONE;
}

/*
 * Tests for initializing the module
 */
ZTEST(lwm2m_client_utils_connmon, test_modem_info_init_fail)
{
	setup();

	modem_info_init_fake.return_val = -1;
	call_lwm2m_init_callbacks();
	zassert_equal(modem_info_init_fake.call_count, 1, "Modem info init not called");
}

ZTEST(lwm2m_client_utils_connmon, test_modem_info_params_init_fail)
{
	setup();

	modem_info_params_init_fake.return_val = -2;
	call_lwm2m_init_callbacks();
	zassert_equal(modem_info_params_init_fake.call_count, 1, "Info params init not called");
}

ZTEST(lwm2m_client_utils_connmon, test_connected)
{
	struct lte_lc_evt evt = {0};

	setup();

	modem_rsrp_resource = 50;
	lwm2m_set_string_fake.custom_fake = set_string_custom_fake;
	lwm2m_set_s16_fake.custom_fake = set_s16_custom_fake;
	modem_info_params_get_fake.custom_fake = copy_modem_info;
	modem_info_rsrp_register_fake.custom_fake = copy_rsrp_handler;
	call_lwm2m_init_callbacks();
	evt.type = LTE_LC_EVT_NW_REG_STATUS;
	evt.nw_reg_status = LTE_LC_NW_REG_REGISTERED_HOME;
	call_lte_handlers(&evt);
	k_sleep(K_MSEC(100));
	zassert_equal(modem_info_params_get_fake.call_count, 1, "Info params get not called");
	zassert_equal(lwm2m_set_string_fake.call_count, 3, "Strings not set");
	modem_info_rsrp_cb(modem_rsrp_resource);
	k_sleep(K_MSEC(100));
	zassert_equal(lwm2m_set_s16_fake.call_count, 1, "RSRP not set");
	evt.nw_reg_status = LTE_LC_NW_REG_NOT_REGISTERED;
	call_lte_handlers(&evt);
	k_sleep(K_MSEC(100));
	zassert_equal(modem_info_params_get_fake.call_count, 1, "Info params called");
	zassert_equal(lwm2m_set_string_fake.call_count, 3, "Strings set");
}

ZTEST(lwm2m_client_utils_connmon, test_update_disconnected)
{
	struct lte_lc_evt evt = {0};

	setup();

	lwm2m_set_string_fake.custom_fake = set_string_custom_fake;
	modem_info_params_get_fake.custom_fake = copy_modem_info;
	evt.type = LTE_LC_EVT_CELL_UPDATE;
	call_lte_handlers(&evt);
	k_sleep(K_MSEC(100));
	zassert_equal(modem_info_params_get_fake.call_count, 0, "Info params called");
	zassert_equal(lwm2m_set_string_fake.call_count, 0, "Strings set");
}

ZTEST(lwm2m_client_utils_connmon, test_update)
{
	struct lte_lc_evt evt = {0};

	setup();

	lwm2m_set_string_fake.custom_fake = set_string_custom_fake;
	modem_info_params_get_fake.custom_fake = copy_modem_info;
	evt.type = LTE_LC_EVT_NW_REG_STATUS;
	evt.nw_reg_status = LTE_LC_NW_REG_REGISTERED_HOME;
	call_lte_handlers(&evt);
	k_sleep(K_MSEC(100));
	zassert_equal(modem_info_params_get_fake.call_count, 1, "Info params get not called");
	zassert_equal(lwm2m_set_string_fake.call_count, 3, "Strings not set");
	evt.type = LTE_LC_EVT_CELL_UPDATE;
	call_lte_handlers(&evt);
	k_sleep(K_MSEC(100));
	zassert_equal(modem_info_params_get_fake.call_count, 2, "Info params called");
	zassert_equal(lwm2m_set_string_fake.call_count, 6, "Strings set");
	evt.type = LTE_LC_EVT_NW_REG_STATUS;
	evt.nw_reg_status = LTE_LC_NW_REG_NOT_REGISTERED;
	call_lte_handlers(&evt);
	k_sleep(K_MSEC(100));
	zassert_equal(modem_info_params_get_fake.call_count, 2, "Info params called");
	zassert_equal(lwm2m_set_string_fake.call_count, 6, "Strings set");
}

ZTEST(lwm2m_client_utils_connmon, test_lte_mode_update)
{
	struct lte_lc_evt evt = {0};

	setup();
	lte_mode = LTE_LC_LTE_MODE_LTEM;

	lwm2m_set_u8_fake.custom_fake = set_u8_custom_fake;
	evt.type = LTE_LC_EVT_LTE_MODE_UPDATE;
	evt.lte_mode = lte_mode;
	call_lte_handlers(&evt);
	zassert_equal(lwm2m_set_u8_fake.call_count, 1, "LTE mode not set");
}
```

## src/device.c
```c
/*
 * Copyright (c) 2022 Nordic Semiconductor ASA
 *
 * SPDX-License-Identifier: LicenseRef-Nordic-5-Clause
 */
#include <zephyr/ztest.h>
#include <zephyr/fff.h>

#include <zephyr/kernel.h>
#include <zephyr/logging/log_ctrl.h>
#include <zephyr/sys/reboot.h>
#include <zephyr/net/lwm2m.h>
#include <net/lwm2m_client_utils.h>

#include "stubs.h"

ZTEST_SUITE(lwm2m_client_utils_device, NULL, NULL, NULL, NULL, NULL);

static lwm2m_engine_execute_cb_t reboot_cb;
static int reboot_type;

static int lwm2m_register_exec_callback_copy(const struct lwm2m_obj_path *path,
						    lwm2m_engine_execute_cb_t cb)
{
	reboot_cb = cb;
	reboot_type = -1;
	return 0;
}

/* Stubbed */
FUNC_NORETURN void sys_reboot(int types)
{
	reboot_type = types;

	while (1) {
		k_sleep(K_SECONDS(1));
	}
}

static void setup(void)
{
	/* Register resets */
	DO_FOREACH_FAKE(RESET_FAKE);

	/* reset common FFF internal structures */
	FFF_RESET_HISTORY();

	reboot_cb = NULL;
	lwm2m_register_exec_callback_fake.custom_fake = NULL;
}

/*
 * Tests for initializing the module and test reboot funtionality
 */

ZTEST(lwm2m_client_utils_device, test_init_device)
{
	setup();
	lwm2m_register_exec_callback_fake.custom_fake =
		lwm2m_register_exec_callback_copy;

	call_lwm2m_init_callbacks();
	zassert_not_null(reboot_cb, "NULL");
}
```

## src/dummy_wlan.c
```c
/*
 * Copyright (c) 2022 Nordic Semiconductor ASA
 *
 * SPDX-License-Identifier: LicenseRef-Nordic-5-Clause
 */
#include <zephyr/device.h>

/* Define a dummy driver just that the linker finds it. Otherwise we get a complaint like:
 *     undefined reference to `__device_dts_ord_12'
 */
#define DT_DRV_COMPAT nordic_wlan0
DEVICE_DT_INST_DEFINE(0, NULL, NULL, NULL, NULL, POST_KERNEL, 0, NULL);
```

## src/location_assistance.c
```c
/*
 * Copyright (c) 2022 Nordic Semiconductor ASA
 *
 * SPDX-License-Identifier: LicenseRef-Nordic-5-Clause
 */

#include <stdlib.h>
#include <zephyr/kernel.h>
#include <zephyr/device.h>
#include <zephyr/init.h>
#include <zephyr/ztest.h>
#include <zephyr/fff.h>
#include "lwm2m_object.h"

#include <net/lwm2m_client_utils_location.h>
#include "stubs.h"

#include "gnss_assistance_obj.h"
#include "ground_fix_obj.h"
#include "location_assistance.h"

#define GNSS_ASSIST_ASSIST_DATA 6
#define GNSS_ASSIST_RESULT_CODE 7

#define GROUND_FIX_RESULT_CODE 1

static struct lwm2m_engine_obj_inst *gnss_obj;
static struct lwm2m_engine_obj_inst *ground_obj;
static int32_t last_result_code;

#define SERVER_RETRY_TIMEOT ((LOCATION_ASSISTANT_RESULT_TIMEOUT * 2) + 2)

static void gnss_result_set(int32_t result);
static void ground_result_set(int32_t result);


void result_code_cb(uint16_t object_id, int32_t result_code)
{
	printf("Result code %d from object %d\r\n", result_code, object_id);
	last_result_code = result_code;
}



int lwm2m_set_s32_custom_fake(const struct lwm2m_obj_path *path, int32_t value)
{
	printf("SET custom s32 %d, /%d/0/%d\r\n", value, path->obj_id, path->res_id);
	if (path->obj_id == GNSS_ASSIST_OBJECT_ID && path->res_id == GNSS_ASSIST_RESULT_CODE) {
		gnss_result_set(value);
	} else if (path->obj_id == GROUND_FIX_OBJECT_ID && path->res_id == GROUND_FIX_RESULT_CODE) {
		ground_result_set(value);
	}

	return 0;
}

static void setup(void)
{
	/* Register resets */
	DO_FOREACH_FAKE(RESET_FAKE);

	/* reset common FFF internal structures */
	FFF_RESET_HISTORY();

	location_assistance_retry_init(false);
	location_assistance_set_result_code_cb(result_code_cb);

	lwm2m_set_s32_fake.custom_fake = lwm2m_set_s32_custom_fake;
}

void fake_lwm2m_register_obj(struct lwm2m_engine_obj *obj)
{
	lwm2m_engine_obj_create_cb_t create_obj_cb;

	create_obj_cb = obj->create_cb;

	if (obj->obj_id == GNSS_ASSIST_OBJECT_ID) {
		if (!gnss_obj) {
			gnss_obj = create_obj_cb(0);
		}
	} else if (obj->obj_id == GROUND_FIX_OBJECT_ID) {
		if (!ground_obj) {
			ground_obj = create_obj_cb(0);
		}
	}
}

static struct nrf_modem_gnss_agnss_data_frame agnss_req = {
	.data_flags = 0xffffffff,
	.system_count = 1,
	.system[0].system_id = NRF_MODEM_GNSS_SYSTEM_GPS,
	.system[0].sv_mask_ephe = 0xffffffff,
	.system[0].sv_mask_alm = 0xffffffff,
};

static struct lwm2m_ctx client_ctx;

static int suite_setup(void)
{
	lwm2m_register_obj_fake.custom_fake = fake_lwm2m_register_obj;

	return 0;
}

static void gnss_result_set(int32_t result)
{
	void *ptr = &result;

	gnss_obj->resources[GNSS_ASSIST_RESULT_CODE].post_write_cb(0, GNSS_ASSIST_RESULT_CODE, 0,
								   ptr, 4, true, 4, 0);
}

static void ground_result_set(int32_t result)
{
	void *ptr = &result;

	ground_obj->resources[GROUND_FIX_RESULT_CODE].post_write_cb(0, GROUND_FIX_RESULT_CODE, 0,
								   ptr, 4, true, 4, 0);

}

static void gnss_assist_data_write(uint8_t *buf, int length)
{
	gnss_obj->resources[GNSS_ASSIST_ASSIST_DATA].post_write_cb(0, GNSS_ASSIST_ASSIST_DATA, 0,
								   buf, length, true, length, 0);
}

static void *loaction_assist_suite_setup(void)
{
	/* Validate that Object are initialized for testing */
	zassert_not_null(gnss_obj, "GNSS object was null");
	zassert_not_null(ground_obj, "Ground object was null");

	return NULL;
}

ZTEST_SUITE(lwm2m_client_utils_location_assistance, NULL, loaction_assist_suite_setup, NULL, NULL,
	    NULL);

ZTEST(lwm2m_client_utils_location_assistance, test_agnss_send)
{
	int rc;
	uint8_t buf[8] = {1, 2, 3, 4, 5, 6, 7, 8};

	setup();

	rc = location_assistance_agnss_set_mask(&agnss_req);
	zassert_equal(rc, 0, "Error %d", rc);

	rc = location_assistance_agnss_request_send(&client_ctx);
	zassert_equal(rc, 0, "Error %d", rc);
	zassert_equal(lwm2m_send_cb_fake.call_count, 1, "Request not sent");

	gnss_result_set(LOCATION_ASSIST_RESULT_CODE_OK);

	gnss_assist_data_write(buf, 8);

	zassert_equal(last_result_code, LOCATION_ASSIST_RESULT_CODE_OK, "Wrong result");
	zassert_equal(nrf_cloud_agnss_process_fake.call_count, 1, "Data not processed %d",
		      nrf_cloud_agnss_process_fake.call_count);

	/* test timeout + 1 retry*/
	rc = location_assistance_agnss_set_mask(&agnss_req);
	zassert_equal(rc, 0, "Error %d", rc);

	rc = location_assistance_agnss_request_send(&client_ctx);
	zassert_equal(rc, 0, "Error %d", rc);
	zassert_equal(lwm2m_send_cb_fake.call_count, 2, "Request not sent");
	k_sleep(K_SECONDS(SERVER_RETRY_TIMEOT));
	zassert_equal(last_result_code, LOCATION_ASSIST_RESULT_CODE_NO_RESP_ERR, "Wrong result %d",
		      last_result_code);
}

ZTEST(lwm2m_client_utils_location_assistance, test_pgps_send)
{
	int rc;
	uint8_t buf[8] = {1, 2, 3, 4, 5, 6, 7, 8};

	setup();

	rc = location_assistance_pgps_request_send(&client_ctx);
	zassert_equal(rc, 0, "Error %d", rc);
	zassert_equal(lwm2m_send_cb_fake.call_count, 1, "Request not sent");

	gnss_result_set(LOCATION_ASSIST_RESULT_CODE_OK);
	gnss_assist_data_write(buf, 8);
	zassert_equal(last_result_code, LOCATION_ASSIST_RESULT_CODE_OK, "Wrong result");
	zassert_equal(nrf_cloud_pgps_finish_update_fake.call_count, 1, "Data not processed");
	/* Test Timeout + 1 retry*/
	rc = location_assistance_pgps_request_send(&client_ctx);
	zassert_equal(rc, 0, "Error %d", rc);
	zassert_equal(lwm2m_send_cb_fake.call_count, 2, "Request not sent");
	k_sleep(K_SECONDS(SERVER_RETRY_TIMEOT));
	zassert_equal(last_result_code, LOCATION_ASSIST_RESULT_CODE_NO_RESP_ERR, "Wrong result %d",
		      last_result_code);
	zassert_equal(lwm2m_send_cb_fake.call_count, 3, "Request not sent");
	rc = location_assistance_pgps_request_send(&client_ctx);
	zassert_equal(rc, 0, "Error %d", rc);
	zassert_equal(lwm2m_send_cb_fake.call_count, 4, "Request not sent");

	gnss_assist_data_write(buf, 8);
	gnss_result_set(LOCATION_ASSIST_RESULT_CODE_OK);
	zassert_equal(last_result_code, LOCATION_ASSIST_RESULT_CODE_OK, "Wrong result");
	zassert_equal(nrf_cloud_pgps_finish_update_fake.call_count, 2, "Data not processed");
}

ZTEST(lwm2m_client_utils_location_assistance, test_simultaneous_send)
{
	int rc;
	uint8_t buf[8] = {1, 2, 3, 4, 5, 6, 7, 8};

	setup();

	rc = location_assistance_agnss_set_mask(&agnss_req);
	zassert_equal(rc, 0, "Error %d", rc);

	rc = location_assistance_agnss_request_send(&client_ctx);
	zassert_equal(rc, 0, "Error %d", rc);
	zassert_equal(lwm2m_send_cb_fake.call_count, 1, "Request not sent");

	rc = location_assistance_pgps_request_send(&client_ctx);
	zassert_equal(rc, -EAGAIN, "Error %d", rc);

	gnss_assist_data_write(buf, 8);
	gnss_result_set(LOCATION_ASSIST_RESULT_CODE_OK);
	zassert_equal(last_result_code, LOCATION_ASSIST_RESULT_CODE_OK, "Wrong result");
	zassert_equal(nrf_cloud_agnss_process_fake.call_count, 1, "Data not processed");

	rc = location_assistance_pgps_request_send(&client_ctx);
	zassert_equal(rc, 0, "Error %d", rc);
	zassert_equal(lwm2m_send_cb_fake.call_count, 2, "Request not sent");
	gnss_assist_data_write(buf, 8);
	gnss_result_set(LOCATION_ASSIST_RESULT_CODE_OK);
	zassert_equal(last_result_code, LOCATION_ASSIST_RESULT_CODE_OK, "Wrong result");
	zassert_equal(nrf_cloud_pgps_finish_update_fake.call_count, 1, "Data not processed");
}

ZTEST(lwm2m_client_utils_location_assistance, test_ground_fix_send)
{
	int rc;

	setup();

	location_assistance_retry_init(true);

	/* Test Timeout */
	rc = location_assistance_ground_fix_request_send(&client_ctx);
	last_result_code = 0;
	zassert_equal(rc, 0, "Error %d", rc);
	zassert_equal(lwm2m_send_cb_fake.call_count, 1, "Request not sent");
	k_sleep(K_SECONDS(SERVER_RETRY_TIMEOT));
	zassert_equal(lwm2m_send_cb_fake.call_count, 2, "Request not sent");
	zassert_equal(last_result_code, LOCATION_ASSIST_RESULT_CODE_NO_RESP_ERR, "Wrong result %d",
		      last_result_code);
	/*Test temporary error*/
	rc = location_assistance_ground_fix_request_send(&client_ctx);
	last_result_code = 0;
	zassert_equal(rc, 0, "Error %d", rc);
	zassert_equal(lwm2m_send_cb_fake.call_count, 3, "Request not sent");
	k_sleep(K_SECONDS(1));
	ground_result_set(LOCATION_ASSIST_RESULT_CODE_TEMP_ERR);


	zassert_equal(last_result_code, LOCATION_ASSIST_RESULT_CODE_TEMP_ERR, "Wrong result %d",
		      last_result_code);
	/* Test that new request is blocked */
	rc = location_assistance_ground_fix_request_send(&client_ctx);
	zassert_equal(rc, -EALREADY, "Error %d", rc);
	k_sleep(K_SECONDS(LOCATION_ASSISTANT_INITIAL_RETRY_INTERVAL + 5));
	zassert_equal(lwm2m_send_cb_fake.call_count, 4, "Request not sent");
	/* Simulate response */
	ground_result_set(LOCATION_ASSIST_RESULT_CODE_OK);
	zassert_equal(last_result_code, LOCATION_ASSIST_RESULT_CODE_OK, "Wrong result %d",
		      last_result_code);
	/*Test pernament error*/
	rc = location_assistance_ground_fix_request_send(&client_ctx);
	last_result_code = 0;
	zassert_equal(rc, 0, "Error %d", rc);
	zassert_equal(lwm2m_send_cb_fake.call_count, 5, "Request not sent");
	k_sleep(K_SECONDS(1));
	ground_result_set(LOCATION_ASSIST_RESULT_CODE_PERMANENT_ERR);
	zassert_equal(last_result_code, LOCATION_ASSIST_RESULT_CODE_PERMANENT_ERR,
		      "Wrong result %d", last_result_code);
	rc = location_assistance_ground_fix_request_send(&client_ctx);
	last_result_code = 0;
	zassert_equal(rc, -EPIPE, "Error %d", rc);
}

ZTEST(lwm2m_client_utils_location_assistance, test_temporary_failure)
{
	int rc;
	uint8_t buf[8] = {1, 2, 3, 4, 5, 6, 7, 8};

	setup();

	location_assistance_retry_init(true);

	rc = location_assistance_agnss_set_mask(&agnss_req);
	zassert_equal(rc, 0, "Error %d", rc);

	rc = location_assistance_agnss_request_send(&client_ctx);
	zassert_equal(rc, 0, "Error %d", rc);
	zassert_equal(lwm2m_send_cb_fake.call_count, 1, "Request not sent");
	gnss_result_set(LOCATION_ASSIST_RESULT_CODE_TEMP_ERR);
	k_sleep(K_MSEC(100));

	rc = location_assistance_agnss_request_send(&client_ctx);
	zassert_equal(rc, -EALREADY, "Error %d", rc);
	zassert_equal(last_result_code, LOCATION_ASSIST_RESULT_CODE_TEMP_ERR, "Wrong result");

	k_sleep(K_SECONDS(LOCATION_ASSISTANT_INITIAL_RETRY_INTERVAL + 5));
	zassert_equal(lwm2m_send_cb_fake.call_count, 2, "Request not sent");

	/* Simulate response */
	gnss_assist_data_write(buf, 8);
	gnss_result_set(LOCATION_ASSIST_RESULT_CODE_OK);
	zassert_equal(last_result_code, LOCATION_ASSIST_RESULT_CODE_OK, "Wrong result");
	zassert_equal(nrf_cloud_agnss_process_fake.call_count, 1, "Data not processed %d",
		      nrf_cloud_pgps_finish_update_fake.call_count);
	/* Test Timeout with 1 retry */
	rc = location_assistance_agnss_set_mask(&agnss_req);
	zassert_equal(rc, 0, "Error %d", rc);
	rc = location_assistance_agnss_request_send(&client_ctx);
	zassert_equal(rc, 0, "Error %d", rc);
	zassert_equal(lwm2m_send_cb_fake.call_count, 3, "Request not sent");
	k_sleep(K_SECONDS(SERVER_RETRY_TIMEOT));
	zassert_equal(lwm2m_send_cb_fake.call_count, 4, "Request not sent");
	zassert_equal(last_result_code, LOCATION_ASSIST_RESULT_CODE_NO_RESP_ERR, "Wrong result");
}

ZTEST(lwm2m_client_utils_location_assistance, test_zzzpermanent_failure)
{
	int rc;

	setup();

	location_assistance_retry_init(true);

	rc = location_assistance_agnss_set_mask(&agnss_req);
	zassert_equal(rc, 0, "Error %d", rc);

	rc = location_assistance_agnss_request_send(&client_ctx);
	zassert_equal(rc, 0, "Error %d", rc);
	zassert_equal(lwm2m_send_cb_fake.call_count, 1, "Request not sent");
	gnss_result_set(LOCATION_ASSIST_RESULT_CODE_PERMANENT_ERR);

	k_sleep(K_MSEC(100));
	rc = location_assistance_agnss_set_mask(&agnss_req);
	zassert_equal(rc, -EPIPE, "Error %d", rc);
	zassert_equal(last_result_code, LOCATION_ASSIST_RESULT_CODE_PERMANENT_ERR, "Wrong result");
}

SYS_INIT(suite_setup, APPLICATION, 0);
```

## src/notification.c
```c
/*
 * Copyright (c) 2022 Nordic Semiconductor ASA
 *
 * SPDX-License-Identifier: LicenseRef-Nordic-5-Clause
 */

#include <zephyr/kernel.h>
#include <zephyr/device.h>
#include <zephyr/init.h>
#include <zephyr/ztest.h>
#include <zephyr/fff.h>

#include <net/lwm2m_client_utils_location.h>
#include "stubs.h"

static struct lte_lc_ncell cells[] = {
	[0].earfcn = 12345,
	[0].time_diff = 123,
	[0].phys_cell_id = 12345,
	[0].rsrp = -54,
	[0].rsrq = -32,
	[1].earfcn = 23456,
	[1].time_diff = 233,
	[1].phys_cell_id = 23456,
	[1].rsrp = -43,
	[1].rsrq = -21,
	[2].earfcn = 34567,
	[2].time_diff = 345,
	[2].phys_cell_id = 34567,
	[2].rsrp = -32,
	[2].rsrq = -10,
};

static struct lte_lc_cells_info cell_info = {
	.ncells_count = 3,
	.neighbor_cells = cells,
};

static void setup(void)
{
	/* Register resets */
	DO_FOREACH_FAKE(RESET_FAKE);

	/* reset common FFF internal structures */
	FFF_RESET_HISTORY();
}

ZTEST_SUITE(lwm2m_client_utils_lte_notification, NULL, NULL, NULL, NULL, NULL);


ZTEST(lwm2m_client_utils_lte_notification, test_ncell_schedule_measurement)
{
	int rc;
	struct lte_lc_evt evt = {0};

	setup();
	lwm2m_ncell_schedule_measurement();
	zassert_equal(lte_lc_neighbor_cell_measurement_fake.call_count, 0,
		      "Cell_measurement call count should be 0");
	rc = lwm2m_ncell_handler_register();
	zassert_equal(rc, 0, "Wrong return value");
	evt.type = LTE_LC_EVT_RRC_UPDATE;
	evt.rrc_mode = LTE_LC_RRC_MODE_CONNECTED;
	call_lte_handlers(&evt);
	zassert_equal(lte_lc_neighbor_cell_measurement_fake.call_count, 0,
		      "No call to lte_lc_neighbor_cell_measurement()");
	evt.rrc_mode = LTE_LC_RRC_MODE_IDLE;
	call_lte_handlers(&evt);
	zassert_equal(lte_lc_neighbor_cell_measurement_fake.call_count, 1,
		      "No call to lte_lc_neighbor_cell_measurement()");
	lwm2m_ncell_schedule_measurement();
}

static struct lwm2m_ctx ctx;
ZTEST(lwm2m_client_utils_lte_notification, test_tau_prewarning)
{
	int rc;
	struct lte_lc_evt evt = {0};

	setup();

	rc = lwm2m_ncell_handler_register();
	zassert_equal(rc, 0, "Wrong return value");
	evt.type = LTE_LC_EVT_TAU_PRE_WARNING;
	call_lte_handlers(&evt);
	zassert_equal(lwm2m_rd_client_update_fake.call_count, 0,
		      "LwM2M RD client update call count should be 0");

	lwm2m_rd_client_ctx_fake.return_val = &ctx;
	call_lte_handlers(&evt);
	zassert_equal(lwm2m_rd_client_update_fake.call_count, 1,
		      "LwM2M RD client not updated");
}

ZTEST(lwm2m_client_utils_lte_notification, test_neighbor_cell_meas)
{
	int rc;
	struct lte_lc_evt evt = {
		.cells_info = cell_info,
	};

	setup();

	rc = lwm2m_ncell_handler_register();
	zassert_equal(rc, 0, "Wrong return value");
	evt.type = LTE_LC_EVT_NEIGHBOR_CELL_MEAS;
	call_lte_handlers(&evt);

	zassert_equal(lwm2m_set_s32_fake.call_count, 15,
		      "Cell info not updated, was %d", lwm2m_set_s32_fake.call_count);
}
```

## src/pm_config.h
```c
/*
 * Copyright (c) 2022 Nordic Semiconductor ASA
 *
 * SPDX-License-Identifier: LicenseRef-Nordic-5-Clause
 */

/* DUMMY FILE ONLY TO BE USED FOR TESTING */
#ifndef PM_CONFIG_H__
#define PM_CONFIG_H__
#define PM_MCUBOOT_PRIMARY_ID 3
#endif /* PM_CONFIG_H__ */
```

## src/signal_meas_info.c
```c
/*
 * Copyright (c) 2022 Nordic Semiconductor ASA
 *
 * SPDX-License-Identifier: LicenseRef-Nordic-5-Clause
 */

#include <zephyr/kernel.h>
#include <zephyr/device.h>
#include <zephyr/init.h>
#include <zephyr/ztest.h>
#include <zephyr/fff.h>

#include <net/lwm2m_client_utils_location.h>
#include "stubs.h"

static struct lte_lc_ncell cells[] = {
	[0].earfcn = 12345,
	[0].time_diff = 123,
	[0].phys_cell_id = 12345,
	[0].rsrp = -54,
	[0].rsrq = -32,
	[1].earfcn = 23456,
	[1].time_diff = 233,
	[1].phys_cell_id = 23456,
	[1].rsrp = -43,
	[1].rsrq = -21,
	[2].earfcn = 34567,
	[2].time_diff = 345,
	[2].phys_cell_id = 34567,
	[2].rsrp = -32,
	[2].rsrq = -10,
};

static struct lte_lc_cells_info cell_info = {
	.ncells_count = 3,
	.neighbor_cells = cells,
};

static void setup(void)
{
	/* Register resets */
	DO_FOREACH_FAKE(RESET_FAKE);

	/* reset common FFF internal structures */
	FFF_RESET_HISTORY();
}


ZTEST_SUITE(lwm2m_client_utils_signal_meas_info, NULL, NULL, NULL, NULL, NULL);

ZTEST(lwm2m_client_utils_signal_meas_info, test_update_ncells)
{
	int rc;

	setup();

	rc = lwm2m_update_signal_meas_objects(&cell_info);
	zassert_equal(rc, 0, "Error, %d", rc);
	zassert_equal(lwm2m_set_s32_fake.call_count, 15,
		      "Cell info not updated, was %d", lwm2m_set_s32_fake.call_count);

	cell_info.ncells_count = 2;

	rc = lwm2m_update_signal_meas_objects(&cell_info);
	zassert_equal(rc, 0, "Error, %d", rc);
	zassert_equal(lwm2m_set_s32_fake.call_count, 30,
		      "Cell info not updated, was %d", lwm2m_set_s32_fake.call_count);
}
```
