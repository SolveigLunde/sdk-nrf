## CMakeLists.txt
```
#
# Copyright (c) 2024 Nordic Semiconductor ASA
#
# SPDX-License-Identifier: LicenseRef-Nordic-5-Clause
#
cmake_minimum_required(VERSION 3.20.0)

find_package(Zephyr REQUIRED HINTS $ENV{ZEPHYR_BASE})
project(ot_rpc_server_test)

FILE(GLOB app_sources src/*.c)

target_include_directories(app PRIVATE
  # Needed to access OpenThread RPC command IDs.
  ${ZEPHYR_NRF_MODULE_DIR}/subsys/net/openthread/rpc/common
  ${ZEPHYR_NRF_MODULE_DIR}/subsys/net/openthread/rpc/server
  ../common
)

target_sources(app PRIVATE
  ${app_sources}
  ../common/nrf_rpc_single_thread.c
)

# Fill the gaps due to not setting NET_L2_OPENTHREAD.
zephyr_include_directories(
  ${ZEPHYR_OPENTHREAD_MODULE_DIR}/include
  ${ZEPHYR_BASE}/modules/openthread/include
)

zephyr_compile_definitions(
  CONFIG_OPENTHREAD_PKT_LIST_SIZE=1
)

# Enforce single-threaded nRF RPC command processing.
target_link_options(app PUBLIC
  -Wl,--wrap=nrf_rpc_os_init,--wrap=nrf_rpc_os_thread_pool_send
)
```

## Kconfig
```
menu "Zephyr Kernel"
source "Kconfig.zephyr"
endmenu

config OPENTHREAD_MESH_DIAG
	bool "Mesh diagnostics"
	default y
```

## prj.conf
```kconfig
#
# Copyright (c) 2024 Nordic Semiconductor ASA
#
# SPDX-License-Identifier: LicenseRef-Nordic-5-Clause
#

# Ztest configuration
CONFIG_ZTEST=y
CONFIG_TEST_RANDOM_GENERATOR=y

CONFIG_OPENTHREAD_RPC=y
CONFIG_OPENTHREAD_RPC_SERVER=y
CONFIG_NRF_RPC_ZCBOR_BACKUPS=1
CONFIG_NRF_RPC_CALLBACK_PROXY=n

CONFIG_MOCK_NRF_RPC=y
CONFIG_MOCK_NRF_RPC_TRANSPORT=y

CONFIG_KERNEL_MEM_POOL=y
CONFIG_HEAP_MEM_POOL_SIZE=4096

CONFIG_ASAN=y
```

## src/coap_suite.c
```c
/*
 * Copyright (c) 2024 Nordic Semiconductor ASA
 *
 * SPDX-License-Identifier: LicenseRef-Nordic-5-Clause
 */

#include <mock_nrf_rpc_transport.h>
#include <ot_rpc_ids.h>
#include <ot_rpc_lock.h>
#include <ot_rpc_resource.h>
#include <test_rpc_env.h>

#include <zephyr/fff.h>
#include <zephyr/kernel.h>
#include <zephyr/ztest.h>

#include <openthread/coap.h>

#include "common_fakes.h"

/* Message address used when testing serialization of a function that takes otMessage* */
#define MSG_ADDR UINT32_MAX

/* Longest possible CoAP URI */
#define URI	 STR_SEQUENCE(32)
#define CBOR_URI 0x78, 0x20, URI

/* Longest possible CoAP token */
#define TOKEN	   INT_SEQUENCE(OT_COAP_MAX_TOKEN_LENGTH)
#define CBOR_TOKEN 0x48, TOKEN

/* Fake functions */

FAKE_VALUE_FUNC(otMessage *, otCoapNewMessage, otInstance *, const otMessageSettings *);
FAKE_VOID_FUNC(otCoapMessageInit, otMessage *, otCoapType, otCoapCode);
FAKE_VALUE_FUNC(otError, otCoapMessageInitResponse, otMessage *, const otMessage *, otCoapType,
		otCoapCode);
FAKE_VALUE_FUNC(otError, otCoapMessageAppendUriPathOptions, otMessage *, const char *);
FAKE_VALUE_FUNC(otError, otCoapMessageSetPayloadMarker, otMessage *);
FAKE_VALUE_FUNC(otCoapType, otCoapMessageGetType, const otMessage *);
FAKE_VALUE_FUNC(otCoapCode, otCoapMessageGetCode, const otMessage *);
FAKE_VALUE_FUNC(uint16_t, otCoapMessageGetMessageId, const otMessage *);
FAKE_VALUE_FUNC(uint8_t, otCoapMessageGetTokenLength, const otMessage *);
FAKE_VALUE_FUNC(const uint8_t *, otCoapMessageGetToken, const otMessage *);
FAKE_VALUE_FUNC(otError, otCoapStart, otInstance *, uint16_t);
FAKE_VALUE_FUNC(otError, otCoapStop, otInstance *);
FAKE_VOID_FUNC(otCoapAddResource, otInstance *, otCoapResource *);
FAKE_VOID_FUNC(otCoapRemoveResource, otInstance *, otCoapResource *);
FAKE_VOID_FUNC(otCoapSetDefaultHandler, otInstance *, otCoapRequestHandler, void *)
FAKE_VALUE_FUNC(otError, otCoapSendRequestWithParameters, otInstance *, otMessage *,
		const otMessageInfo *, otCoapResponseHandler, void *, const otCoapTxParameters *);
FAKE_VALUE_FUNC(otError, otCoapSendResponseWithParameters, otInstance *, otMessage *,
		const otMessageInfo *, const otCoapTxParameters *);

#define FOREACH_FAKE(f)                                                                            \
	f(otMessageGetLength);                                                                     \
	f(otMessageGetOffset);                                                                     \
	f(otMessageRead);                                                                          \
	f(otMessageFree);                                                                          \
	f(otMessageAppend);                                                                        \
	f(otCoapNewMessage);                                                                       \
	f(otCoapMessageInit);                                                                      \
	f(otCoapMessageInitResponse);                                                              \
	f(otCoapMessageAppendUriPathOptions);                                                      \
	f(otCoapMessageSetPayloadMarker);                                                          \
	f(otCoapMessageGetType);                                                                   \
	f(otCoapMessageGetCode);                                                                   \
	f(otCoapMessageGetMessageId);                                                              \
	f(otCoapMessageGetTokenLength);                                                            \
	f(otCoapMessageGetToken);                                                                  \
	f(otCoapStart);                                                                            \
	f(otCoapStop);                                                                             \
	f(otCoapAddResource);                                                                      \
	f(otCoapRemoveResource);                                                                   \
	f(otCoapSetDefaultHandler);                                                                \
	f(otCoapSendRequestWithParameters);                                                        \
	f(otCoapSendResponseWithParameters);

static void nrf_rpc_err_handler(const struct nrf_rpc_err_report *report)
{
	zassert_ok(report->code);
}

static void tc_setup(void *f)
{
	mock_nrf_rpc_tr_expect_add(RPC_INIT_REQ, RPC_INIT_RSP);
	zassert_ok(nrf_rpc_init(nrf_rpc_err_handler));
	mock_nrf_rpc_tr_expect_reset();

	FOREACH_FAKE(RESET_FAKE);
	FFF_RESET_HISTORY();

	/* Unit tests take up to two message slots. */
	ot_res_tab_msg_free(1);
	ot_res_tab_msg_free(2);
}

/*
 * Test reception of otCoapNewMessage() command.
 * Test serialization of the result: NULL.
 */
ZTEST(ot_rpc_coap, test_otCoapNewMessage_0)
{
	otCoapNewMessage_fake.return_val = NULL;

	mock_nrf_rpc_tr_expect_add(RPC_RSP(0), NO_RSP);
	mock_nrf_rpc_tr_receive(
		RPC_CMD(OT_RPC_CMD_COAP_NEW_MESSAGE, CBOR_FALSE, OT_MESSAGE_PRIORITY_LOW));
	mock_nrf_rpc_tr_expect_done();

	zassert_equal(otCoapNewMessage_fake.call_count, 1);
}

/*
 * Test reception of otCoapNewMessage() command.
 * Test serialization of the result: 0xffffffff.
 */
ZTEST(ot_rpc_coap, test_otCoapNewMessage_max)
{
	otCoapNewMessage_fake.return_val = (otMessage *)UINT32_MAX;

	/* otCoapNewMessage() handler sends slot ID (1) instead of the actual message pointer */
	mock_nrf_rpc_tr_expect_add(RPC_RSP(1), NO_RSP);
	mock_nrf_rpc_tr_receive(
		RPC_CMD(OT_RPC_CMD_COAP_NEW_MESSAGE, CBOR_TRUE, OT_MESSAGE_PRIORITY_HIGH));
	mock_nrf_rpc_tr_expect_done();

	zassert_equal(otCoapNewMessage_fake.call_count, 1);
	zassert_not_null(ot_res_tab_msg_get(1));
}

/*
 * Test reception of otCoapMessageInit() command.
 */
ZTEST(ot_rpc_coap, test_otCoapMessageInit)
{
	ot_rpc_res_tab_key message_rep = ot_res_tab_msg_alloc((otMessage *)MSG_ADDR);

	mock_nrf_rpc_tr_expect_add(RPC_RSP(), NO_RSP);
	mock_nrf_rpc_tr_receive(RPC_CMD(OT_RPC_CMD_COAP_MESSAGE_INIT, message_rep,
					OT_COAP_TYPE_RESET,
					CBOR_UINT8(OT_COAP_CODE_PROXY_NOT_SUPPORTED)));
	mock_nrf_rpc_tr_expect_done();

	zassert_equal(otCoapMessageInit_fake.call_count, 1);
	zassert_equal(otCoapMessageInit_fake.arg0_val, (otMessage *)MSG_ADDR);
	zassert_equal(otCoapMessageInit_fake.arg1_val, OT_COAP_TYPE_RESET);
	zassert_equal(otCoapMessageInit_fake.arg2_val, OT_COAP_CODE_PROXY_NOT_SUPPORTED);
}

/*
 * Test reception of otCoapMessageInitResponse() command.
 * Test serialization of the result: OT_ERROR_INVALID_ARGS.
 */
ZTEST(ot_rpc_coap, test_otCoapMessageInitResponse)
{
	ot_rpc_res_tab_key response_rep = ot_res_tab_msg_alloc((otMessage *)MSG_ADDR);
	ot_rpc_res_tab_key request_rep = ot_res_tab_msg_alloc((otMessage *)(MSG_ADDR - 1));

	otCoapMessageInitResponse_fake.return_val = OT_ERROR_INVALID_ARGS;

	mock_nrf_rpc_tr_expect_add(RPC_RSP(OT_ERROR_INVALID_ARGS), NO_RSP);
	mock_nrf_rpc_tr_receive(RPC_CMD(OT_RPC_CMD_COAP_MESSAGE_INIT_RESPONSE, response_rep,
					request_rep, OT_COAP_TYPE_RESET,
					CBOR_UINT8(OT_COAP_CODE_PROXY_NOT_SUPPORTED)));
	mock_nrf_rpc_tr_expect_done();

	zassert_equal(otCoapMessageInitResponse_fake.call_count, 1);
	zassert_equal(otCoapMessageInitResponse_fake.arg0_val, (otMessage *)MSG_ADDR);
	zassert_equal(otCoapMessageInitResponse_fake.arg1_val, (otMessage *)(MSG_ADDR - 1));
	zassert_equal(otCoapMessageInitResponse_fake.arg2_val, OT_COAP_TYPE_RESET);
	zassert_equal(otCoapMessageInitResponse_fake.arg3_val, OT_COAP_CODE_PROXY_NOT_SUPPORTED);
}

/*
 * Test reception of otCoapMessageAppendUriPathOptions() command.
 * Test serialization of the result: OT_ERROR_INVALID_ARGS.
 */
otError append_uri_path_options_fake(otMessage *message, const char *uri_path)
{
	char uri[] = {URI, '\0'};

	zassert_equal(message, (otMessage *)MSG_ADDR);
	zassert_str_equal(uri_path, uri);

	return OT_ERROR_INVALID_ARGS;
}

ZTEST(ot_rpc_coap, test_otCoapMessageAppendUriPathOptions)
{
	ot_rpc_res_tab_key message_rep = ot_res_tab_msg_alloc((otMessage *)MSG_ADDR);

	otCoapMessageAppendUriPathOptions_fake.custom_fake = append_uri_path_options_fake;

	mock_nrf_rpc_tr_expect_add(RPC_RSP(OT_ERROR_INVALID_ARGS), NO_RSP);
	mock_nrf_rpc_tr_receive(
		RPC_CMD(OT_RPC_CMD_COAP_MESSAGE_APPEND_URI_PATH_OPTIONS, message_rep, CBOR_URI));
	mock_nrf_rpc_tr_expect_done();

	zassert_equal(otCoapMessageAppendUriPathOptions_fake.call_count, 1);
}

/*
 * Test reception of otCoapMessageSetPayloadMarker() command.
 * Test serialization of the result: OT_ERROR_INVALID_ARGS.
 */
ZTEST(ot_rpc_coap, test_otCoapMessageSetPayloadMarker)
{
	ot_rpc_res_tab_key message_rep = ot_res_tab_msg_alloc((otMessage *)MSG_ADDR);

	otCoapMessageSetPayloadMarker_fake.return_val = OT_ERROR_INVALID_ARGS;

	mock_nrf_rpc_tr_expect_add(RPC_RSP(OT_ERROR_INVALID_ARGS), NO_RSP);
	mock_nrf_rpc_tr_receive(RPC_CMD(OT_RPC_CMD_COAP_MESSAGE_SET_PAYLOAD_MARKER, message_rep));
	mock_nrf_rpc_tr_expect_done();

	zassert_equal(otCoapMessageSetPayloadMarker_fake.call_count, 1);
	zassert_equal(otCoapMessageSetPayloadMarker_fake.arg0_val, (otMessage *)MSG_ADDR);
}

/*
 * Test reception of otCoapMessageGetType() command.
 * Test serialization of the result: OT_COAP_TYPE_RESET.
 */
ZTEST(ot_rpc_coap, test_otCoapMessageGetType)
{
	ot_rpc_res_tab_key message_rep = ot_res_tab_msg_alloc((otMessage *)MSG_ADDR);

	otCoapMessageGetType_fake.return_val = OT_COAP_TYPE_RESET;

	mock_nrf_rpc_tr_expect_add(RPC_RSP(OT_COAP_TYPE_RESET), NO_RSP);
	mock_nrf_rpc_tr_receive(RPC_CMD(OT_RPC_CMD_COAP_MESSAGE_GET_TYPE, message_rep));
	mock_nrf_rpc_tr_expect_done();

	zassert_equal(otCoapMessageGetType_fake.call_count, 1);
	zassert_equal(otCoapMessageGetType_fake.arg0_val, (otMessage *)MSG_ADDR);
}

/*
 * Test reception of otCoapMessageGetCode() command.
 * Test serialization of the result: OT_COAP_TYPE_RESET.
 */
ZTEST(ot_rpc_coap, test_otCoapMessageGetCode)
{
	ot_rpc_res_tab_key message_rep = ot_res_tab_msg_alloc((otMessage *)MSG_ADDR);

	otCoapMessageGetCode_fake.return_val = OT_COAP_CODE_PROXY_NOT_SUPPORTED;

	mock_nrf_rpc_tr_expect_add(RPC_RSP(CBOR_UINT8(OT_COAP_CODE_PROXY_NOT_SUPPORTED)), NO_RSP);
	mock_nrf_rpc_tr_receive(RPC_CMD(OT_RPC_CMD_COAP_MESSAGE_GET_CODE, message_rep));
	mock_nrf_rpc_tr_expect_done();

	zassert_equal(otCoapMessageGetCode_fake.call_count, 1);
	zassert_equal(otCoapMessageGetCode_fake.arg0_val, (otMessage *)MSG_ADDR);
}

/*
 * Test reception of otCoapMessageGetMessageId() command.
 * Test serialization of the result: 0xffff.
 */
ZTEST(ot_rpc_coap, test_otCoapMessageGetMessageId)
{
	ot_rpc_res_tab_key message_rep = ot_res_tab_msg_alloc((otMessage *)MSG_ADDR);

	otCoapMessageGetMessageId_fake.return_val = UINT16_MAX;

	mock_nrf_rpc_tr_expect_add(RPC_RSP(CBOR_UINT16(UINT16_MAX)), NO_RSP);
	mock_nrf_rpc_tr_receive(RPC_CMD(OT_RPC_CMD_COAP_MESSAGE_GET_MESSAGE_ID, message_rep));
	mock_nrf_rpc_tr_expect_done();

	zassert_equal(otCoapMessageGetMessageId_fake.call_count, 1);
	zassert_equal(otCoapMessageGetMessageId_fake.arg0_val, (otMessage *)MSG_ADDR);
}

/*
 * Test reception of otCoapMessageGetTokenLength() command.
 * Test serialization of the result: OT_COAP_MAX_TOKEN_LENGTH.
 */
ZTEST(ot_rpc_coap, test_otCoapMessageGetTokenLength)
{
	ot_rpc_res_tab_key message_rep = ot_res_tab_msg_alloc((otMessage *)MSG_ADDR);

	otCoapMessageGetTokenLength_fake.return_val = OT_COAP_MAX_TOKEN_LENGTH;

	mock_nrf_rpc_tr_expect_add(RPC_RSP(OT_COAP_MAX_TOKEN_LENGTH), NO_RSP);
	mock_nrf_rpc_tr_receive(RPC_CMD(OT_RPC_CMD_COAP_MESSAGE_GET_TOKEN_LENGTH, message_rep));
	mock_nrf_rpc_tr_expect_done();

	zassert_equal(otCoapMessageGetTokenLength_fake.call_count, 1);
	zassert_equal(otCoapMessageGetTokenLength_fake.arg0_val, (otMessage *)MSG_ADDR);
}

/*
 * Test reception of otCoapMessageGetToken() command.
 * Test serialization of the result of length OT_COAP_MAX_TOKEN_LENGTH.
 */
ZTEST(ot_rpc_coap, test_otCoapMessageGetToken)
{
	ot_rpc_res_tab_key message_rep = ot_res_tab_msg_alloc((otMessage *)MSG_ADDR);
	uint8_t token[] = {TOKEN};

	otCoapMessageGetToken_fake.return_val = token;
	otCoapMessageGetTokenLength_fake.return_val = OT_COAP_MAX_TOKEN_LENGTH;

	mock_nrf_rpc_tr_expect_add(RPC_RSP(CBOR_TOKEN), NO_RSP);
	mock_nrf_rpc_tr_receive(RPC_CMD(OT_RPC_CMD_COAP_MESSAGE_GET_TOKEN, message_rep));
	mock_nrf_rpc_tr_expect_done();

	zassert_equal(otCoapMessageGetToken_fake.call_count, 1);
	zassert_equal(otCoapMessageGetToken_fake.arg0_val, (otMessage *)MSG_ADDR);
}

/*
 * Test reception of otCoapStart() command.
 * Test serialization of the result: OT_ERROR_INVALID_ARGS.
 */
ZTEST(ot_rpc_coap, test_otCoapStart)
{
	otCoapStart_fake.return_val = OT_ERROR_INVALID_ARGS;

	mock_nrf_rpc_tr_expect_add(RPC_RSP(OT_ERROR_INVALID_ARGS), NO_RSP);
	mock_nrf_rpc_tr_receive(RPC_CMD(OT_RPC_CMD_COAP_START, CBOR_UINT16(UINT16_MAX)));
	mock_nrf_rpc_tr_expect_done();

	zassert_equal(otCoapStart_fake.call_count, 1);
	zassert_equal(otCoapStart_fake.arg1_val, UINT16_MAX);
}

/*
 * Test reception of otCoapStop() command.
 * Test serialization of the result: OT_ERROR_INVALID_ARGS.
 */
ZTEST(ot_rpc_coap, test_otCoapStop)
{
	otCoapStop_fake.return_val = OT_ERROR_INVALID_ARGS;

	mock_nrf_rpc_tr_expect_add(RPC_RSP(OT_ERROR_INVALID_ARGS), NO_RSP);
	mock_nrf_rpc_tr_receive(RPC_CMD(OT_RPC_CMD_COAP_STOP));
	mock_nrf_rpc_tr_expect_done();

	zassert_equal(otCoapStop_fake.call_count, 1);
}

static void otCoapAddResource_custom_func(otInstance *instance, otCoapResource *resource)
{
	char uri[] = {URI, '\0'};

	zassert_not_null(resource);
	zexpect_str_equal(resource->mUriPath, uri);
}

static void otCoapRemoveResource_custom_func(otInstance *instance, otCoapResource *resource)
{
	char uri[] = {URI, '\0'};

	zassert_not_null(resource);
	zexpect_str_equal(resource->mUriPath, uri);
}

/*
 * Test reception of otCoapAddResource() and otCoapRemoveResource() commands.
 */
ZTEST(ot_rpc_coap, test_otCoapAddResource_otCoapRemoveResource)
{
	/*
	 * Message key is allocated by the resource handler encoder function but we know that
	 * the first free slot will be selected so it will be 1.
	 */
	ot_rpc_res_tab_key message_rep = 1;
	otMessageInfo message_info = {
		.mSockAddr = {.mFields.m8 = {ADDR_1}},
		.mPeerAddr = {.mFields.m8 = {ADDR_2}},
		.mSockPort = PORT_1,
		.mPeerPort = PORT_2,
		.mHopLimit = HOP_LIMIT,
		.mEcn = 3,
		.mIsHostInterface = true,
		.mAllowZeroHopLimit = true,
		.mMulticastLoop = true,
	};

	/* Test reception of otCoapAddResource() */
	otCoapAddResource_fake.custom_fake = otCoapAddResource_custom_func;

	mock_nrf_rpc_tr_expect_add(RPC_RSP(), NO_RSP);
	mock_nrf_rpc_tr_receive(RPC_CMD(OT_RPC_CMD_COAP_ADD_RESOURCE, CBOR_URI));
	mock_nrf_rpc_tr_expect_done();

	zassert_equal(otCoapAddResource_fake.call_count, 1);

	/* Test serialization of the resource handler call */
	mock_nrf_rpc_tr_expect_add(
		RPC_CMD(OT_RPC_CMD_COAP_RESOURCE_HANDLER, CBOR_URI, message_rep, CBOR_MSG_INFO),
		RPC_RSP());
	ot_rpc_mutex_lock();
	otCoapAddResource_fake.arg1_val->mHandler(otCoapAddResource_fake.arg1_val->mContext,
						  (otMessage *)MSG_ADDR, &message_info);
	ot_rpc_mutex_unlock();
	mock_nrf_rpc_tr_expect_done();
	zassert_is_null(ot_res_tab_msg_get(message_rep));

	/* Test reception of otCoapRemoveResource() */
	otCoapRemoveResource_fake.custom_fake = otCoapRemoveResource_custom_func;

	mock_nrf_rpc_tr_expect_add(RPC_RSP(), NO_RSP);
	mock_nrf_rpc_tr_receive(RPC_CMD(OT_RPC_CMD_COAP_REMOVE_RESOURCE, CBOR_URI));
	mock_nrf_rpc_tr_expect_done();

	zassert_equal(otCoapRemoveResource_fake.call_count, 1);
}

/*
 * Test reception of otCoapSetDefaultHandler() command.
 */
ZTEST(ot_rpc_coap, test_otCoapSetDefaultHandler)
{
	/*
	 * Message key is allocated by the default handler encoder function but we know that
	 * the first free slot will be selected so it will be 1.
	 */
	ot_rpc_res_tab_key message_rep = 1;
	otMessageInfo message_info = {
		.mSockAddr = {.mFields.m8 = {ADDR_1}},
		.mPeerAddr = {.mFields.m8 = {ADDR_2}},
		.mSockPort = PORT_1,
		.mPeerPort = PORT_2,
		.mHopLimit = HOP_LIMIT,
		.mEcn = 3,
		.mIsHostInterface = true,
		.mAllowZeroHopLimit = true,
		.mMulticastLoop = true,
	};

	/* Test reception of otCoapSetDefaultHandler() command that sets the default handler */
	mock_nrf_rpc_tr_expect_add(RPC_RSP(), NO_RSP);
	mock_nrf_rpc_tr_receive(RPC_CMD(OT_RPC_CMD_COAP_SET_DEFAULT_HANDLER, CBOR_TRUE));
	mock_nrf_rpc_tr_expect_done();

	zassert_equal(otCoapSetDefaultHandler_fake.call_count, 1);
	zassert_not_null(otCoapSetDefaultHandler_fake.arg1_val);

	/* Test serialization of the default handler call */
	mock_nrf_rpc_tr_expect_add(
		RPC_CMD(OT_RPC_CMD_COAP_DEFAULT_HANDLER, message_rep, CBOR_MSG_INFO), RPC_RSP());
	ot_rpc_mutex_lock();
	otCoapSetDefaultHandler_fake.arg1_val(otCoapSetDefaultHandler_fake.arg2_val,
					      (otMessage *)MSG_ADDR, &message_info);
	ot_rpc_mutex_unlock();
	mock_nrf_rpc_tr_expect_done();
	zassert_is_null(ot_res_tab_msg_get(message_rep));

	/* Test reception of otCoapSetDefaultHandler() command that unsets the default handler */
	RESET_FAKE(otCoapSetDefaultHandler);

	mock_nrf_rpc_tr_expect_add(RPC_RSP(), NO_RSP);
	mock_nrf_rpc_tr_receive(RPC_CMD(OT_RPC_CMD_COAP_SET_DEFAULT_HANDLER, CBOR_FALSE));
	mock_nrf_rpc_tr_expect_done();

	zassert_equal(otCoapSetDefaultHandler_fake.call_count, 1);
	zassert_is_null(otCoapSetDefaultHandler_fake.arg1_val);
}

/*
 * Test reception of otCoapSendRequest().
 * Test serialization of the result: OT_ERROR_NONE.
 * Test response handler invocation.
 */
ZTEST(ot_rpc_coap, test_otCoapSendRequest)
{
	ot_rpc_coap_request_key request_rep = 3;
	ot_rpc_res_tab_key message_rep = ot_res_tab_msg_alloc((otMessage *)MSG_ADDR);
	/*
	 * The request message slot is freed when otCoapSendRequest() succeeds,
	 * so we know that the same slot will be used to relay the response message.
	 */
	ot_rpc_res_tab_key response_rep = message_rep;
	otMessageInfo message_info = {
		.mSockAddr = {.mFields.m8 = {ADDR_1}},
		.mPeerAddr = {.mFields.m8 = {ADDR_2}},
		.mSockPort = PORT_1,
		.mPeerPort = PORT_2,
		.mHopLimit = HOP_LIMIT,
		.mEcn = 3,
		.mIsHostInterface = true,
		.mAllowZeroHopLimit = true,
		.mMulticastLoop = true,
	};

	otCoapSendRequestWithParameters_fake.return_val = OT_ERROR_NONE;

	mock_nrf_rpc_tr_expect_add(RPC_RSP(OT_ERROR_NONE), NO_RSP);
	mock_nrf_rpc_tr_receive(
		RPC_CMD(OT_RPC_CMD_COAP_SEND_REQUEST, message_rep, CBOR_MSG_INFO, request_rep));
	mock_nrf_rpc_tr_expect_done();

	zassert_equal(otCoapSendRequestWithParameters_fake.call_count, 1);
	zexpect_equal(otCoapSendRequestWithParameters_fake.arg1_val, (otMessage *)MSG_ADDR);
	zexpect_not_null(otCoapSendRequestWithParameters_fake.arg2_val);
	zexpect_not_null(otCoapSendRequestWithParameters_fake.arg3_val);

	/* Test serialization of the response handler call */
	mock_nrf_rpc_tr_expect_add(RPC_CMD(OT_RPC_CMD_COAP_RESPONSE_HANDLER, request_rep,
					   response_rep, CBOR_MSG_INFO, OT_ERROR_PARSE),
				   RPC_RSP());
	ot_rpc_mutex_lock();
	otCoapSendRequestWithParameters_fake.arg3_val(otCoapSendRequestWithParameters_fake.arg4_val,
						      (otMessage *)MSG_ADDR, &message_info,
						      OT_ERROR_PARSE);
	ot_rpc_mutex_unlock();
	mock_nrf_rpc_tr_expect_done();
}

/*
 * Test reception of otCoapSendRequest().
 * Test serialization of the result: OT_ERROR_INVALID_STATE.
 * Test that the message handle has not been released on failure.
 */
ZTEST(ot_rpc_coap, test_otCoapSendRequest_failed)
{
	ot_rpc_coap_request_key request_rep = 3;
	ot_rpc_res_tab_key message_rep = ot_res_tab_msg_alloc((otMessage *)MSG_ADDR);

	otCoapSendRequestWithParameters_fake.return_val = OT_ERROR_INVALID_STATE;

	mock_nrf_rpc_tr_expect_add(RPC_RSP(OT_ERROR_INVALID_STATE), NO_RSP);
	mock_nrf_rpc_tr_receive(
		RPC_CMD(OT_RPC_CMD_COAP_SEND_REQUEST, message_rep, CBOR_MSG_INFO, request_rep));
	mock_nrf_rpc_tr_expect_done();

	zassert_equal(otCoapSendRequestWithParameters_fake.call_count, 1);
	zexpect_equal(otCoapSendRequestWithParameters_fake.arg1_val, (otMessage *)MSG_ADDR);
	zexpect_not_null(otCoapSendRequestWithParameters_fake.arg2_val);
	zexpect_not_null(otCoapSendRequestWithParameters_fake.arg3_val);
	zassert_not_null(ot_res_tab_msg_get(message_rep));
}

/*
 * Test reception of otCoapSendResponse().
 * Test serialization of the result: OT_ERROR_NONE.
 * Test that the response message handle has been released on success.
 */
ZTEST(ot_rpc_coap, test_otCoapSendResponse)
{
	ot_rpc_res_tab_key message_rep = ot_res_tab_msg_alloc((otMessage *)MSG_ADDR);

	otCoapSendResponseWithParameters_fake.return_val = OT_ERROR_NONE;

	mock_nrf_rpc_tr_expect_add(RPC_RSP(OT_ERROR_NONE), NO_RSP);
	mock_nrf_rpc_tr_receive(RPC_CMD(OT_RPC_CMD_COAP_SEND_RESPONSE, message_rep, CBOR_MSG_INFO));
	mock_nrf_rpc_tr_expect_done();

	zassert_equal(otCoapSendResponseWithParameters_fake.call_count, 1);
	zexpect_equal(otCoapSendResponseWithParameters_fake.arg1_val, (otMessage *)MSG_ADDR);
	zexpect_not_null(otCoapSendResponseWithParameters_fake.arg2_val);
	zassert_is_null(ot_res_tab_msg_get(message_rep));
}

/*
 * Test reception of otCoapSendResponse().
 * Test serialization of the result: OT_ERROR_INVALID_STATE.
 * Test that the response message handle hasn't been released on failure.
 */
ZTEST(ot_rpc_coap, test_otCoapSendResponse_failed)
{
	ot_rpc_res_tab_key message_rep = ot_res_tab_msg_alloc((otMessage *)MSG_ADDR);

	otCoapSendResponseWithParameters_fake.return_val = OT_ERROR_INVALID_STATE;

	mock_nrf_rpc_tr_expect_add(RPC_RSP(OT_ERROR_INVALID_STATE), NO_RSP);
	mock_nrf_rpc_tr_receive(RPC_CMD(OT_RPC_CMD_COAP_SEND_RESPONSE, message_rep, CBOR_MSG_INFO));
	mock_nrf_rpc_tr_expect_done();

	zassert_equal(otCoapSendResponseWithParameters_fake.call_count, 1);
	zexpect_equal(otCoapSendResponseWithParameters_fake.arg1_val, (otMessage *)MSG_ADDR);
	zexpect_not_null(otCoapSendResponseWithParameters_fake.arg2_val);
	zassert_not_null(ot_res_tab_msg_get(message_rep));
}

ZTEST_SUITE(ot_rpc_coap, NULL, NULL, tc_setup, NULL, NULL);
```

## src/common_fakes.c
```c
/*
 * Copyright (c) 2024 Nordic Semiconductor ASA
 *
 * SPDX-License-Identifier: LicenseRef-Nordic-5-Clause
 */

#include "common_fakes.h"

DEFINE_FAKE_VALUE_FUNC(uint16_t, otMessageGetLength, const otMessage *);
DEFINE_FAKE_VALUE_FUNC(uint16_t, otMessageGetOffset, const otMessage *);
DEFINE_FAKE_VALUE_FUNC(otError, otMessageGetThreadLinkInfo, const otMessage *, otThreadLinkInfo *);
DEFINE_FAKE_VALUE_FUNC(uint16_t, otMessageRead, const otMessage *, uint16_t, void *, uint16_t);
DEFINE_FAKE_VOID_FUNC(otMessageFree, otMessage *);
DEFINE_FAKE_VALUE_FUNC(otError, otMessageAppend, otMessage *, const void *, uint16_t);
DEFINE_FAKE_VALUE_FUNC(otMessage *, otUdpNewMessage, otInstance *, const otMessageSettings *);
DEFINE_FAKE_VALUE_FUNC(void *, nrf_rpc_cbkproxy_out_get, int, void *);
```

## src/common_fakes.h
```c
/*
 * Copyright (c) 2024 Nordic Semiconductor ASA
 *
 * SPDX-License-Identifier: LicenseRef-Nordic-5-Clause
 */

#ifndef __COMMON_FAKES_H__
#define __COMMON_FAKES_H__
#include <zephyr/fff.h>
#include <openthread/message.h>

DECLARE_FAKE_VALUE_FUNC(otMessage *, otUdpNewMessage, otInstance *, const otMessageSettings *);
DECLARE_FAKE_VALUE_FUNC(uint16_t, otMessageGetLength, const otMessage *);
DECLARE_FAKE_VALUE_FUNC(uint16_t, otMessageGetOffset, const otMessage *);
DECLARE_FAKE_VALUE_FUNC(otError, otMessageGetThreadLinkInfo, const otMessage *, otThreadLinkInfo *);
DECLARE_FAKE_VALUE_FUNC(uint16_t, otMessageRead, const otMessage *, uint16_t, void *, uint16_t);
DECLARE_FAKE_VOID_FUNC(otMessageFree, otMessage *);
DECLARE_FAKE_VALUE_FUNC(otError, otMessageAppend, otMessage *, const void *, uint16_t);
DECLARE_FAKE_VALUE_FUNC(void *, nrf_rpc_cbkproxy_out_get, int, void *);

#endif
```

## src/dataset_suite.c
```c
/*
 * Copyright (c) 2024 Nordic Semiconductor ASA
 *
 * SPDX-License-Identifier: LicenseRef-Nordic-5-Clause
 */

#include <mock_nrf_rpc_transport.h>
#include <ot_rpc_ids.h>
#include <test_rpc_env.h>

#include <zephyr/fff.h>
#include <zephyr/ztest.h>
#include <zephyr/kernel.h>

#include <openthread/dataset.h>

/* Fake functions */
FAKE_VALUE_FUNC(bool, otDatasetIsCommissioned, otInstance *);
FAKE_VALUE_FUNC(otError, otDatasetSetActiveTlvs, otInstance *, const otOperationalDatasetTlvs *);
FAKE_VALUE_FUNC(otError, otDatasetGetActiveTlvs, otInstance *, otOperationalDatasetTlvs *);
FAKE_VALUE_FUNC(otError, otDatasetSetActive, otInstance *, const otOperationalDataset *);
FAKE_VALUE_FUNC(otError, otDatasetGetActive, otInstance *, otOperationalDataset *);
FAKE_VALUE_FUNC(otError, otDatasetSetPendingTlvs, otInstance *, const otOperationalDatasetTlvs *);
FAKE_VALUE_FUNC(otError, otDatasetGetPendingTlvs, otInstance *, otOperationalDatasetTlvs *);
FAKE_VALUE_FUNC(otError, otDatasetSetPending, otInstance *, const otOperationalDataset *);
FAKE_VALUE_FUNC(otError, otDatasetGetPending, otInstance *, otOperationalDataset *);

#define FOREACH_FAKE(f)                                                                            \
	f(otDatasetIsCommissioned);                                                                \
	f(otDatasetSetActiveTlvs);                                                                 \
	f(otDatasetGetActiveTlvs);                                                                 \
	f(otDatasetSetActive);                                                                     \
	f(otDatasetGetActive);                                                                     \
	f(otDatasetSetPendingTlvs);                                                                \
	f(otDatasetGetPendingTlvs);                                                                \
	f(otDatasetSetPending);                                                                    \
	f(otDatasetGetPending);

static void nrf_rpc_err_handler(const struct nrf_rpc_err_report *report)
{
	zassert_ok(report->code);
}

static void tc_setup(void *f)
{
	mock_nrf_rpc_tr_expect_add(RPC_INIT_REQ, RPC_INIT_RSP);
	zassert_ok(nrf_rpc_init(nrf_rpc_err_handler));
	mock_nrf_rpc_tr_expect_reset();

	FOREACH_FAKE(RESET_FAKE);
	FFF_RESET_HISTORY();
}

/*
 * Test reception of otDatasetIsCommissioned command.
 * Test serialization of the result: true or false.
 */
ZTEST(ot_rpc_dataset, test_otDatasetIsCommissioned)
{
	otDatasetIsCommissioned_fake.return_val = true;

	mock_nrf_rpc_tr_expect_add(RPC_RSP(CBOR_TRUE), NO_RSP);
	mock_nrf_rpc_tr_receive(RPC_CMD(OT_RPC_CMD_DATASET_IS_COMMISSIONED));
	mock_nrf_rpc_tr_expect_done();

	zassert_equal(otDatasetIsCommissioned_fake.call_count, 1);

	otDatasetIsCommissioned_fake.return_val = false;

	mock_nrf_rpc_tr_expect_add(RPC_RSP(CBOR_FALSE), NO_RSP);
	mock_nrf_rpc_tr_receive(RPC_CMD(OT_RPC_CMD_DATASET_IS_COMMISSIONED));
	mock_nrf_rpc_tr_expect_done();

	zassert_equal(otDatasetIsCommissioned_fake.call_count, 2);
}

static otError dataset_tlvs_set_fake(otInstance *instance, const otOperationalDatasetTlvs *dataset)
{
	const otOperationalDatasetTlvs expected_dataset = {
		{INT_SEQUENCE(OT_OPERATIONAL_DATASET_MAX_LENGTH)},
		OT_OPERATIONAL_DATASET_MAX_LENGTH};

	zassert_mem_equal(dataset, &expected_dataset, sizeof(otOperationalDatasetTlvs));

	return OT_ERROR_NONE;
}

/*
 * Test reception of otDatasetSetActiveTlvs command.
 * Test serialization of the result: OT_ERROR_NONE.
 */
ZTEST(ot_rpc_dataset, test_otDatasetSetActiveTlvs)
{
	otDatasetSetActiveTlvs_fake.custom_fake = dataset_tlvs_set_fake;

	mock_nrf_rpc_tr_expect_add(RPC_RSP(OT_ERROR_NONE), NO_RSP);
	mock_nrf_rpc_tr_receive(RPC_CMD(OT_RPC_CMD_DATASET_SET_ACTIVE_TLVS, TLVS));
	mock_nrf_rpc_tr_expect_done();

	zassert_equal(otDatasetSetActiveTlvs_fake.call_count, 1);
}

/*
 * Test reception of otDatasetSetPendingTlvs command.
 * Test serialization of the result: OT_ERROR_NONE.
 */
ZTEST(ot_rpc_dataset, test_otDatasetSetPendingTlvs)
{
	otDatasetSetPendingTlvs_fake.custom_fake = dataset_tlvs_set_fake;

	mock_nrf_rpc_tr_expect_add(RPC_RSP(OT_ERROR_NONE), NO_RSP);
	mock_nrf_rpc_tr_receive(RPC_CMD(OT_RPC_CMD_DATASET_SET_PENDING_TLVS, TLVS));
	mock_nrf_rpc_tr_expect_done();

	zassert_equal(otDatasetSetPendingTlvs_fake.call_count, 1);
}

/*
 * Test reception of otDatasetSetActiveTlvs command with NULL pointer.
 * Test serialization of the result: OT_ERROR_INVALID_ARGS.
 */
ZTEST(ot_rpc_dataset, test_otDatasetSetActiveTlvs_negative)
{
	mock_nrf_rpc_tr_expect_add(RPC_RSP(OT_ERROR_INVALID_ARGS), NO_RSP);
	mock_nrf_rpc_tr_receive(RPC_CMD(OT_RPC_CMD_DATASET_SET_ACTIVE_TLVS, CBOR_NULL));
	mock_nrf_rpc_tr_expect_done();

	zassert_equal(otDatasetSetActiveTlvs_fake.call_count, 0);
}

/*
 * Test reception of otDatasetSetPendingTlvs command with NULL pointer.
 * Test serialization of the result: OT_ERROR_INVALID_ARGS.
 */
ZTEST(ot_rpc_dataset, test_otDatasetSetPendingTlvs_negative)
{
	mock_nrf_rpc_tr_expect_add(RPC_RSP(OT_ERROR_INVALID_ARGS), NO_RSP);
	mock_nrf_rpc_tr_receive(RPC_CMD(OT_RPC_CMD_DATASET_SET_PENDING_TLVS, CBOR_NULL));
	mock_nrf_rpc_tr_expect_done();

	zassert_equal(otDatasetSetPendingTlvs_fake.call_count, 0);
}

static otError dataset_get_tlvs_fake(otInstance *instance, otOperationalDatasetTlvs *dataset)
{
	otOperationalDatasetTlvs expected_dataset = {
		{INT_SEQUENCE(OT_OPERATIONAL_DATASET_MAX_LENGTH)},
		OT_OPERATIONAL_DATASET_MAX_LENGTH};

	memcpy(dataset, &expected_dataset, sizeof(otOperationalDatasetTlvs));

	return OT_ERROR_NONE;
}

/*
 * Test reception of otDatasetGetActiveTlvs command.
 * Test serialization of the result: TLVS data.
 */
ZTEST(ot_rpc_dataset, test_otDatasetGetActiveTlvs)
{
	otDatasetGetActiveTlvs_fake.custom_fake = dataset_get_tlvs_fake;

	mock_nrf_rpc_tr_expect_add(RPC_RSP(TLVS), NO_RSP);
	mock_nrf_rpc_tr_receive(RPC_CMD(OT_RPC_CMD_DATASET_GET_ACTIVE_TLVS));
	mock_nrf_rpc_tr_expect_done();

	zassert_equal(otDatasetGetActiveTlvs_fake.call_count, 1);
}

/*
 * Test reception of otDatasetGetPendingTlvs command.
 * Test serialization of the result: TLVS data.
 */
ZTEST(ot_rpc_dataset, test_otDatasetGetPendingTlvs)
{
	otDatasetGetPendingTlvs_fake.custom_fake = dataset_get_tlvs_fake;

	mock_nrf_rpc_tr_expect_add(RPC_RSP(TLVS), NO_RSP);
	mock_nrf_rpc_tr_receive(RPC_CMD(OT_RPC_CMD_DATASET_GET_PENDING_TLVS));
	mock_nrf_rpc_tr_expect_done();

	zassert_equal(otDatasetGetPendingTlvs_fake.call_count, 1);
}

/*
 * Test reception of otDatasetGetActiveTlvs command.
 * Test serialization of the result: NULL as tlvs data has not been found.
 */
ZTEST(ot_rpc_dataset, test_otDatasetGetActiveTlvs_null)
{
	otDatasetGetActiveTlvs_fake.return_val = OT_ERROR_NOT_FOUND;

	mock_nrf_rpc_tr_expect_add(RPC_RSP(CBOR_NULL), NO_RSP);
	mock_nrf_rpc_tr_receive(RPC_CMD(OT_RPC_CMD_DATASET_GET_ACTIVE_TLVS));
	mock_nrf_rpc_tr_expect_done();

	zassert_equal(otDatasetGetActiveTlvs_fake.call_count, 1);
}

/*
 * Test reception of otDatasetGetPendingTlvs command.
 * Test serialization of the result: NULL as tlvs data has not been found.
 */
ZTEST(ot_rpc_dataset, test_otDatasetGetPendingTlvs_null)
{
	otDatasetGetPendingTlvs_fake.return_val = OT_ERROR_NOT_FOUND;

	mock_nrf_rpc_tr_expect_add(RPC_RSP(CBOR_NULL), NO_RSP);
	mock_nrf_rpc_tr_receive(RPC_CMD(OT_RPC_CMD_DATASET_GET_PENDING_TLVS));
	mock_nrf_rpc_tr_expect_done();

	zassert_equal(otDatasetGetPendingTlvs_fake.call_count, 1);
}

static otError dataset_set_fake(otInstance *instance, const otOperationalDataset *dataset)
{
	uint8_t net_key[] = {INT_SEQUENCE(OT_NETWORK_KEY_SIZE)};
	uint8_t nwk_name[] = {INT_SEQUENCE(OT_NETWORK_NAME_MAX_SIZE), 0};
	uint8_t ext_pan_id[] = {INT_SEQUENCE(OT_EXT_PAN_ID_SIZE)};
	uint8_t local_prefix[] = {INT_SEQUENCE(OT_IP6_PREFIX_SIZE)};
	uint8_t pskc[] = {INT_SEQUENCE(OT_PSKC_MAX_SIZE)};

	zassert_equal(dataset->mActiveTimestamp.mSeconds, 0x0123456789abcdefull);
	zassert_equal(dataset->mActiveTimestamp.mTicks, 0x1234);
	zassert_false(dataset->mActiveTimestamp.mAuthoritative);

	zassert_equal(dataset->mPendingTimestamp.mSeconds, 0x0123456789abcdefull);
	zassert_equal(dataset->mPendingTimestamp.mTicks, 0x1234);
	zassert_false(dataset->mPendingTimestamp.mAuthoritative);

	zassert_mem_equal(dataset->mNetworkKey.m8, net_key, OT_NETWORK_KEY_SIZE);
	zassert_mem_equal(dataset->mNetworkName.m8, nwk_name, OT_NETWORK_NAME_MAX_SIZE + 1);
	zassert_mem_equal(dataset->mExtendedPanId.m8, ext_pan_id, OT_EXT_PAN_ID_SIZE);
	zassert_mem_equal(dataset->mMeshLocalPrefix.m8, local_prefix, OT_IP6_PREFIX_SIZE);
	zassert_equal(dataset->mDelay, 0x12345678ul);
	zassert_equal(dataset->mPanId, 0xabcd);
	zassert_equal(dataset->mChannel, 0xef67);
	zassert_mem_equal(dataset->mPskc.m8, pskc, OT_PSKC_MAX_SIZE);

	zassert_equal(dataset->mSecurityPolicy.mRotationTime, 0x9876);
	zassert_true(!!dataset->mSecurityPolicy.mObtainNetworkKeyEnabled);
	zassert_false(!!dataset->mSecurityPolicy.mNativeCommissioningEnabled);
	zassert_true(!!dataset->mSecurityPolicy.mRoutersEnabled);
	zassert_false(!!dataset->mSecurityPolicy.mExternalCommissioningEnabled);
	zassert_true(!!dataset->mSecurityPolicy.mCommercialCommissioningEnabled);
	zassert_false(!!dataset->mSecurityPolicy.mAutonomousEnrollmentEnabled);
	zassert_true(!!dataset->mSecurityPolicy.mNetworkKeyProvisioningEnabled);
	zassert_false(!!dataset->mSecurityPolicy.mTobleLinkEnabled);
	zassert_true(!!dataset->mSecurityPolicy.mNonCcmRoutersEnabled);
	zassert_equal(dataset->mSecurityPolicy.mVersionThresholdForRouting, 7);

	zassert_equal(dataset->mChannelMask, 0xfedcba98ul);

	zassert_false(dataset->mComponents.mIsActiveTimestampPresent);
	zassert_true(dataset->mComponents.mIsPendingTimestampPresent);
	zassert_false(dataset->mComponents.mIsNetworkKeyPresent);
	zassert_true(dataset->mComponents.mIsNetworkNamePresent);
	zassert_false(dataset->mComponents.mIsExtendedPanIdPresent);
	zassert_true(dataset->mComponents.mIsMeshLocalPrefixPresent);
	zassert_false(dataset->mComponents.mIsDelayPresent);
	zassert_true(dataset->mComponents.mIsPanIdPresent);
	zassert_false(dataset->mComponents.mIsChannelPresent);
	zassert_true(dataset->mComponents.mIsPskcPresent);
	zassert_false(dataset->mComponents.mIsSecurityPolicyPresent);
	zassert_true(dataset->mComponents.mIsChannelMaskPresent);

	return OT_ERROR_NONE;
}

/*
 * Test reception of otDatasetSetActive command.
 * Test serialization of the result: OT_ERROR_NONE.
 */
ZTEST(ot_rpc_dataset, test_otDatasetSetActive)
{
	otDatasetSetActive_fake.custom_fake = dataset_set_fake;

	mock_nrf_rpc_tr_expect_add(RPC_RSP(OT_ERROR_NONE), NO_RSP);
	mock_nrf_rpc_tr_receive(RPC_CMD(OT_RPC_CMD_DATASET_SET_ACTIVE, DATASET));
	mock_nrf_rpc_tr_expect_done();

	zassert_equal(otDatasetSetActive_fake.call_count, 1);
}

/*
 * Test reception of otDatasetSetPending command.
 * Test serialization of the result: OT_ERROR_NONE.
 */
ZTEST(ot_rpc_dataset, test_otDatasetSetPending)
{
	otDatasetSetPending_fake.custom_fake = dataset_set_fake;

	mock_nrf_rpc_tr_expect_add(RPC_RSP(OT_ERROR_NONE), NO_RSP);
	mock_nrf_rpc_tr_receive(RPC_CMD(OT_RPC_CMD_DATASET_SET_PENDING, DATASET));
	mock_nrf_rpc_tr_expect_done();

	zassert_equal(otDatasetSetPending_fake.call_count, 1);
}

/*
 * Test reception of otDatasetSetActive command with NULL pointer.
 * Test serialization of the result: OT_ERROR_INVALID_ARGS.
 */
ZTEST(ot_rpc_dataset, test_otDatasetSetActive_negative)
{
	mock_nrf_rpc_tr_expect_add(RPC_RSP(OT_ERROR_INVALID_ARGS), NO_RSP);
	mock_nrf_rpc_tr_receive(RPC_CMD(OT_RPC_CMD_DATASET_SET_ACTIVE, CBOR_NULL));
	mock_nrf_rpc_tr_expect_done();

	zassert_equal(otDatasetSetActive_fake.call_count, 0);
}

/*
 * Test reception of otDatasetSetPending command with NULL pointer.
 * Test serialization of the result: OT_ERROR_INVALID_ARGS.
 */
ZTEST(ot_rpc_dataset, test_otDatasetSetPending_negative)
{
	mock_nrf_rpc_tr_expect_add(RPC_RSP(OT_ERROR_INVALID_ARGS), NO_RSP);
	mock_nrf_rpc_tr_receive(RPC_CMD(OT_RPC_CMD_DATASET_SET_PENDING, CBOR_NULL));
	mock_nrf_rpc_tr_expect_done();

	zassert_equal(otDatasetSetPending_fake.call_count, 0);
}

static otError dataset_get_fake(otInstance *instance, otOperationalDataset *dataset)
{
	otOperationalDataset expected_dataset = {
		{0x0123456789abcdefull, 0x1234, false},
		{0x0123456789abcdefull, 0x1234, false},
		{{INT_SEQUENCE(OT_NETWORK_KEY_SIZE)}},
		{{INT_SEQUENCE(OT_NETWORK_NAME_MAX_SIZE)}},
		{{INT_SEQUENCE(OT_EXT_PAN_ID_SIZE)}},
		{{INT_SEQUENCE(OT_IP6_PREFIX_SIZE)}},
		0x12345678ul,
		0xabcd,
		0xef67,
		{{INT_SEQUENCE(OT_PSKC_MAX_SIZE)}},
		{0x9876, 1, 0, 1, 0, 1, 0, 1, 0, 1, 7},
		0xfedcba98,
		{false, true, false, true, false, true, false, true, false, true, false, true}};

	memcpy(dataset, &expected_dataset, sizeof(otOperationalDataset));

	return OT_ERROR_NONE;
}

/*
 * Test reception of otDatasetGetActive command.
 * Test serialization of the result: dataset.
 */
ZTEST(ot_rpc_dataset, test_otDatasetGetActive)
{
	otDatasetGetActive_fake.custom_fake = dataset_get_fake;

	mock_nrf_rpc_tr_expect_add(RPC_RSP(DATASET), NO_RSP);
	mock_nrf_rpc_tr_receive(RPC_CMD(OT_RPC_CMD_DATASET_GET_ACTIVE));
	mock_nrf_rpc_tr_expect_done();

	zassert_equal(otDatasetGetActive_fake.call_count, 1);
}

/*
 * Test reception of otDatasetGetPending command.
 * Test serialization of the result: dataset.
 */
ZTEST(ot_rpc_dataset, test_otDatasetGetPending)
{
	otDatasetGetPending_fake.custom_fake = dataset_get_fake;

	mock_nrf_rpc_tr_expect_add(RPC_RSP(DATASET), NO_RSP);
	mock_nrf_rpc_tr_receive(RPC_CMD(OT_RPC_CMD_DATASET_GET_PENDING));
	mock_nrf_rpc_tr_expect_done();

	zassert_equal(otDatasetGetPending_fake.call_count, 1);
}

/*
 * Test reception of otDatasetGetActive command.
 * Test serialization of the result: NULL as dataset has not been found.
 */
ZTEST(ot_rpc_dataset, test_otDatasetGetActive_null)
{
	otDatasetGetActive_fake.return_val = OT_ERROR_NOT_FOUND;

	mock_nrf_rpc_tr_expect_add(RPC_RSP(CBOR_NULL), NO_RSP);
	mock_nrf_rpc_tr_receive(RPC_CMD(OT_RPC_CMD_DATASET_GET_ACTIVE));
	mock_nrf_rpc_tr_expect_done();

	zassert_equal(otDatasetGetActive_fake.call_count, 1);
}

/*
 * Test reception of otDatasetGetPending command.
 * Test serialization of the result: NULL as dataset has not been found.
 */
ZTEST(ot_rpc_dataset, test_otDatasetGetPending_null)
{
	otDatasetGetPending_fake.return_val = OT_ERROR_NOT_FOUND;

	mock_nrf_rpc_tr_expect_add(RPC_RSP(CBOR_NULL), NO_RSP);
	mock_nrf_rpc_tr_receive(RPC_CMD(OT_RPC_CMD_DATASET_GET_PENDING));
	mock_nrf_rpc_tr_expect_done();

	zassert_equal(otDatasetGetPending_fake.call_count, 1);
}

ZTEST_SUITE(ot_rpc_dataset, NULL, NULL, tc_setup, NULL, NULL);
```

## src/instance_suite.c
```c
/*
 * Copyright (c) 2024 Nordic Semiconductor ASA
 *
 * SPDX-License-Identifier: LicenseRef-Nordic-5-Clause
 */

#include <mock_nrf_rpc_transport.h>
#include <ot_rpc_ids.h>
#include <test_rpc_env.h>

#include <zephyr/fff.h>
#include <zephyr/kernel.h>
#include <zephyr/ztest.h>

#include <openthread.h>
#include <openthread/instance.h>

/* Fake functions */

FAKE_VALUE_FUNC(otInstance *, otInstanceInitSingle);
FAKE_VALUE_FUNC(uint32_t, otInstanceGetId, otInstance *);
FAKE_VALUE_FUNC(bool, otInstanceIsInitialized, otInstance *);
FAKE_VOID_FUNC(otInstanceFinalize, otInstance *);
FAKE_VALUE_FUNC(otError, otInstanceErasePersistentInfo, otInstance *);
FAKE_VOID_FUNC(otInstanceFactoryReset, otInstance *);
FAKE_VALUE_FUNC(const char *, otGetVersionString);
FAKE_VALUE_FUNC(otError, otSetStateChangedCallback, otInstance *, otStateChangedCallback, void *);
FAKE_VOID_FUNC(otRemoveStateChangeCallback, otInstance *, otStateChangedCallback, void *);

#define FOREACH_FAKE(f)                                                                            \
	f(otInstanceInitSingle);                                                                   \
	f(otInstanceGetId);                                                                        \
	f(otInstanceIsInitialized);                                                                \
	f(otInstanceFinalize);                                                                     \
	f(otInstanceErasePersistentInfo);                                                          \
	f(otGetVersionString);                                                                     \
	f(otSetStateChangedCallback);                                                              \
	f(otRemoveStateChangeCallback);

static void nrf_rpc_err_handler(const struct nrf_rpc_err_report *report)
{
	zassert_ok(report->code);
}

static void tc_setup(void *f)
{
	mock_nrf_rpc_tr_expect_add(RPC_INIT_REQ, RPC_INIT_RSP);
	zassert_ok(nrf_rpc_init(nrf_rpc_err_handler));
	mock_nrf_rpc_tr_expect_reset();

	FOREACH_FAKE(RESET_FAKE);
	FFF_RESET_HISTORY();
}

/*
 * Test reception of otInstanceInitSingle() command.
 * Test serialization of the result: NULL.
 */
ZTEST(ot_rpc_instance, test_otInstanceInitSingle_0)
{
	otInstanceInitSingle_fake.return_val = NULL;

	mock_nrf_rpc_tr_expect_add(RPC_RSP(0), NO_RSP);
	mock_nrf_rpc_tr_receive(RPC_CMD(OT_RPC_CMD_INSTANCE_INIT_SINGLE));
	mock_nrf_rpc_tr_expect_done();

	zassert_equal(otInstanceInitSingle_fake.call_count, 1);
}

/*
 * Test reception of otInstanceInitSingle() command.
 * Test serialization of the result: 0xffffffff.
 */
ZTEST(ot_rpc_instance, test_otInstanceInitSingle_max)
{
	otInstanceInitSingle_fake.return_val = (otInstance *)UINT32_MAX;

	mock_nrf_rpc_tr_expect_add(RPC_RSP(CBOR_UINT32(UINT32_MAX)), NO_RSP);
	mock_nrf_rpc_tr_receive(RPC_CMD(OT_RPC_CMD_INSTANCE_INIT_SINGLE));
	mock_nrf_rpc_tr_expect_done();

	zassert_equal(otInstanceInitSingle_fake.call_count, 1);
}

/*
 * Test reception of otInstanceGetId() command.
 * Test serialization of the result: 0.
 */
ZTEST(ot_rpc_instance, test_otInstanceGetId_0)
{
	uintptr_t instance = (uintptr_t)openthread_get_default_instance();

	otInstanceGetId_fake.return_val = 0;

	mock_nrf_rpc_tr_expect_add(RPC_RSP(0), NO_RSP);
	mock_nrf_rpc_tr_receive(RPC_CMD(OT_RPC_CMD_INSTANCE_GET_ID, CBOR_UINT32(instance)));
	mock_nrf_rpc_tr_expect_done();

	zassert_equal(otInstanceGetId_fake.call_count, 1);
	zassert_equal(otInstanceGetId_fake.arg0_val, (otInstance *)instance);
}

/*
 * Test reception of otInstanceGetId() command.
 * Test serialization of the result: 0xffffffff.
 */
ZTEST(ot_rpc_instance, test_otInstanceGetId_max)
{
	uintptr_t instance = (uintptr_t)openthread_get_default_instance();

	otInstanceGetId_fake.return_val = 0xffffffff;

	mock_nrf_rpc_tr_expect_add(RPC_RSP(CBOR_UINT32(UINT32_MAX)), NO_RSP);
	mock_nrf_rpc_tr_receive(RPC_CMD(OT_RPC_CMD_INSTANCE_GET_ID, CBOR_UINT32(instance)));
	mock_nrf_rpc_tr_expect_done();

	zassert_equal(otInstanceGetId_fake.call_count, 1);
	zassert_equal(otInstanceGetId_fake.arg0_val, (otInstance *)instance);
}

/*
 * Test reception of otInstanceIsInitialized() command.
 * Test serialization of the result: false.
 */
ZTEST(ot_rpc_instance, test_otInstanceIsInitialized_false)
{
	uintptr_t instance = (uintptr_t)openthread_get_default_instance();

	otInstanceIsInitialized_fake.return_val = false;

	mock_nrf_rpc_tr_expect_add(RPC_RSP(CBOR_FALSE), NO_RSP);
	mock_nrf_rpc_tr_receive(RPC_CMD(OT_RPC_CMD_INSTANCE_IS_INITIALIZED, CBOR_UINT32(instance)));
	mock_nrf_rpc_tr_expect_done();

	zassert_equal(otInstanceIsInitialized_fake.call_count, 1);
	zassert_equal(otInstanceIsInitialized_fake.arg0_val, (otInstance *)instance);
}

/*
 * Test reception of otInstanceIsInitialized() command.
 * Test serialization of the result: true.
 */
ZTEST(ot_rpc_instance, test_otInstanceIsInitialized_true)
{
	uintptr_t instance = (uintptr_t)openthread_get_default_instance();

	otInstanceIsInitialized_fake.return_val = true;

	mock_nrf_rpc_tr_expect_add(RPC_RSP(CBOR_TRUE), NO_RSP);
	mock_nrf_rpc_tr_receive(RPC_CMD(OT_RPC_CMD_INSTANCE_IS_INITIALIZED, CBOR_UINT32(instance)));
	mock_nrf_rpc_tr_expect_done();

	zassert_equal(otInstanceIsInitialized_fake.call_count, 1);
	zassert_equal(otInstanceIsInitialized_fake.arg0_val, (otInstance *)instance);
}

/*
 * Test reception of otInstanceFinalize() command.
 */
ZTEST(ot_rpc_instance, test_otInstanceFinalize)
{
	uintptr_t instance = (uintptr_t)openthread_get_default_instance();

	mock_nrf_rpc_tr_expect_add(RPC_RSP(), NO_RSP);
	mock_nrf_rpc_tr_receive(RPC_CMD(OT_RPC_CMD_INSTANCE_FINALIZE, CBOR_UINT32(instance)));
	mock_nrf_rpc_tr_expect_done();

	zassert_equal(otInstanceFinalize_fake.call_count, 1);
}

/*
 * Test reception of otInstanceErasePersistentInfo() command.
 * Test serialization of the result: OT_ERROR_NONE.
 */
ZTEST(ot_rpc_instance, test_otInstanceErasePersistentInfo_ok)
{
	uintptr_t instance = (uintptr_t)openthread_get_default_instance();

	otInstanceErasePersistentInfo_fake.return_val = OT_ERROR_NONE;

	mock_nrf_rpc_tr_expect_add(RPC_RSP(OT_ERROR_NONE), NO_RSP);
	mock_nrf_rpc_tr_receive(
		RPC_CMD(OT_RPC_CMD_INSTANCE_ERASE_PERSISTENT_INFO, CBOR_UINT32(instance)));
	mock_nrf_rpc_tr_expect_done();

	zassert_equal(otInstanceErasePersistentInfo_fake.call_count, 1);
	zassert_equal(otInstanceErasePersistentInfo_fake.arg0_val, (otInstance *)instance);
}

/*
 * Test reception of otInstanceErasePersistentInfo() command.
 * Test serialization of the result: OT_ERROR_INVALID_STATE.
 */
ZTEST(ot_rpc_instance, test_otInstanceErasePersistentInfo_error)
{
	uintptr_t instance = (uintptr_t)openthread_get_default_instance();

	otInstanceErasePersistentInfo_fake.return_val = OT_ERROR_INVALID_STATE;

	mock_nrf_rpc_tr_expect_add(RPC_RSP(OT_ERROR_INVALID_STATE), NO_RSP);
	mock_nrf_rpc_tr_receive(
		RPC_CMD(OT_RPC_CMD_INSTANCE_ERASE_PERSISTENT_INFO, CBOR_UINT32(instance)));
	mock_nrf_rpc_tr_expect_done();

	zassert_equal(otInstanceErasePersistentInfo_fake.call_count, 1);
	zassert_equal(otInstanceErasePersistentInfo_fake.arg0_val, (otInstance *)instance);
}

/*
 * Test reception of otInstanceFactoryReset() command.
 */
ZTEST(ot_rpc_instance, test_otInstanceFactoryReset)
{
	uintptr_t instance = (uintptr_t)openthread_get_default_instance();

	mock_nrf_rpc_tr_expect_add(RPC_RSP(), NO_RSP);
	mock_nrf_rpc_tr_receive(RPC_CMD(OT_RPC_CMD_INSTANCE_FACTORY_RESET));
	mock_nrf_rpc_tr_expect_done();

	zassert_equal(otInstanceFactoryReset_fake.call_count, 1);
	zassert_equal(otInstanceFactoryReset_fake.arg0_val, (otInstance *)instance);
}

/*
 * Test reception of otGetVersionString() command.
 */
ZTEST(ot_rpc_instance, test_otGetVersionString)
{
	const char version[] = {VERSION_STR, '\0'};

	otGetVersionString_fake.return_val = version;

	mock_nrf_rpc_tr_expect_add(RPC_RSP(0x58, 64, VERSION_STR), NO_RSP);
	mock_nrf_rpc_tr_receive(RPC_CMD(OT_RPC_CMD_GET_VERSION_STRING));
	mock_nrf_rpc_tr_expect_done();

	zassert_equal(otGetVersionString_fake.call_count, 1);
}

ZTEST_SUITE(ot_rpc_instance, NULL, NULL, tc_setup, NULL, NULL);
```

## src/link_raw_suite.c
```c
/*
 * Copyright (c) 2025 Nordic Semiconductor ASA
 *
 * SPDX-License-Identifier: LicenseRef-Nordic-5-Clause
 */

#include <mock_nrf_rpc_transport.h>
#include <ot_rpc_ids.h>
#include <test_rpc_env.h>

#include <zephyr/fff.h>
#include <zephyr/ztest.h>
#include <zephyr/kernel.h>

#include <openthread/link_raw.h>

/* Fake functions */

FAKE_VALUE_FUNC(uint64_t, otLinkRawGetRadioTime, otInstance *);

#define FOREACH_FAKE(f) f(otLinkRawGetRadioTime);

static void nrf_rpc_err_handler(const struct nrf_rpc_err_report *report)
{
	zassert_ok(report->code);
}

static void tc_setup(void *f)
{
	mock_nrf_rpc_tr_expect_add(RPC_INIT_REQ, RPC_INIT_RSP);
	zassert_ok(nrf_rpc_init(nrf_rpc_err_handler));
	mock_nrf_rpc_tr_expect_reset();

	FOREACH_FAKE(RESET_FAKE);
	FFF_RESET_HISTORY();
}

/*
 * Test reception of otLinkRawGetRadioTime() command.
 * Test serialization of the result: 0.
 */
ZTEST(ot_rpc_link_raw, test_otLinkRawGetRadioTime_0)
{
	otLinkRawGetRadioTime_fake.return_val = 0;

	mock_nrf_rpc_tr_expect_add(RPC_RSP(0), NO_RSP);
	mock_nrf_rpc_tr_receive(RPC_CMD(OT_RPC_CMD_LINK_RAW_GET_RADIO_TIME));
	mock_nrf_rpc_tr_expect_done();

	zassert_equal(otLinkRawGetRadioTime_fake.call_count, 1);
}

/*
 * Test reception of otLinkRawGetRadioTime() command.
 * Test serialization of the result: UINT64_MAX.
 */
ZTEST(ot_rpc_link_raw, test_otLinkRawGetRadioTime_max)
{
	otLinkRawGetRadioTime_fake.return_val = UINT64_MAX;

	mock_nrf_rpc_tr_expect_add(RPC_RSP(CBOR_UINT64(UINT64_MAX)), NO_RSP);
	mock_nrf_rpc_tr_receive(RPC_CMD(OT_RPC_CMD_LINK_RAW_GET_RADIO_TIME));
	mock_nrf_rpc_tr_expect_done();

	zassert_equal(otLinkRawGetRadioTime_fake.call_count, 1);
}

ZTEST_SUITE(ot_rpc_link_raw, NULL, NULL, tc_setup, NULL, NULL);
```
